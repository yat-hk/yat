// Widget layout + drawing — spec §9 (v0.2 subset: column/row/spacer/divider/
// text/bignum/list/qr/icon, standard chrome). Typography is the real thing as of
// v0.3: proportional Noto Sans / Noto Sans TC bitmaps at the exact sizes and
// line heights §9.3/§9.7 mandate, out of the engine's own tables
// (<yat/fonts.h>, generated by tools/fonts/gen_fonts.py).
#include <yat/engine.h>
#include <yat/icons.h>

#include <algorithm>
#include <cmath>
#include <cstring>
#include <string>
#include <vector>

// Vendored Project Nayuki qrcodegen (MIT) — §9.11. The header already guards
// itself with `extern "C"` for C++ includers. See engine/third_party/qrcodegen/
// for the license and implementation; engine/src/qrcodegen_shim.c gives
// PlatformIO's LDF a srcDir-local translation unit for firmware builds.
#include "../third_party/qrcodegen/qrcodegen.h"

// Keeps a big-buffer leaf out of the layout recursion's frame (see drawQr).
// gcc/clang cover all three targets (host, xtensa-esp32, emscripten).
#if defined(__GNUC__) || defined(__clang__)
#define YAT_NOINLINE __attribute__((noinline))
#else
#define YAT_NOINLINE
#endif

namespace yat {

// ---- semantic ink roles (§9.1a) ----
//
// THE role→ink table. Phase 1 of the colour system is exactly this function:
// one place, six answers, chosen to match what the shipped packs already do
// with raw ink so that adopting a role never moves a pixel.
//
// Phase 2 (device capability profiles, ROADMAP) is `clampInkToProfile` below:
// a mono E1001 has no red/yellow/green/blue to give anything, chromatic or
// role-named, so every one of them becomes Black rather than something that
// reads as broken — never White, which would make the value disappear
// instead of just losing its colour. This costs nothing in practice: every
// shipped pack that colours something for a reason already pairs the colour
// with a difference mono keeps —
//   - a number: sushiro-queue's wait minutes, aqhi's reading;
//   - a word: aqhi's "{{risk}} RISK" label names the band itself, the
//     footer's "stale HH:MM" / "低電 low" say what's wrong in text;
//   - a shape: the alert triangle icon, family-board's pinned star vs
//     unpinned arrow (paired with bold weight, itself untouched by ink);
//   - a bar's fill length: aqhi's gauge, the battery glyph's charge level.
// No shipped pack leans on colour alone to carry meaning — hko-now's raw
// ink literals for official warning signals (§9.1a's "ink stays valid
// forever" case) each pair a distinct icon shape with distinct warning text
// too — so collapsing every chromatic ink to Black is the smallest change
// that stays readable, and it applies identically whether the pack wrote a
// role ("danger") or a literal ("red"): a mono panel can't tell the two
// apart on the wire, and shouldn't have to.
Ink clampInkToProfile(Ink ink, const DeviceProfile& profile) {
  if (profile.palette != PanelPalette::Mono) return ink;
  switch (ink) {
    case Ink::Red: case Ink::Yellow: case Ink::Green: case Ink::Blue: return Ink::Black;
    default: return ink;  // Black, White pass through unchanged
  }
}

// Nothing else in the engine may map a role to an ink.
RolePaint paintForRole(InkRole role, const DeviceProfile& profile) {
  Ink mark = Ink::Black, field = Ink::White;
  switch (role) {
    case InkRole::Accent: mark = Ink::Red; break;   // the brand red, for the one thing a page is about
    case InkRole::Good: mark = Ink::Green; break;   // fine / clear / go — also the green button's own ink
    // Getting worse, not yet bad — and the one role whose ink the panel cannot
    // actually show (canvas.h's RolePaint): yellow measures ~1.1:1 against this
    // white, so `warn` marks in black and spends its yellow on the field the
    // engine lays behind those marks. Everything a household reads off a
    // `warn` — sushiro's middle wait band, aqhi's 4-6 — is a number or a word,
    // and a legible number in black beats an invisible one in yellow.
    case InkRole::Warn: mark = Ink::Black; field = Ink::Yellow; break;
    case InkRole::Danger: mark = Ink::Red; break;   // in force / wrong / act now (warnings, flat battery)
    case InkRole::Info: mark = Ink::Blue; break;    // supporting detail, calm by construction
    case InkRole::Muted: mark = Ink::Black; break;  // de-emphasis; Spectra-6 has no grey to spend on it
  }
  // A mono panel has no field to give either — the mark carries it alone,
  // exactly as it carries every other clamped role.
  Ink clampedField = clampInkToProfile(field, profile);
  if (clampedField != field) clampedField = Ink::White;
  return {clampInkToProfile(mark, profile), clampedField};
}

Ink inkForRole(InkRole role, const DeviceProfile& profile) {
  return paintForRole(role, profile).mark;
}

bool inkRoleFromName(const char* name, InkRole& out) {
  struct { const char* n; InkRole r; } tab[] = {
      {"accent", InkRole::Accent}, {"good", InkRole::Good},   {"warn", InkRole::Warn},
      {"danger", InkRole::Danger}, {"info", InkRole::Info},   {"muted", InkRole::Muted}};
  for (auto& e : tab)
    if (strcmp(name, e.n) == 0) { out = e.r; return true; }
  return false;
}

bool paintFromName(const char* name, RolePaint& out, const DeviceProfile& profile) {
  struct { const char* n; Ink i; } tab[] = {
      {"black", Ink::Black}, {"white", Ink::White}, {"red", Ink::Red},
      {"yellow", Ink::Yellow}, {"green", Ink::Green}, {"blue", Ink::Blue}};
  for (auto& e : tab)
    if (strcmp(name, e.n) == 0) {
      out = {clampInkToProfile(e.i, profile), Ink::White};
      return true;
    }
  InkRole role;
  if (inkRoleFromName(name, role)) { out = paintForRole(role, profile); return true; }
  return false;
}

bool inkFromName(const char* name, Ink& out, const DeviceProfile& profile) {
  RolePaint p;
  if (!paintFromName(name, p, profile)) return false;
  out = p.mark;
  return true;
}

// Every NoticeCode a host can set is an Action by construction (engine.h): the
// Info and Degraded levels are things the engine works out for itself, so a
// host has no code to name them with and cannot manufacture one.
NoticeLevel noticeLevel(NoticeCode code) {
  return code == NoticeCode::None ? NoticeLevel::None : NoticeLevel::Action;
}

bool deviceProfileFromName(const char* name, DeviceProfile& out) {
  if (strcmp(name, "e1002") == 0) { out = kProfileE1002; return true; }
  if (strcmp(name, "e1001") == 0) { out = kProfileE1001; return true; }
  return false;
}

namespace {

using detail::addWarn;
using detail::evalWhen;
using detail::substitute;

// §9.7 `size` -> the face to use, and §9.3's line height for it. Both tables are
// now exactly the spec's; there is a real face at every one of these sizes.
struct SizeSpec { int px; int lineH; };
SizeSpec textSize(const char* s) {
  if (!s) return {24, 30};
  if (strcmp(s, "small") == 0) return {16, 20};
  if (strcmp(s, "medium") == 0) return {24, 30};
  if (strcmp(s, "large") == 0) return {32, 40};
  if (strcmp(s, "xlarge") == 0) return {48, 60};
  return {24, 30};
}
SizeSpec bignumSize(const char* s) {
  if (s && strcmp(s, "xlarge") == 0) return {128, 148};
  return {96, 112};
}

// UTF-8 -> UTF-16 (BMP only; others become U+FFFD)
size_t utf8Next(const std::string& s, size_t i, uint16_t& code) {
  unsigned char c = s[i];
  if (c < 0x80) { code = c; return i + 1; }
  if ((c & 0xE0) == 0xC0 && i + 1 < s.size()) {
    code = ((c & 0x1F) << 6) | (s[i + 1] & 0x3F);
    return i + 2;
  }
  if ((c & 0xF0) == 0xE0 && i + 2 < s.size()) {
    code = ((c & 0x0F) << 12) | ((s[i + 1] & 0x3F) << 6) | (s[i + 2] & 0x3F);
    return i + 3;
  }
  if ((c & 0xF8) == 0xF0 && i + 3 < s.size()) { code = 0xFFFD; return i + 4; }
  code = 0xFFFD;
  return i + 1;
}

// A codepoint no face covers (§9.7). Rather than leave a hole — which reads as a
// data bug the author can't see — draw the conventional "missing glyph" hollow
// box, proportioned off the em so it sits in the run at any size.
int tofuW(int px) { return px * 3 / 5; }
int tofuH(int px) { return px * 7 / 10; }
int tofuAdvance(int px) { return tofuW(px) + (px + 7) / 8; }

int glyphAdvance(FontProvider& font, uint16_t code, int px, bool bold) {
  GlyphInfo g;
  if (!font.glyph(px, code, bold, g)) return tofuAdvance(px);
  return g.advance;
}

int textWidth(FontProvider& font, const std::string& s, int px, bool bold) {
  int w = 0;
  uint16_t code;
  for (size_t i = 0; i < s.size();) {
    i = utf8Next(s, i, code);
    w += glyphAdvance(font, code, px, bold);
  }
  return w;
}

// §9.3(5): drawing is clipped at the container bounds, per pixel — a glyph that
// straddles the edge is cut, not dropped, so the clip never changes where the
// following glyphs land.
void blitGlyph(Canvas& cv, const GlyphInfo& g, int penX, int baselineY, Ink ink, int clipLeft,
               int clipRight) {
  if (!g.bitmap || g.bw == 0 || g.bh == 0) return;  // e.g. space: advance only
  int x0 = penX + g.xOffset, y0 = baselineY + g.yOffset;
  for (int row = 0; row < g.bh; row++) {
    const uint8_t* r = g.bitmap + (size_t)row * g.stride;
    for (int col = 0; col < g.bw; col++) {
      if (!(r[col >> 3] & (0x80 >> (col & 7)))) continue;
      int px = x0 + col * g.scale, py = y0 + row * g.scale;
      for (int sx = 0; sx < g.scale; sx++) {
        // Synthetic bold widens each column by one *device* pixel to the right,
        // which is why GlyphInfo::advance already carries the extra pixel.
        int span = g.smear ? 2 : 1;
        for (int k = 0; k < span; k++) {
          int cx = px + sx + k;
          if (cx < clipLeft || cx >= clipRight) continue;
          cv.fillRect(cx, py, 1, g.scale, ink);
        }
      }
    }
  }
}

void drawTofu(Canvas& cv, int penX, int baselineY, int px, Ink ink, int clipLeft, int clipRight) {
  int w = tofuW(px), h = tofuH(px);
  int x = penX, y = baselineY - h;
  int t = px >= 48 ? 2 : 1;
  auto band = [&](int bx, int by, int bw, int bh) {
    int l = std::max(bx, clipLeft), r = std::min(bx + bw, clipRight);
    if (r > l) cv.fillRect(l, by, r - l, bh, ink);
  };
  band(x, y, w, t);
  band(x, y + h - t, w, t);
  band(x, y, t, h);
  band(x + w - t, y, t, h);
}


// `baselineY` — not the top of the line box. Callers that have a line box get the
// baseline by adding FontProvider::ascent(px).
int drawTextRun(Canvas& cv, FontProvider& font, int x, int baselineY, const std::string& s, int px,
                Ink ink, bool bold, int clipLeft, int clipRight) {
  // Every text path in the engine funnels through here — `text`, `bignum`,
  // `list` rows, chrome — so the highlighter is applied once, here, rather than
  // at each of them. A pack that spelled `"color": "yellow"` on type gets it
  // automatically and needs no edit; the `warn` role never reaches it, because
  // that role's mark has been black since §9.1a-a's first revision.
  if (ink == Ink::Yellow) {
    // §9.1a-a second revision, settled on the owner's panel twice over: the
    // highlight band worked in isolation but broke column coherence — one
    // banded row among plain siblings (live sushiro, an evening of red waits
    // and a single teens row) reads as a glitch, not as emphasis. So yellow
    // type clamps to plain black, full stop, the same shape as the mono
    // profile's chromatic clamp: packs keep saying "yellow", the panel gets
    // the one thing it can actually print at stroke width. Yellowness, where
    // a design truly wants it, belongs to surfaces the panel renders well.
    ink = Ink::Black;
  }
  uint16_t code;
  for (size_t i = 0; i < s.size();) {
    i = utf8Next(s, i, code);
    GlyphInfo g;
    if (font.glyph(px, code, bold, g)) {
      blitGlyph(cv, g, x, baselineY, ink, clipLeft, clipRight);
      x += g.advance;
    } else {
      drawTofu(cv, x, baselineY, px, ink, clipLeft, clipRight);
      x += tofuAdvance(px);
    }
  }
  return x;
}

// Trims `line` by whole codepoints until the ellipsis fits inside `maxWidth`,
// then appends it (§9.3: "the last rendered line ends with …"). v0.1 appended
// unconditionally, which overflowed the moment advances stopped being uniform.
void ellipsize(FontProvider& font, std::string& line, int px, bool bold, int maxWidth) {
  static const char* kEllipsis = "…";
  int ellW = textWidth(font, kEllipsis, px, bold);
  while (!line.empty() && textWidth(font, line, px, bold) + ellW > maxWidth) {
    size_t cut = line.size();
    while (cut > 0 && ((unsigned char)line[cut - 1] & 0xC0) == 0x80) cut--;  // UTF-8 continuation
    if (cut > 0) cut--;
    line.resize(cut);
  }
  while (!line.empty() && line.back() == ' ') line.pop_back();
  line += kEllipsis;
}

// Greedy wrap (§9.3): Latin breaks on spaces, CJK anywhere, `\n` forces a break.
// Lines past `maxLines` are dropped and the last one gets an ellipsis.
std::vector<std::string> wrapText(FontProvider& font, const std::string& s, int px, bool bold,
                                  int maxWidth, int maxLines) {
  std::vector<std::string> lines;
  if (maxLines < 1) maxLines = 1;
  std::string cur;
  int curW = 0;
  size_t lastSpace = std::string::npos;  // byte index of the last ' ' inside cur
  bool truncated = false;
  uint16_t code;
  size_t i = 0;
  while (i < s.size()) {
    size_t next = utf8Next(s, i, code);
    if (code == '\n') {
      lines.push_back(cur);
      cur.clear();
      curW = 0;
      lastSpace = std::string::npos;
      i = next;
      if ((int)lines.size() >= maxLines) { truncated = i < s.size(); break; }
      continue;
    }
    int adv = glyphAdvance(font, code, px, bold);
    if (!cur.empty() && curW + adv > maxWidth) {
      if ((int)lines.size() + 1 >= maxLines) { truncated = true; break; }
      if (code < 0x100 && lastSpace != std::string::npos) {
        std::string rest = cur.substr(lastSpace + 1);
        cur.resize(lastSpace);
        lines.push_back(cur);
        cur = rest;
        curW = textWidth(font, cur, px, bold);  // proportional: no arithmetic shortcut
      } else {
        lines.push_back(cur);
        cur.clear();
        curW = 0;
      }
      lastSpace = std::string::npos;
      continue;  // re-test this same glyph against the fresh line
    }
    if (code == ' ') lastSpace = cur.size();
    cur.append(s, i, next - i);
    curW += adv;
    i = next;
  }
  if (!cur.empty() || lines.empty()) lines.push_back(cur);
  if (truncated) ellipsize(font, lines.back(), px, bold, maxWidth);
  return lines;
}

// §9.3 row-axis intrinsic width of a `text`: "longest line's rendered advance
// width, unwrapped" — i.e. split on explicit `\n` only, never on wrapping.
int unwrappedWidth(FontProvider& font, const std::string& s, int px, bool bold) {
  int best = 0, cur = 0;
  uint16_t code;
  for (size_t i = 0; i < s.size();) {
    i = utf8Next(s, i, code);
    if (code == '\n') {
      if (cur > best) best = cur;
      cur = 0;
      continue;
    }
    cur += glyphAdvance(font, code, px, bold);
  }
  return cur > best ? cur : best;
}

// ---- yellow: surface vs stroke (§9.1a-a) ----------------------------------
//
// Settled on the hardware, by the owner, off a six-candidate swatch card. The
// verdict, verbatim:
//
//   TEXT — only D (1/2 red) is visible, but "it's pure orange, not yellow";
//          B, C, E and F text all bad.
//   FIELDS — A (pure yellow) "isn't too bad", E "okay".
//
// Which says something none of the design rounds before it had right:
// **yellow works as a SURFACE and fails as a STROKE.** Enough of it in one
// place is legible even at 1.1:1 against white; a few pixels of it wide is not,
// and no weave rescues the stroke case without destroying the colour — D was
// the only legible text and it had stopped being yellow by the time it got
// there.
//
// So the engine sorts yellow into two classes rather than treating it as one
// ink with one problem:
//
//   SURFACE  fills, fields, bars, a 24px icon bitmap's chunky runs — pure
//            yellow, untouched, exactly as a pack asked for.
//   STROKE   type, and thin rules with nowhere to put a field. Type gets the
//            highlighter treatment below (black glyphs on a yellow band, which
//            converts the stroke case into the surface case and keeps the
//            colour). Rules that cannot have a field — a chart's line, a
//            yellow `divider` — get the D weave, on the grounds that a visible
//            orange line beats an invisible yellow one when there is no third
//            option.
//
// Ordered (Bayer) rather than error-diffused: positionally stable, so the same
// stroke at the same place is always the same pixels (§12.2 cross-target
// identity, §11.2's render hash), one table lookup per pixel on an ESP32, and
// it tiles seamlessly because it is indexed by absolute canvas coordinates.
struct AmberMix {
  uint8_t red;    // pixels per 64 replaced with Ink::Red
  uint8_t black;  // pixels per 64 replaced with Ink::Black
};

// Red counts up from the low end of the ordered pattern and black counts down
// from the high end, so a mix carrying both never puts the two in neighbouring
// slots — a blend stays a blend instead of clumping into visible specks.
const uint8_t kBayer8[64] = {
    0,  32, 8,  40, 2,  34, 10, 42, 48, 16, 56, 24, 50, 18, 58, 26,
    12, 44, 4,  36, 14, 46, 6,  38, 60, 28, 52, 20, 62, 30, 54, 22,
    3,  35, 11, 43, 1,  33, 9,  41, 51, 19, 59, 27, 49, 17, 57, 25,
    15, 47, 7,  39, 13, 45, 5,  37, 63, 31, 55, 23, 61, 29, 53, 21};

Ink amberInkAt(const AmberMix& mix, int x, int y) {
  const uint8_t t = kBayer8[(y & 7) * 8 + (x & 7)];
  if (t < mix.red) return Ink::Red;
  if (t >= 64 - mix.black) return Ink::Black;
  return Ink::Yellow;
}

// Candidate D from the swatch card: red 1-in-2. Chosen for exactly one job —
// the stroke that has no field to fall back on — and chosen knowing what it
// costs. The owner's own words about D were "it's pure orange, not yellow";
// that is a bad trade for a word, which is why type does not use it, and an
// acceptable one for a chart line, which is otherwise not there at all.
const AmberMix kAmber = {32, 0};

// Weaves the amber through `Ink::Yellow`, but only where a draw site has asked
// for it. The default is OFF and that is the whole design: after the hardware
// verdict, most yellow must reach the panel untouched, so this proxy is opt-in
// per stroke rather than a blanket substitution.
//
// A Mono profile weaves nothing, because `clampInkToProfile` has already turned
// every yellow black before a paint gets here — amber clamps exactly as yellow
// did, by never being reached.
struct AmberCanvas : Canvas {
  Canvas& target;
  bool enabled;
  bool weave = false;
  AmberCanvas(Canvas& t, const DeviceProfile& profile)
      : target(t), enabled(profile.palette == PanelPalette::Spectra6) {}
  int width() const override { return target.width(); }
  int height() const override { return target.height(); }
  bool weaving(Ink ink) const { return enabled && weave && ink == Ink::Yellow; }
  void drawPixel(int x, int y, Ink ink) override {
    target.drawPixel(x, y, weaving(ink) ? amberInkAt(kAmber, x, y) : ink);
  }
  void fillRect(int x, int y, int w, int h, Ink ink) override {
    if (!weaving(ink)) { target.fillRect(x, y, w, h, ink); return; }
    for (int j = y; j < y + h; j++)
      for (int i = x; i < x + w; i++) target.drawPixel(i, j, amberInkAt(kAmber, i, j));
  }
};

// Marks a scope as drawing a STROKE with no field available — a chart's line, a
// `divider`'s rule. Yellow inside it is woven; everything else is unaffected.
struct AmberStrokeScope {
  AmberCanvas* a;
  bool saved;
  explicit AmberStrokeScope(AmberCanvas* a_) : a(a_), saved(a_ && a_->weave) {
    if (a) a->weave = true;
  }
  ~AmberStrokeScope() { if (a) a->weave = saved; }
};

// §9.3(5) "children are drawn in order and clipped at the container bounds".
// Until v0.3 only two places honoured that: `text`, which clips glyphs to its
// own left/right edges, and `list`, which drops a row that would not fit. Every
// other widget drew wherever layout put it — so a `column` whose children add up
// to more than its box (a hand-unrolled bar-row trend, a long param label) painted
// straight over the footer chrome.
//
// The clip lives in a proxy canvas rather than being threaded through the ~20
// draw call sites, because "the one place a new widget forgets to check" is
// exactly how this bug got in. Chrome (§9.1) is drawn on the real canvas before
// the widget tree is entered, so it is never clipped by content.
struct ClipCanvas : Canvas {
  Canvas& target;
  int x0, y0, x1, y1;  // half-open clip rect, canvas coordinates
  explicit ClipCanvas(Canvas& t) : target(t), x0(0), y0(0), x1(t.width()), y1(t.height()) {}
  int width() const override { return target.width(); }
  int height() const override { return target.height(); }
  void drawPixel(int x, int y, Ink ink) override {
    if (x < x0 || y < y0 || x >= x1 || y >= y1) return;
    target.drawPixel(x, y, ink);
  }
  void fillRect(int x, int y, int w, int h, Ink ink) override {
    int l = x > x0 ? x : x0, t = y > y0 ? y : y0;
    int r = x + w < x1 ? x + w : x1, b = y + h < y1 ? y + h : y1;
    if (r > l && b > t) target.fillRect(l, t, r - l, b - t, ink);
  }
};

// Narrows the clip to one container's content box for the lifetime of the
// scope, then restores it. Intersects — a child can never widen what its parent
// allows. 16 bytes of stack per nesting level and no recursion of its own; the
// §12.1 layout-depth cap already bounds the chain.
struct ClipScope {
  ClipCanvas& cc;
  int sx0, sy0, sx1, sy1;
  ClipScope(ClipCanvas& c, int x, int y, int w, int h)
      : cc(c), sx0(c.x0), sy0(c.y0), sx1(c.x1), sy1(c.y1) {
    if (x > cc.x0) cc.x0 = x;
    if (y > cc.y0) cc.y0 = y;
    if (x + w < cc.x1) cc.x1 = x + w;
    if (y + h < cc.y1) cc.y1 = y + h;
  }
  ~ClipScope() { cc.x0 = sx0; cc.y0 = sy0; cc.x1 = sx1; cc.y1 = sy1; }
};

struct Ctx {
  ClipCanvas& cv;
  FontProvider& font;
  detail::EvalCtx ev;  // params/data/pack/strings/item/index/lang/now/warn
  std::string err;
  const FetchFn* fetch = nullptr;      // §9.10: stashed by fetchAndExtract(), may be null
  ImageDecoder* imageDecoder = nullptr;  // §9.10: Engine::setImageDecoder(), may be null
  DeviceProfile profile = kProfileE1002;  // ROADMAP device capability profile, bound in render()
  AmberCanvas* amber = nullptr;  // §9.1a-a weave, so drawImage can suspend it for its dither
};

// Binds `item`/`index` for one list row and restores the outer context (§9.8).
struct RowScope {
  Ctx& c;
  JsonVariantConst item;
  long index;
  bool inRow;
  explicit RowScope(Ctx& c_) : c(c_), item(c_.ev.item), index(c_.ev.index), inRow(c_.ev.inRow) {}
  void bind(JsonVariantConst el, long i) {
    c.ev.item = el;
    c.ev.index = i;
    c.ev.inRow = true;
  }
  ~RowScope() {
    c.ev.item = item;
    c.ev.index = index;
    c.ev.inRow = inRow;
  }
};

// §9.1 `color`, all three spellings: an ink literal ("red"), a semantic role
// (§9.1a, "danger" — what packs SHOULD write), or the param form
// {"param": "<name>"} naming an enum param whose members are either.
//
// The param form was specified and schema'd in 0.3 but never implemented here:
// an object is not a string, so `w["color"] | dflt` quietly handed back the
// default and `stock-ticker`'s user-chosen up/down colours rendered black on
// every panel. Resolving it needs the params, which is why this takes `Ctx`.
//
// A name that resolves to nothing warns rather than silently drawing black —
// a typo'd colour is invisible in review and indistinguishable on the panel
// from a deliberate one.
RolePaint widgetPaint(Ctx& c, JsonVariantConst w, const char* dflt = "black") {
  JsonVariantConst cvar = w["color"];
  const char* name = dflt;
  if (cvar.is<JsonObjectConst>()) {
    const char* pn = cvar["param"] | "";
    const char* pv = c.ev.params[pn] | "";
    if (pv[0] == '\0')
      addWarn(c.ev.warn, std::string("color param '") + pn + "' is not set to a colour name");
    else
      name = pv;
  } else {
    name = cvar | dflt;
  }
  RolePaint p{Ink::Black, Ink::White};
  if (!paintFromName(name, p, c.profile)) {
    addWarn(c.ev.warn, std::string("unknown color '") + name + "' (§9.1); drawn in " + dflt);
    paintFromName(dflt, p, c.profile);
  }
  return p;
}

// The one-ink answer. Every widget whose whole surface is marks — type,
// bignum, icon, divider, chart — takes this and never sees a field: §9.1a-a's
// rule is that a field only ever sits *behind* a mark, and these have nothing
// to put behind.
Ink widgetInk(Ctx& c, JsonVariantConst w, const char* dflt = "black") {
  return widgetPaint(c, w, dflt).mark;
}

int iconPx(const char* s) {
  if (s && strcmp(s, "small") == 0) return 24;
  if (s && strcmp(s, "large") == 0) return 96;
  return 48;
}

// ---- measurement (§9.3, v0.1 metrics) ----
// `availW` is always a width: the wrap width when measuring a height
// (inColumn), the width still free to the left-to-right run when measuring a
// width (in a row). Passing a row's *height* here was the v0.1 clamp bug.
int measureMain(Ctx& c, JsonVariantConst w, bool inColumn, int availW);
int measureList(Ctx& c, JsonVariantConst w, bool inColumn, int availW);

// One child of a container, with the main-axis extent layout gave it.
struct LayoutItem { JsonVariantConst w; int main; int flex; };

// §9.3(2)+(3): the single place that divides a container's main axis between
// its children — intrinsic sizes first, then `remaining` shared out among the
// `flex` ones. Measurement and drawing both call it, because they MUST agree:
// a row that measures its height as if each child had the whole width, then
// draws each child in a narrow slice of it, is a row too short for its own
// contents. That spilled harmlessly until §9.3(5) clipping landed; now it would
// silently eat the wrapped second line of a text.
//
// Returns Σ intrinsic + gaps, i.e. what the children need; the caller compares
// that against `mainAvail` to detect overflow. `cross` is only read for a
// column (it is the wrap width there); a row's children are measured against
// the width their earlier siblings left, so a row can be laid out before its
// own height is known.
int layoutChildren(Ctx& c, JsonVariantConst w, bool isColumn, int mainAvail, int cross,
                   std::vector<LayoutItem>& items) {
  int gap = w["gap"] | 0;
  int fixedSum = 0, flexSum = 0, visCount = 0, used = 0, flexCount = 0;
  for (JsonVariantConst ch : w["children"].as<JsonArrayConst>()) {
    bool vis = true;
    if (!evalWhen(ch["when"], c.ev, vis, c.err) && !c.err.empty()) return 0;
    if (!vis) continue;
    int fx = ch["flex"] | 0;
    // §9.3: a `list` in a row fills the width left over by intrinsic siblings.
    if (fx == 0 && !isColumn && strcmp(ch["type"] | "", "list") == 0) fx = 1;
    if (visCount > 0) used += gap;
    int m = 0;
    if (fx == 0) {
      // In a row the child clamps to the width earlier siblings left free.
      m = measureMain(c, ch, isColumn, isColumn ? cross : (mainAvail - used > 0 ? mainAvail - used : 0));
      used += m;
    } else {
      flexCount++;
    }
    items.push_back({ch, m, fx});
    fixedSum += m;
    flexSum += fx;
    visCount++;
  }
  int gaps = visCount > 1 ? gap * (visCount - 1) : 0;
  int remaining = mainAvail - fixedSum - gaps;
  if (remaining < 0) remaining = 0;  // §9.3(3): negative remaining -> flex gets 0
  int given = 0, flexSeen = 0;
  for (auto& it : items) {
    if (it.flex > 0) {
      flexSeen++;
      it.main = (flexSeen == flexCount) ? remaining - given
                                        : (int)((long)remaining * it.flex / (flexSum ? flexSum : 1));
      given += it.main;
    }
  }
  return fixedSum + gaps;
}

// Intrinsic size of a container's children (§9.3(2)): every rendered child —
// flex ones included — contributes its intrinsic size here. `flex` only grows a
// child into space already allocated to its container (§9.3(3), done in
// drawContainer); counting a flex child as 0 while measuring a *nested*
// container collapsed rows whose text carried flex.
int measureChildrenSum(Ctx& c, JsonVariantConst w, bool childrenInColumn, int availW) {
  int total = 0, count = 0, used = 0, gap = w["gap"] | 0;
  for (JsonVariantConst ch : w["children"].as<JsonArrayConst>()) {
    bool vis = true;
    std::string e;
    evalWhen(ch["when"], c.ev, vis, e);
    if (!vis) continue;
    if (count > 0) used += gap;
    count++;
    int avail = childrenInColumn ? availW : (availW - used > 0 ? availW - used : 0);
    int m = measureMain(c, ch, childrenInColumn, avail);
    total += m;
    used += m;
  }
  if (count > 1) total += gap * (count - 1);
  return total;
}

int measureMain(Ctx& c, JsonVariantConst w, bool inColumn, int availW) {
  const char* t = w["type"] | "";
  if (strcmp(t, "text") == 0) {
    SizeSpec sz = textSize(w["size"] | "medium");
    bool bold = strcmp(w["weight"] | "regular", "bold") == 0;
    std::string s;
    if (!substitute(w["value"] | "", c.ev, s, c.err)) return 0;
    if (inColumn) {
      int maxLines = w["max_lines"] | 1;
      auto lines = wrapText(c.font, s, sz.px, bold, availW, maxLines);
      return sz.lineH * (int)lines.size();
    }
    int tw = unwrappedWidth(c.font, s, sz.px, bold);
    return tw < availW ? tw : availW;
  }
  if (strcmp(t, "bignum") == 0) {
    SizeSpec sz = bignumSize(w["size"] | "large");
    if (inColumn) return sz.lineH;
    std::string s;
    if (!substitute(w["value"] | "", c.ev, s, c.err)) return 0;
    return textWidth(c.font, s, sz.px, false);
  }
  if (strcmp(t, "bar") == 0) return inColumn ? (w["height"] | 12) : availW;  // §9.12/§9.3 fill
  if (strcmp(t, "chart") == 0) return inColumn ? (w["height"] | 96) : availW;  // §9.12a/§9.3 fill
  if (strcmp(t, "spacer") == 0) return w["size"] | 0;
  if (strcmp(t, "divider") == 0) return w["thickness"] | 1;
  if (strcmp(t, "icon") == 0) return iconPx(w["size"] | "medium");
  if (strcmp(t, "qr") == 0) return w["size"] | 120;
  if (strcmp(t, "image") == 0) return inColumn ? (w["height"] | 1) : (w["width"] | 1);  // §9.3/§9.10
  if (strcmp(t, "list") == 0) {
    // §9.3: Σ rendered row heights + gaps in a column; widest rendered row
    // when measured as a width. (A list that is a *direct child of a row*
    // additionally fills the leftover width — implicit flex 1, drawContainer.)
    return measureList(c, w, inColumn, availW);
  }
  if (strcmp(t, "column") == 0) {
    int padV = 0, padH = 0;
    JsonArrayConst pad = w["padding"].as<JsonArrayConst>();
    if (!pad.isNull()) { padV = (int)pad[0] + (int)pad[2]; padH = (int)pad[1] + (int)pad[3]; }
    if (inColumn) return measureChildrenSum(c, w, true, availW - padH) + padV;
    // column measured along a row's axis: max child cross width + padding
    int m = 0;
    for (JsonVariantConst ch : w["children"].as<JsonArrayConst>()) {
      bool vis = true; std::string e;
      evalWhen(ch["when"], c.ev, vis, e);
      if (!vis) continue;
      int cw = measureMain(c, ch, false, availW - padH);
      if (cw > m) m = cw;
    }
    return m + padH;
  }
  if (strcmp(t, "row") == 0) {
    int padV = 0, padH = 0;
    JsonArrayConst pad = w["padding"].as<JsonArrayConst>();
    if (!pad.isNull()) { padV = (int)pad[0] + (int)pad[2]; padH = (int)pad[1] + (int)pad[3]; }
    if (!inColumn) return measureChildrenSum(c, w, false, availW - padH) + padH;
    // Row measured in a column: height = max child height + padding, where each
    // child is measured at the width layout will actually give it — the same
    // division drawContainer performs. Measuring every child against the full
    // container width instead under-counted anything that wraps (§9.3's "clamped
    // to the container's remaining width; wrapping then applies at that clamp").
    std::vector<LayoutItem> items;
    layoutChildren(c, w, false, availW - padH, 0, items);
    if (!c.err.empty()) return 0;
    int m = 0;
    for (auto& it : items) {
      int chH = measureMain(c, it.w, true, it.main);
      if (chH > m) m = chH;
    }
    return m + padV;
  }
  c.err = std::string("engine v0.2: widget '") + t + "' not implemented";
  return 0;
}

// §6.5 bind-expr -> the bound value. Shared by `list` (§9.8) and `chart`
// (§9.12a) so both accept exactly the same roots; `who` only names the widget in
// the error text.
bool resolveBind(Ctx& c, const std::string& bind, const char* who, JsonVariantConst& out) {
  size_t dot = bind.find('.');
  if (dot == std::string::npos) {
    c.err = std::string(who) + ": bad bind '" + bind + "' (§6.5 bind-expr)";
    return false;
  }
  std::string head = bind.substr(0, dot), name = bind.substr(dot + 1);
  JsonVariantConst root;
  if (head == "data") root = c.ev.data;
  else if (head == "params") root = c.ev.params;
  // §9.8a: a nested list's bind is `item.<prop>`, rooted at the outer row's
  // current `item` — legal only inside a list row (RowScope has set inRow).
  else if (head == "item" && c.ev.inRow) root = c.ev.item;
  else {
    c.err = std::string(who) + ": bind root '" + head +
            "' must be data or params (§6.5), or item.<prop> for a §9.8a nested list";
    return false;
  }
  out = root[name.c_str()];
  return true;
}

// ---- list (§9.8) ----
struct ListPlan {
  JsonVariantConst arr;
  bool bindOk = false;  // false -> E_BIND: the list renders nothing
  int maxRows = 10;
  int gap = 4;
};

bool listPlan(Ctx& c, JsonVariantConst w, ListPlan& lp) {
  if (!resolveBind(c, w["bind"] | "", "list", lp.arr)) return false;
  lp.bindOk = lp.arr.is<JsonArrayConst>();
  lp.gap = w["gap"] | 4;
  JsonVariantConst mr = w["max_rows"];
  if (mr.isNull()) {
    lp.maxRows = 10;
  } else if (mr.is<JsonObjectConst>()) {  // §9.8 param form
    const char* pn = mr["param"] | "";
    JsonVariantConst pv = c.ev.params[pn];
    if (!pv.is<long>() && !pv.is<int>() && !pv.is<double>()) {
      c.err = std::string("list: max_rows param '") + pn + "' is not an integer";
      return false;
    }
    lp.maxRows = (int)pv.as<long>();
  } else {
    lp.maxRows = mr.as<int>();
  }
  if (lp.maxRows < 1) lp.maxRows = 1;
  if (lp.maxRows > 20) lp.maxRows = 20;
  return true;
}

// One row = the row template as an implicit `row` container, gap 0
// (§9.3: row height = max child intrinsic height).
void makeRowTemplate(JsonVariantConst w, JsonDocument& doc) {
  JsonObject o = doc.to<JsonObject>();
  o["type"] = "row";
  o["gap"] = 0;
  o["children"] = w["row"];
}

// empty_text renders as a plain `medium` text (§9.8).
void makeEmptyText(JsonVariantConst w, JsonDocument& doc) {
  JsonObject o = doc.to<JsonObject>();
  o["type"] = "text";
  o["value"] = w["empty_text"];
  o["size"] = "medium";
}

// RFC-foreach-partial-results.md option A: the engine-owned line a `list`
// draws on its own E_BIND slot instead of nothing. This is not `empty_text`
// (§9.8 keeps that reserved for the genuinely-empty array — a different user
// message from "this source never got data") and it is not a substitution
// into the pack's own widgets — it is the widget-scale sibling of the §11.3
// fallback card, in the same calm, non-`danger` chrome voice, drawn only on
// the list's own failed slot rather than the whole page. Built as a plain
// `text` widget so it rides the existing measure/draw/clip machinery instead
// of duplicating it (§12.2: measure and draw must agree).
void makeBindFailText(JsonDocument& doc) {
  JsonObject o = doc.to<JsonObject>();
  o["type"] = "text";
  o["value"] = "暫時攞唔到 · Can't get this right now";
  o["size"] = "small";
  o["color"] = "info";
}

int measureList(Ctx& c, JsonVariantConst w, bool inColumn, int availW) {
  ListPlan lp;
  if (!listPlan(c, w, lp)) return 0;
  if (!lp.bindOk) {
    // §A: E_BIND now draws one engine-owned line instead of nothing (never
    // `empty_text` — §9.8 still reserves that for the genuinely-empty case).
    JsonDocument ed;
    makeBindFailText(ed);
    return measureMain(c, ed.as<JsonVariantConst>(), inColumn, availW);
  }
  JsonArrayConst a = lp.arr.as<JsonArrayConst>();
  if (a.size() == 0) {
    if (w["empty_text"].isNull()) return 0;
    JsonDocument ed;
    makeEmptyText(w, ed);
    return measureMain(c, ed.as<JsonVariantConst>(), inColumn, availW);
  }
  JsonDocument rowDoc;
  makeRowTemplate(w, rowDoc);
  RowScope scope(c);
  int total = 0, widest = 0, n = 0;
  for (JsonVariantConst el : a) {
    if (n >= lp.maxRows) break;
    scope.bind(el, ++n);
    int m = measureMain(c, rowDoc.as<JsonVariantConst>(), inColumn, availW);
    if (!c.err.empty()) return 0;
    total += m;
    if (m > widest) widest = m;
  }
  if (!inColumn) return widest;
  if (n > 1) total += lp.gap * (n - 1);
  return total;
}

// ---- drawing ----
void drawWidget(Ctx& c, JsonVariantConst w, int x, int y, int width, int height, bool inColumn);

void drawContainer(Ctx& c, JsonVariantConst w, int x, int y, int width, int height, bool isColumn) {
  JsonArrayConst pad = w["padding"].as<JsonArrayConst>();
  int pt = 0, pr = 0, pb = 0, pl = 0;
  if (!pad.isNull()) { pt = pad[0]; pr = pad[1]; pb = pad[2]; pl = pad[3]; }
  x += pl; y += pt; width -= pl + pr; height -= pt + pb;
  int gap = w["gap"] | 0;
  int mainAvail = isColumn ? height : width;
  int cross = isColumn ? width : height;

  std::vector<LayoutItem> items;
  int needed = layoutChildren(c, w, isColumn, mainAvail, cross, items);
  if (!c.err.empty()) return;
  if (needed > mainAvail) {
    // §9.3(5) makes this silent on the panel, but a pack whose content does not
    // fit is a pack whose author wants to know — the preview prints render
    // warnings, the device logs them.
    char buf[96];
    snprintf(buf, sizeof(buf), "layout overflow: %s content exceeds its box by %dpx — clipped",
             isColumn ? "column" : "row", needed - mainAvail);
    addWarn(c.ev.warn, buf);
  }

  const char* align = w["align"] | (isColumn ? "stretch" : "center");
  ClipScope clip(c.cv, x, y, width, height);  // §9.3(5)
  int cur = isColumn ? y : x;
  for (auto& it : items) {
    int chX, chY, chW, chH;
    if (isColumn) {
      chX = x; chW = width; chY = cur; chH = it.main;
      // §9.3(4) cross positioning for intrinsic-width widgets (text/bignum
      // keep their own `align` property, v0.1 behaviour).
      const char* t = it.w["type"] | "";
      if (strcmp(t, "icon") == 0 || strcmp(t, "qr") == 0 || strcmp(t, "image") == 0) {
        int iw = measureMain(c, it.w, false, width);
        if (iw > 0 && iw < width) {
          if (strcmp(align, "center") == 0) chX = x + (width - iw) / 2;
          else if (strcmp(align, "end") == 0) chX = x + width - iw;
          chW = iw;
        }
      }
    } else {
      chY = y; chH = height; chX = cur; chW = it.main;
      if (strcmp(align, "center") == 0) {
        int h = measureMain(c, it.w, true, chW);
        if (h < height) { chY = y + (height - h) / 2; chH = h; }
      } else if (strcmp(align, "end") == 0) {
        int h = measureMain(c, it.w, true, chW);
        if (h < height) { chY = y + height - h; chH = h; }
      }
    }
    drawWidget(c, it.w, chX, chY, chW, chH, isColumn);
    if (!c.err.empty()) return;
    cur += it.main + gap;
  }
}

void strokeRect(Canvas& cv, int x, int y, int w, int h, Ink ink) {
  if (w <= 0 || h <= 0) return;
  cv.fillRect(x, y, w, 1, ink);
  cv.fillRect(x, y + h - 1, w, 1, ink);
  cv.fillRect(x, y, 1, h, ink);
  cv.fillRect(x + w - 1, y, 1, h, ink);
}

// §9.9: one catalog bitmap, blitted at integer scale — one fillRect per set
// bit, same loop shape as drawGlyph. Shared by the `icon` widget, the footer
// battery glyph and the empty-state card so all three stay pixel-identical
// (and so a fourth caller has nothing to get subtly wrong).
void blitIcon(Canvas& cv, const uint8_t* bits, int x, int y, int scale, Ink ink) {
  // §9.1a-a, third and final hardware verdict: icon bitmaps are strokes too —
  // a sun is rays and a thin circle, and on this panel it vanished exactly
  // like yellow type did (owner, hko-9day, 2026-08-06). So the clamp that
  // covers glyphs covers icons: yellow survives only as WIDE SOLID FILLS
  // (bars, bands, fields); every stroke-drawn mark renders black.
  if (ink == Ink::Yellow) ink = Ink::Black;
  for (int row = 0; row < kIconBase; row++) {
    const uint8_t* r = bits + row * kIconStride;
    uint32_t packed = ((uint32_t)r[0] << 16) | ((uint32_t)r[1] << 8) | (uint32_t)r[2];
    for (int col = 0; col < kIconBase; col++)
      if (packed & (0x800000u >> col))
        cv.fillRect(x + col * scale, y + row * scale, scale, scale, ink);
  }
}

// Trims `s` to `maxW` only when it actually overruns — `ellipsize` appends the
// ellipsis unconditionally, which on a line that already fits is both a lie
// and an overflow.
std::string fitLine(FontProvider& font, std::string s, int px, bool bold, int maxW) {
  if (textWidth(font, s, px, bold) > maxW) ellipsize(font, s, px, bold, maxW);
  return s;
}

// ---- image (§9.10) ----

// The 6 fixed inks as the DEVICE holds them (spec §9.1) — the table an `image`
// widget's pixels are matched against, and the one place the toolchain must not
// track how an ink actually looks: dithering asks "which of the six is this
// photo pixel nearest", and the answer has to be the same on the panel, in the
// preview and in the browser or the same photo lands on different inks.
//
// tools/preview/main.cpp's display palette deliberately no longer agrees about
// yellow (§9.1a-a: the ink measures ~1.1:1 against this panel's white, so the
// preview paints it near-white to show what a household will actually see).
// That divergence is display-side only and must stay there — moving it into
// this table would change which ink a photograph is quantized to on real
// hardware, which is a different decision entirely.
struct PaletteEntry { Ink ink; int r, g, b; };
const PaletteEntry kPalette[6] = {
    {Ink::Black, 0x10, 0x10, 0x10}, {Ink::White, 0xFF, 0xFF, 0xFF},
    {Ink::Red, 0xC0, 0x1E, 0x28},   {Ink::Yellow, 0xE8, 0xC0, 0x00},
    {Ink::Green, 0x15, 0x70, 0x3B}, {Ink::Blue, 0x1D, 0x4F, 0x91},
};

int nearestInkIdx(const PaletteEntry* pal, int palN, double r, double g, double b) {
  int best = 0;
  double bestD = 1e30;
  for (int i = 0; i < palN; i++) {
    double dr = r - pal[i].r, dg = g - pal[i].g, db = b - pal[i].b;
    double d = dr * dr + dg * dg + db * db;
    if (d < bestD) { bestD = d; best = i; }
  }
  return best;
}

// The palette an `image` widget dithers against: all 6 inks on Spectra6, or
// just Black/White on Mono — so a mono profile gets real grayscale
// Floyd-Steinberg dithering to the two inks it actually has, rather than
// dithering to 6 and then collapsing 4 of them to Black afterward (which
// would throw away exactly the error-diffusion this function exists for).
struct Palette { const PaletteEntry* entries; int count; };
Palette paletteForProfile(const DeviceProfile& profile) {
  static const PaletteEntry kMonoPalette[2] = {kPalette[0], kPalette[1]};  // Black, White
  if (profile.palette == PanelPalette::Mono) return {kMonoPalette, 2};
  return {kPalette, 6};
}

// True iff `s` is *exactly* one `{{params.<name>}}` placeholder and nothing
// else — URL form (b), §5.1/§9.10: the whole string is a full https URL
// supplied by one param, so its substituted value must be used verbatim
// (never percent-encoded — that would mangle the scheme/host). Anything else
// is form (a): a literal-host URL with placeholders only in path/query,
// where each placeholder's value IS percent-encoded (§7.3.2), matching every
// `https` source's url substitution.
bool isFormBSrc(const std::string& s) {
  static const std::string kOpen = "{{params.";
  if (s.size() < kOpen.size() + 3) return false;  // "{{params." + at least "x}}"
  if (s.compare(0, kOpen.size(), kOpen) != 0) return false;
  if (s.compare(s.size() - 2, 2, "}}") != 0) return false;
  return s.find("{{", 2) == std::string::npos;  // exactly one placeholder, spanning the whole string
}

// Nearest-neighbor resample of `src` (sw x sh RGB) into a boxW x boxH RGB
// buffer per `fit` (§9.10: contain letterboxes centered, cover center-crops,
// stretch distorts). Letterbox bars (contain) are left white, matching the
// panel's white background.
std::vector<uint8_t> resampleToBox(const std::vector<uint8_t>& src, int sw, int sh, int boxW,
                                    int boxH, const char* fit) {
  std::vector<uint8_t> dst((size_t)boxW * boxH * 3, 0xFF);
  if (sw <= 0 || sh <= 0 || boxW <= 0 || boxH <= 0) return dst;

  auto blit = [&](int drawnW, int drawnH, int offX, int offY, int scaledW, int scaledH,
                  int cropX, int cropY) {
    for (int y = 0; y < drawnH; y++) {
      int scy = y + cropY;
      int sy = (int)((long long)scy * sh / scaledH);
      if (sy < 0) sy = 0; if (sy >= sh) sy = sh - 1;
      for (int x = 0; x < drawnW; x++) {
        int scx = x + cropX;
        int sx = (int)((long long)scx * sw / scaledW);
        if (sx < 0) sx = 0; if (sx >= sw) sx = sw - 1;
        size_t so = ((size_t)sy * sw + sx) * 3;
        size_t doo = ((size_t)(y + offY) * boxW + (x + offX)) * 3;
        dst[doo] = src[so]; dst[doo + 1] = src[so + 1]; dst[doo + 2] = src[so + 2];
      }
    }
  };

  if (strcmp(fit, "cover") == 0) {
    double scale = std::max((double)boxW / sw, (double)boxH / sh);
    int scaledW = std::max(1, (int)std::lround(sw * scale));
    int scaledH = std::max(1, (int)std::lround(sh * scale));
    int cropX = (scaledW - boxW) / 2, cropY = (scaledH - boxH) / 2;
    blit(boxW, boxH, 0, 0, scaledW, scaledH, cropX, cropY);
  } else if (strcmp(fit, "stretch") == 0) {
    blit(boxW, boxH, 0, 0, boxW, boxH, 0, 0);
  } else {  // "contain" (default) — aspect-fit, centered, letterboxed
    double scale = std::min((double)boxW / sw, (double)boxH / sh);
    int drawnW = std::min(boxW, std::max(1, (int)std::lround(sw * scale)));
    int drawnH = std::min(boxH, std::max(1, (int)std::lround(sh * scale)));
    int offX = (boxW - drawnW) / 2, offY = (boxH - drawnH) / 2;
    blit(drawnW, drawnH, offX, offY, drawnW, drawnH, 0, 0);
  }
  return dst;
}

// Serpentine Floyd-Steinberg error diffusion (dither == "floyd_steinberg") or
// plain nearest-ink (dither == "none") over an already-resampled boxW x boxH
// RGB buffer, drawing each resulting ink via Canvas::drawPixel at (x0,y0)+
// offset (§9.10).
void ditherAndDraw(Canvas& cv, int x0, int y0, int boxW, int boxH,
                    const std::vector<uint8_t>& rgb, bool floyd, const Palette& pal) {
  if (!floyd) {
    for (int y = 0; y < boxH; y++) {
      for (int x = 0; x < boxW; x++) {
        size_t o = ((size_t)y * boxW + x) * 3;
        int idx = nearestInkIdx(pal.entries, pal.count, rgb[o], rgb[o + 1], rgb[o + 2]);
        cv.drawPixel(x0 + x, y0 + y, pal.entries[idx].ink);
      }
    }
    return;
  }
  std::vector<double> buf(rgb.begin(), rgb.end());
  auto at = [&](int x, int y) -> double* { return &buf[((size_t)y * boxW + x) * 3]; };
  auto spread = [&](int x, int y, double er, double eg, double eb, double coef) {
    if (x < 0 || x >= boxW || y < 0 || y >= boxH) return;
    double* p = at(x, y);
    p[0] += er * coef; p[1] += eg * coef; p[2] += eb * coef;
  };
  for (int y = 0; y < boxH; y++) {
    bool ltr = (y % 2) == 0;  // serpentine: alternate scan direction each row
    int dir = ltr ? 1 : -1;
    for (int i = 0; i < boxW; i++) {
      int x = ltr ? i : (boxW - 1 - i);
      double* p = at(x, y);
      int idx = nearestInkIdx(pal.entries, pal.count, p[0], p[1], p[2]);
      cv.drawPixel(x0 + x, y0 + y, pal.entries[idx].ink);
      double er = p[0] - pal.entries[idx].r, eg = p[1] - pal.entries[idx].g,
             eb = p[2] - pal.entries[idx].b;
      spread(x + dir, y, er, eg, eb, 7.0 / 16);
      spread(x - dir, y + 1, er, eg, eb, 3.0 / 16);
      spread(x, y + 1, er, eg, eb, 5.0 / 16);
      spread(x + dir, y + 1, er, eg, eb, 1.0 / 16);
    }
  }
}

// §9.10 failure outcome. The spec's letter was "the image's box renders
// empty"; its intent is that the page never claim to have a picture it does
// not have. Drawn as literal nothing that intent inverts on photo-frame,
// whose ENTIRE body is one 800x404 image widget: an empty box there is an
// empty panel, and an empty panel on a device that holds its last image with
// the power off is indistinguishable from a dead one. So the box is drawn as
// what it is — an empty frame, with the reason inside it. Same information,
// and the panel still reads as a photo frame waiting for a photo.
//
// `info`, never `danger`: the panel's red ink means a weather warning or a
// flat battery, and a picture that did not load is neither.
void drawImagePlaceholder(Ctx& c, int x, int y, int w, int h) {
  if (w < 32 || h < 12) return;  // too small to say anything honest in
  const Ink info = inkForRole(InkRole::Info, c.profile);
  c.cv.fillRect(x, y, w, h, Ink::White);
  strokeRect(c.cv, x, y, w, h, info);
  strokeRect(c.cv, x + 1, y + 1, w - 2, h - 2, info);

  // 廣東話 first, English under it. Each line is dropped whole rather than
  // sliced when the frame is too short for it — §9.3(5)'s rule for type, for
  // the same reason: half a line of glyphs reads as breakage.
  const int zhPx = 24, zhLineH = 30, enPx = 16, enLineH = 20;
  int maxW = w - 16;
  bool zh = h >= zhLineH + 8;
  bool en = h >= zhLineH + enLineH + 12;
  int blockH = (zh ? zhLineH : 0) + (en ? enLineH + 2 : 0);
  if (blockH == 0) return;
  int top = y + (h - blockH) / 2;
  auto centered = [&](const std::string& text, int px, int lineH, Ink ink) {
    std::string line = fitLine(c.font, text, px, false, maxW);
    int tw = textWidth(c.font, line, px, false);
    drawTextRun(c.cv, c.font, x + (w - tw) / 2, top + c.font.ascent(px), line, px, ink, false,
                x + 8, x + w - 8);
    top += lineH;
  };
  if (zh) centered("相片載入唔到", zhPx, zhLineH + 2, Ink::Black);
  if (en) centered("Photo didn't load", enPx, enLineH, info);
}

// §9.10: fetch (render-time, via the Engine's stashed FetchFn) + PNG-decode
// (pluggable, Engine::setImageDecoder) + scale + dither an `image` widget
// into its declared width x height box. Any failure along the way draws the
// placeholder frame above and adds a render warning naming the cause.
void drawImage(Ctx& c, JsonVariantConst w, int x, int y, int width, int height) {
  auto fail = [&](const std::string& msg) {
    drawImagePlaceholder(c, x, y, width, height);
    addWarn(c.ev.warn, msg);
  };

  if (!c.fetch || !*c.fetch) { fail("image: no fetch function available at render (§9.10)"); return; }

  // §9.10/§12.3(3): src placeholders are limited to {{params.*}}/{{now}} —
  // a restricted context (data/item/each/strings/pack left unset) turns any
  // other reference into a hard grammar error rather than silently
  // resolving it.
  detail::EvalCtx imgCtx;
  imgCtx.params = c.ev.params;
  imgCtx.now = c.ev.now;
  imgCtx.warn = c.ev.warn;

  std::string tpl = w["src"] | "";
  bool formB = isFormBSrc(tpl);
  std::string url;
  if (!substitute(tpl, imgCtx, url, c.err, /*urlEncode=*/!formB)) return;
  if (url.compare(0, 8, "https://") != 0) {
    fail("image: src did not resolve to an https:// URL (§5.1)");
    return;
  }

  std::string body, ferr;
  if (!(*c.fetch)("image", url, body, ferr)) {
    fail(std::string("image fetch failed: ") + ferr + " (§9.10)");
    return;
  }
  if (body.size() > 204800) {
    fail("image: fetched body exceeds the 204800-byte cap (§9.10)");
    return;
  }
  static const unsigned char kPngSig[8] = {0x89, 0x50, 0x4E, 0x47, 0x0D, 0x0A, 0x1A, 0x0A};
  if (body.size() < 8 || memcmp(body.data(), kPngSig, 8) != 0) {
    fail("image: fetched body is not a PNG (§9.10, PNG only)");
    return;
  }
  if (!c.imageDecoder) {
    fail("image: no decoder in this build");
    return;
  }
  int sw = 0, sh = 0;
  std::vector<uint8_t> rgb;
  if (!c.imageDecoder->decode(body, sw, sh, rgb)) {
    fail("image: PNG decode failed (§9.10)");
    return;
  }
  if (sw <= 0 || sh <= 0 || sw > 800 || sh > 480) {
    fail("image: source pixels exceed the 800x480 cap (§9.10)");
    return;
  }

  const char* fit = w["fit"] | "contain";
  const char* dither = w["dither"] | "floyd_steinberg";
  std::vector<uint8_t> dst = resampleToBox(rgb, sw, sh, width, height, fit);
  // No amber scope here, and none needed: the weave is opt-in per stroke
  // (§9.1a-a), and a photograph is the surface case at its most extreme —
  // error diffusion has already surrounded each yellow pixel with whatever its
  // neighbours needed, which is why a dithered sunset reads correctly today.
  ditherAndDraw(c.cv, x, y, width, height, dst, strcmp(dither, "floyd_steinberg") == 0,
                paletteForProfile(c.profile));
}

// §9.8 row instantiation: draw up to max_rows rows, `item`/`index` bound.
// §9.11: value template -> payload (<=512 bytes post-substitution) -> qrcodegen
// at the declared ecc, always black-on-white. Runtime cap overflow or an encode
// failure falls back to the honest bordered placeholder box the engine has
// always drawn for this widget.
//
// MUST stay a separate, non-inlined frame: the two qrcodegen scratch buffers are
// qrcodegen_BUFFER_LEN_MAX (3918) bytes each, and drawWidget is the layout
// recursion. Inlined here they sat in *every* drawWidget frame — 8.3 KB per
// level, ~69 KB of stack to draw a page of plain text, against a 16 KB firmware
// loop-task stack. Measured with `c++ -O2 -fstack-usage`; if you fold this back
// into drawWidget, re-measure first.
YAT_NOINLINE void drawQr(Ctx& c, JsonVariantConst w, int x, int y) {
  int s = w["size"] | 120;
  auto placeholder = [&](const char* warnMsg) {
    strokeRect(c.cv, x, y, s, s, Ink::Black);
    strokeRect(c.cv, x + 4, y + 4, s - 8, s - 8, Ink::Black);
    addWarn(c.ev.warn, warnMsg);
  };
  std::string val;
  if (!substitute(w["value"] | "", c.ev, val, c.err)) return;
  if (val.size() > 512) {
    placeholder("qr payload exceeds 512 bytes post-substitution (§9.11 runtime cap); drawn as a placeholder box");
    return;
  }
  const char* eccStr = w["ecc"] | "M";
  enum qrcodegen_Ecc ecc = qrcodegen_Ecc_MEDIUM;
  if (strcmp(eccStr, "L") == 0) ecc = qrcodegen_Ecc_LOW;
  else if (strcmp(eccStr, "Q") == 0) ecc = qrcodegen_Ecc_QUARTILE;
  else if (strcmp(eccStr, "H") == 0) ecc = qrcodegen_Ecc_HIGH;
  uint8_t qr0[qrcodegen_BUFFER_LEN_MAX];
  uint8_t tempBuf[qrcodegen_BUFFER_LEN_MAX];
  bool ok = qrcodegen_encodeText(val.c_str(), tempBuf, qr0, ecc, qrcodegen_VERSION_MIN,
                                  qrcodegen_VERSION_MAX, qrcodegen_Mask_AUTO,
                                  /*boostEcl=*/false);
  if (!ok) {
    placeholder("qr encode failed; drawn as a placeholder box (§9.11)");
    return;
  }
  int modules = qrcodegen_getSize(qr0);
  const int quiet = 4;  // §9.11 quiet zone, in modules
  int total = modules + quiet * 2;
  int scale = s / total;
  if (scale < 1) scale = 1;  // never degenerate to an unscannable 0px module
  int px = total * scale;
  // Centered in the declared size box (drawContainer already centers the box
  // itself per the parent's `align`, §9.3(4)).
  int offX = x + (s - px) / 2;
  int offY = y + (s - px) / 2;
  c.cv.fillRect(x, y, s, s, Ink::White);  // always black-on-white (§9.11)
  for (int my = 0; my < modules; my++) {
    for (int mx = 0; mx < modules; mx++) {
      if (qrcodegen_getModule(qr0, mx, my)) {
        c.cv.fillRect(offX + (mx + quiet) * scale, offY + (my + quiet) * scale, scale, scale,
                      Ink::Black);
      }
    }
  }
}

void drawList(Ctx& c, JsonVariantConst w, int x, int y, int width, int height) {
  ListPlan lp;
  if (!listPlan(c, w, lp)) return;
  if (!lp.bindOk) {
    addWarn(c.ev.warn, std::string("E_BIND: list bind '") + (w["bind"] | "") + "' is not an array");
    // §A: the list's own failed slot gets one engine-owned line rather than
    // nothing — never a substitution into the pack's widgets, and never
    // `empty_text` (§9.8/§11.3).
    JsonDocument ed;
    makeBindFailText(ed);
    int h = measureMain(c, ed.as<JsonVariantConst>(), true, width);
    drawWidget(c, ed.as<JsonVariantConst>(), x, y, width, h, true);
    return;
  }
  JsonArrayConst a = lp.arr.as<JsonArrayConst>();
  if (a.size() == 0) {
    if (w["empty_text"].isNull()) return;
    JsonDocument ed;
    makeEmptyText(w, ed);
    int h = measureMain(c, ed.as<JsonVariantConst>(), true, width);
    drawWidget(c, ed.as<JsonVariantConst>(), x, y, width, h, true);
    return;
  }
  JsonDocument rowDoc;
  makeRowTemplate(w, rowDoc);
  JsonVariantConst rowW = rowDoc.as<JsonVariantConst>();
  RowScope scope(c);
  ClipScope clip(c.cv, x, y, width, height);  // §9.3(5)
  int cur = y, n = 0;
  for (JsonVariantConst el : a) {
    if (n >= lp.maxRows) break;
    scope.bind(el, ++n);
    int rh = measureMain(c, rowW, true, width);
    if (!c.err.empty()) return;
    // A whole row that would not fit is dropped rather than sliced in half —
    // a half-height row of text reads as breakage, a missing row reads as a
    // list that ended. The clip above is the backstop for everything else
    // (§9.3(5)); this is the nicer-looking case of the same rule.
    if (cur + rh > y + height) break;
    drawWidget(c, rowW, x, cur, width, rh, true);
    if (!c.err.empty()) return;
    cur += rh + lp.gap;
  }
}

// §9.12/§9.12a scale bound: a literal number, or the params-only template form.
// `okOut` false = absent or not numeric — the caller decides whether that is an
// E_TYPE (`bar`, where bounds are required) or a fallback to auto-scale (`chart`).
double scaleBound(Ctx& c, JsonVariantConst w, const char* key, double dflt, bool& okOut) {
  JsonVariantConst b = w[key];
  okOut = true;
  if (b.is<double>() || b.is<long>() || b.is<int>() || b.is<float>()) return b.as<double>();
  if (b.is<const char*>()) {  // params-only template form
    std::string t2, e2;
    if (!substitute(b.as<const char*>(), c.ev, t2, e2)) { okOut = false; return dflt; }
    char* end = nullptr;
    double d = strtod(t2.c_str(), &end);
    if (end == t2.c_str() || *end != '\0') { okOut = false; return dflt; }
    return d;
  }
  okOut = false;
  return dflt;
}

// A JSON scalar as a number, accepting the numeric *strings* that string-typed
// feeds (HKO, CSV) deliver — the same coercion §6.5's ordering comparators do.
bool numericValue(JsonVariantConst v, double& out) {
  if (v.is<double>() || v.is<long>() || v.is<int>() || v.is<float>()) { out = v.as<double>(); return true; }
  if (v.is<const char*>()) {
    const char* s = v.as<const char*>();
    if (!s || !*s) return false;
    char* end = nullptr;
    double d = strtod(s, &end);
    if (end == s || *end != '\0') return false;
    out = d;
    return true;
  }
  return false;
}

// §9.12a `chart`, line mode: a polyline over a bound numeric array. One sample
// per element, evenly spaced across the full width; elements that are not
// numbers (a null hour in a forecast feed) are gaps the line breaks across
// rather than zeros it dives to, because a missing reading is not a reading of 0.
constexpr int kChartMaxPoints = 64;

// Bresenham, thickened downward by one pixel: at 800x480 on e-paper a hairline
// is legible up close and gone from across a room, and the panel has no
// antialiasing to lean on. Thickening down (never up) keeps the top edge of the
// stroke exactly on the computed sample row.
void drawPolySegment(Canvas& cv, int x0, int y0, int x1, int y1, Ink ink) {
  int dx = x1 - x0 >= 0 ? x1 - x0 : x0 - x1, sx = x0 < x1 ? 1 : -1;
  int dy = y1 - y0 >= 0 ? y0 - y1 : y1 - y0, sy = y0 < y1 ? 1 : -1;
  int errv = dx + dy;
  while (true) {
    cv.fillRect(x0, y0, 1, 2, ink);
    if (x0 == x1 && y0 == y1) break;
    int e2 = 2 * errv;
    if (e2 >= dy) { errv += dy; x0 += sx; }
    if (e2 <= dx) { errv += dx; y0 += sy; }
  }
}

// §9.12a `show_bounds`: a whole-number bound prints bare ("36"), anything else
// keeps one decimal — the pinned bounds packs actually use (temp-trend's 8/36)
// read as plain numbers, not "8.0".
std::string formatChartBound(double v) {
  char buf[32];
  double r = std::round(v);
  if (std::fabs(v - r) < 0.005) snprintf(buf, sizeof(buf), "%d", (int)r);
  else snprintf(buf, sizeof(buf), "%.1f", v);
  return buf;
}

void drawChart(Ctx& c, JsonVariantConst w, int x, int y, int width, int height) {
  const char* mode = w["mode"] | "line";
  if (strcmp(mode, "line") != 0) {
    addWarn(c.ev.warn, std::string("chart: unknown mode '") + mode + "', drawn as 'line'");
  }
  JsonVariantConst bound;
  if (!resolveBind(c, w["bind"] | "", "chart", bound)) return;
  if (!bound.is<JsonArrayConst>()) {
    addWarn(c.ev.warn, std::string("E_BIND: chart bind '") + (w["bind"] | "") + "' is not an array");
    return;  // renders nothing, exactly as a list does (§9.8/§11.3)
  }
  JsonArrayConst a = bound.as<JsonArrayConst>();

  std::vector<double> vals;
  std::vector<bool> ok;
  for (JsonVariantConst el : a) {
    if ((int)vals.size() >= kChartMaxPoints) {
      addWarn(c.ev.warn, "chart: series longer than 64 points, tail not drawn");
      break;
    }
    double d = 0;
    bool good = numericValue(el, d);
    vals.push_back(d);
    ok.push_back(good);
  }
  int numeric = 0;
  for (size_t i = 0; i < ok.size(); i++)
    if (ok[i]) numeric++;
  if (numeric == 0) {
    addWarn(c.ev.warn, "E_TYPE: chart series has no numeric values");
    return;  // empty box, same posture as an empty bar track (§9.12)
  }

  // Scale: explicit min/max pin it; otherwise the series' own range, padded by
  // 10% of the span so the line never runs along the box edge. Auto-scale fills
  // the box whatever the span is — see §9.12a on when to pin the bounds instead.
  bool okMin = false, okMax = false;
  double lo = scaleBound(c, w, "min", 0, okMin), hi = scaleBound(c, w, "max", 0, okMax);
  if (!okMin || !okMax || hi <= lo) {
    if ((okMin || okMax) && hi <= lo)
      addWarn(c.ev.warn, "E_TYPE: chart max <= min, auto-scaled instead");
    lo = hi = 0;
    bool first = true;
    for (size_t i = 0; i < vals.size(); i++) {
      if (!ok[i]) continue;
      if (first) { lo = hi = vals[i]; first = false; continue; }
      if (vals[i] < lo) lo = vals[i];
      if (vals[i] > hi) hi = vals[i];
    }
    double span = hi - lo;
    if (span <= 0) { lo -= 0.5; hi += 0.5; }  // flat series sits mid-box
    else { lo -= span * 0.1; hi += span * 0.1; }
  }

  Ink ink = widgetInk(c, w);
  bool dots = w["dots"] | false;
  int n = (int)vals.size();
  int usableH = height - 2 > 0 ? height - 2 : 1;  // room for the 2px stroke
  auto px = [&](int i) { return n > 1 ? x + (int)((long)i * (width - 1) / (n - 1)) : x + width / 2; };
  auto py = [&](int i) {
    double frac = (hi - vals[i]) / (hi - lo);
    if (frac < 0) frac = 0;
    if (frac > 1) frac = 1;
    return y + (int)(frac * usableH + 0.5);
  };
  // §9.1a-a stroke class, same as a `divider`: a 2px chart line has nowhere to
  // put a field, so yellow in it is woven rather than left invisible. Scoped
  // over the whole series (markers included) so one line is one colour.
  AmberStrokeScope stroke(c.amber);
  for (int i = 0; i + 1 < n; i++) {
    if (!ok[i] || !ok[i + 1]) continue;  // gap: no segment spans a missing sample
    drawPolySegment(c.cv, px(i), py(i), px(i + 1), py(i + 1), ink);
  }
  // A reading whose neighbours are both missing has no segment to appear in.
  // Mark it anyway — a value the engine was given must never render as nothing.
  for (int i = 0; i < n; i++) {
    if (!ok[i]) continue;
    if ((i > 0 && ok[i - 1]) || (i + 1 < n && ok[i + 1])) continue;
    c.cv.fillRect(px(i) < x + width - 2 ? px(i) : x + width - 2, py(i), 2, 2, ink);
  }
  if (dots) {
    for (int i = 0; i < n; i++) {
      if (!ok[i]) continue;
      // 5x5 marker, clamped into the box so an end sample (or one sitting on a
      // pinned bound) shows a whole marker rather than a clipped half of one.
      int mx = px(i) - 2, my = py(i) - 2;
      if (mx < x) mx = x;
      if (mx + 5 > x + width) mx = x + width - 5;
      if (my < y) my = y;
      if (my + 5 > y + height) my = y + height - 5;
      c.cv.fillRect(mx, my, 5, 5, ink);
    }
  }

  // §9.12a `show_bounds` (default off — opt in per PACK-SPEC): the resolved
  // hi/lo (pinned or, absent that, auto-scaled) printed small and muted at the
  // box's top-left/bottom-left corners, so a pinned scale reads as a labelled
  // band instead of an unexplained flat line. Drawn last so the labels sit on
  // top of the line/dots rather than under them.
  if (w["show_bounds"] | false) {
    Ink boundInk = Ink::Black;
    inkFromName("muted", boundInk, c.profile);
    SizeSpec sz = textSize("small");
    std::string hiStr = formatChartBound(hi), loStr = formatChartBound(lo);
    drawTextRun(c.cv, c.font, x, y + c.font.ascent(sz.px), hiStr, sz.px, boundInk, false, x, x + width);
    drawTextRun(c.cv, c.font, x, y + height - sz.lineH + c.font.ascent(sz.px), loStr, sz.px, boundInk,
                false, x, x + width);
  }
}

void drawWidget(Ctx& c, JsonVariantConst w, int x, int y, int width, int height, bool inColumn) {
  const char* t = w["type"] | "";
  if (strcmp(t, "column") == 0) { drawContainer(c, w, x, y, width, height, true); return; }
  if (strcmp(t, "row") == 0) { drawContainer(c, w, x, y, width, height, false); return; }
  if (strcmp(t, "spacer") == 0) return;
  if (strcmp(t, "chart") == 0) { drawChart(c, w, x, y, width, height); return; }  // §9.12a
  if (strcmp(t, "bar") == 0) {  // §9.12
    auto bound = [&](const char* key, double dflt, bool& okOut) -> double {
      return scaleBound(c, w, key, dflt, okOut);
    };
    int barH = w["height"] | 12;
    RolePaint fill = widgetPaint(c, w);
    std::string vs;
    if (!substitute(w["value"] | "", c.ev, vs, c.err)) return;
    char* end = nullptr;
    double val = strtod(vs.c_str(), &end);
    bool okMin, okMax, okVal = (end != vs.c_str() && *end == '\0');
    double mn = bound("min", 0, okMin), mx = bound("max", 1, okMax);
    // track: 1px black border, white interior (§9.12)
    c.cv.fillRect(x, y, width, barH, Ink::Black);
    c.cv.fillRect(x + 1, y + 1, width - 2, barH - 2, Ink::White);
    if (!okVal || !okMin || !okMax || mx <= mn) {
      addWarn(c.ev.warn, "E_TYPE: bar value/min/max not numeric (or max <= min)");
      return;  // empty track per §9.12
    }
    double frac = (val - mn) / (mx - mn);
    if (frac < 0) frac = 0;
    if (frac > 1) frac = 1;
    int fw = (int)((width - 2) * frac + 0.5);
    if (fw > 0) {
      // §9.1a-a surface class: a bar's fill is an AREA, and the hardware trial
      // found yellow perfectly serviceable as one ("isn't too bad" at a full
      // field). So a role with a field fills in the field — pure yellow, what
      // the pack asked for — and caps the fill's leading edge in the mark. The
      // cap is not decoration: the value IS the position of that edge, and a
      // 2px black tick pins it against the white track beyond. Roles without a
      // field fill in their mark, as every bar has since §9.12.
      if (fill.field != Ink::White) {
        c.cv.fillRect(x + 1, y + 1, fw, barH - 2, fill.field);
        int capW = std::min(2, fw);
        c.cv.fillRect(x + 1 + fw - capW, y + 1, capW, barH - 2, fill.mark);
      } else {
        c.cv.fillRect(x + 1, y + 1, fw, barH - 2, fill.mark);
      }
    }
    return;
  }
  if (strcmp(t, "divider") == 0) {
    int th = w["thickness"] | 1;
    Ink ink = widgetInk(c, w);
    // §9.1a-a stroke class: a rule is a few pixels of ink with no field to put
    // behind it — the one shape where the highlighter has nothing to work with.
    // Woven, so a yellow divider is a visible line rather than a missing one.
    AmberStrokeScope stroke(c.amber);
    if (inColumn) c.cv.fillRect(x, y, width, th, ink);
    else c.cv.fillRect(x, y, th, height, ink);
    return;
  }
  if (strcmp(t, "list") == 0) { drawList(c, w, x, y, width, height); return; }
  if (strcmp(t, "image") == 0) { drawImage(c, w, x, y, width, height); return; }
  if (strcmp(t, "icon") == 0) {
    // §9.9: one 24x24 1-bit bitmap per catalog name (engine/src/icons.cpp,
    // authored by tools/icons/gen_icons.py), blitted at integer scale x1/x2/x4
    // for small/medium/large — same loop shape as drawGlyph, in the widget ink.
    int s = iconPx(w["size"] | "medium");
    const char* nm = w["name"] | "";
    Ink ink = widgetInk(c, w);
    const uint8_t* bits = nullptr;
    if (!iconBitmap(nm, bits)) {
      // Unreachable for a schema-valid pack (the catalog is a closed enum);
      // an unknown name keeps the honest bordered box rather than nothing.
      strokeRect(c.cv, x, y, s, s, ink);
      addWarn(c.ev.warn,
              std::string("icon '") + nm + "' is not in the §9.9 catalog; drawn as a placeholder box");
      return;
    }
    blitIcon(c.cv, bits, x, y, s / kIconBase, ink);
    return;
  }
  if (strcmp(t, "qr") == 0) { drawQr(c, w, x, y); return; }
  if (strcmp(t, "text") == 0) {
    SizeSpec sz = textSize(w["size"] | "medium");
    std::string s;
    if (!substitute(w["value"] | "", c.ev, s, c.err)) return;
    bool bold = strcmp(w["weight"] | "regular", "bold") == 0;
    Ink ink = widgetInk(c, w);
    const char* al = w["align"] | "left";
    int maxLines = w["max_lines"] | 1;
    auto lines = wrapText(c.font, s, sz.px, bold, width, maxLines);
    int lineTop = y;
    for (auto& line : lines) {
      // §9.3(5): type is never sliced. A line whose box runs past the clip is
      // dropped whole — the same call `list` makes for a row that will not fit,
      // for the same reason: a line of glyphs cut through the middle reads as a
      // broken panel, a missing line reads as text that ended.
      if (lineTop + sz.lineH > c.cv.y1) break;
      int lx = x;
      int lw = textWidth(c.font, line, sz.px, bold);
      if (strcmp(al, "center") == 0) lx = x + (width - lw) / 2;
      else if (strcmp(al, "right") == 0) lx = x + width - lw;
      drawTextRun(c.cv, c.font, lx, lineTop + c.font.ascent(sz.px), line, sz.px, ink, bold, x,
                  x + width);
      lineTop += sz.lineH;
    }
    return;
  }
  if (strcmp(t, "bignum") == 0) {
    SizeSpec sz = bignumSize(w["size"] | "large");
    std::string s;
    if (!substitute(w["value"] | "", c.ev, s, c.err)) return;
    Ink ink = widgetInk(c, w);
    const char* al = w["align"] | "left";
    int lw = textWidth(c.font, s, sz.px, false);
    int lx = x;
    if (strcmp(al, "center") == 0) lx = x + (width - lw) / 2;
    else if (strcmp(al, "right") == 0) lx = x + width - lw;
    drawTextRun(c.cv, c.font, lx, y + c.font.ascent(sz.px), s, sz.px, ink, false, x, x + width);
    return;
  }
  c.err = std::string("engine v0.2: widget '") + t + "' not implemented";
}

// G25/§11.4: standard-chrome footer battery glyph. Blits the §9.9 catalog's
// "battery" bitmap at native x1 scale (24px), then repaints its interior
// "body" cavity with a fill bar sized to pct/100 in `ink`.
//
// The cavity bounds below were read directly off the 24x24 bitmap in
// icons.cpp (not computed): rows 8..15 are the flat sides of the case, clear
// of the top/bottom rounded-cap curves (rows 5,6,17,18) and clear of the
// right wall (present only on rows 7 and 16, at column 17); columns 3..16
// sit inside the case's left cap (columns 1-2 are left solid, unchanged, as
// a 2px end-wall) and stop short of the right wall/terminal nub (columns
// 17-22). Filling that box left-to-right reads as a charge level; at pct=0
// it's all-white (an empty case), at pct=100 it matches the bitmap's own
// default look (solid).
constexpr int kBatteryBodyX = 3, kBatteryBodyY = 8, kBatteryBodyW = 14, kBatteryBodyH = 8;

// The case is always drawn in the mark; only the charge bar inside it takes the
// role's field when it has one (§9.1a-a). The bar is a surface — a solid block
// inside a bounded cavity — which is the class of yellow the hardware trial
// cleared, so the `warn` band (21-50%) is a black case with a genuinely yellow
// charge level, and reads as a battery at a glance and as "getting low" on a
// second one.
void drawBatteryGlyph(Canvas& cv, int x, int y, RolePaint paint, int pct) {
  const uint8_t* bits = nullptr;
  if (!iconBitmap("battery", bits)) return;  // unreachable: "battery" is always in the §9.9 catalog
  blitIcon(cv, bits, x, y, 1, paint.mark);
  int clamped = std::clamp(pct, 0, 100);
  cv.fillRect(x + kBatteryBodyX, y + kBatteryBodyY, kBatteryBodyW, kBatteryBodyH, Ink::White);
  int fillW = (kBatteryBodyW * clamped + 50) / 100;
  if (fillW > 0)
    cv.fillRect(x + kBatteryBodyX, y + kBatteryBodyY, fillW, kBatteryBodyH,
                paint.field != Ink::White ? paint.field : paint.mark);
}

// §11.4 footer voice hint, words half: up to `max` of the page's own wake
// words out of the pack's §2 `aliases`, reading the user's own language
// first. `jyutping` is deliberately never shown — it exists so the matcher
// can hear a romanized transcript, and printing "tin1 hei3" on the panel
// would be telling a Cantonese speaker to say something nobody says.
void collectAliasWords(JsonVariantConst aliases, const char* lang, size_t max,
                       std::vector<std::string>& out) {
  if (!aliases.is<JsonObjectConst>()) return;
  const char* order[2] = {"zh-Hant", "en"};
  if (lang && strcmp(lang, "en") == 0) { order[0] = "en"; order[1] = "zh-Hant"; }
  for (const char* key : order) {
    JsonVariantConst arr = aliases[key];
    if (!arr.is<JsonArrayConst>()) continue;
    for (JsonVariantConst a : arr.as<JsonArrayConst>()) {
      if (out.size() >= max) return;
      const char* s = a | "";
      if (s[0] == '\0') continue;
      bool dup = false;
      for (const std::string& have : out)
        if (have == s) { dup = true; break; }
      if (!dup) out.emplace_back(s);
    }
  }
}

// §11.4 footer voice hint, drawing half. The one thing a household has to
// KNOW to use the microphone is which words this page answers to, so the page
// prints its own: a green dot standing in for the green button (drawn in real
// ink, so it reads as the physical button rather than as punctuation) followed
// by the words in 「」. The ink comes from `good` — the role whose whole job
// on this panel is the green the button is painted in.
// ---- §11.4a device notices ----------------------------------------------
//
// Three surfaces, graded by what they ask of the reader rather than by how
// alarming the fault sounds from the inside (see engine.h's NoticeLevel):
//
//   Info      a 15x12 warning triangle in the footer, beside the stale badge.
//             No words. It says "one field of this page came out wrong", which
//             is a thing to notice and not a thing to do.
//   Degraded  a 24px line above the footer: the same triangle, then one
//             bilingual sentence. Quiet — a rule, black type, no field.
//   Action    a 34px banner at the top of the content band: black type on a
//             yellow field, ruled top and bottom, naming where the fix lives.
//
// They nest on purpose. The glyph a household learns in the footer is the same
// glyph that turns up with a sentence attached, and then on a field — one
// vocabulary getting louder, not three unrelated alarms. None of them is red:
// §9.1a reserves that for a weather warning in force and a battery about to
// die, and a rejected API key is neither.
//
// The one thing the panel must never do is shout. The banner is 34 px of 404
// and the strip 24 — together under 15% of the content band, and each appears
// only while its condition actually holds.

// The classic sign, small enough to sit in a 32px footer — and, since §9.1a-a
// grew to cover fields, a SOLID black triangle rather than an outlined one.
// The bang is knocked out of that black rather than drawn on top of it, so the
// field ink only ever appears surrounded by mark: yellow's 1.1:1 problem is
// specifically against white, and the same ink against black is high-contrast
// and perfectly legible. Worst case — a panel whose yellow is indistinguishable
// from paper — the knock-out reads as a white bang, which is the same shape.
// Nothing here depends on the field being visible, and the outline version did:
// at 15x12 a 1px stroke around a washed-out interior is a glyph that isn't
// there.
void drawWarnTriangle(Canvas& cv, int x, int y, int w, int h, Ink mark, Ink field) {
  const int cx = x + w / 2;
  for (int r = 0; r < h; r++) {
    int half = (r + 1) * w / (2 * h);
    cv.fillRect(cx - half, y + r, 2 * half + 1, 1, mark);
  }
  cv.fillRect(cx - w / 2, y + h - 1, w, 1, mark);  // base, squared off
  // Bang and dot, knocked out. 2px wide wherever the triangle is wide enough to
  // spare it — a 1px knock-out inside a solid glyph is a glyph with no bang,
  // which is a triangle and not a warning sign.
  const int bw = w >= 13 ? 2 : 1;
  const int top = h / 3, bangH = h - top - 4;
  cv.fillRect(cx - bw / 2, y + top, bw, bangH > 0 ? bangH : 1, field);
  cv.fillRect(cx - bw / 2, y + h - 3, bw, 1, field);
}

constexpr int kWarnTriW = 15, kWarnTriH = 12;
// The banner's copy of the glyph, sized to the room a 34px band actually has:
// the footer's 15x12 is a compromise with a 32px chrome band it shares with
// type, and reproducing that compromise inside the loudest surface the panel
// has would be copying the constraint instead of the design.
constexpr int kBannerTriW = 20, kBannerTriH = 16;
constexpr int kActionBannerH = 34;
// Thick enough to read as a banner edge rather than as a hairline: the whole
// failure this rule exists for was a 1px rule being the only black structure
// holding an invisible yellow field together.
constexpr int kActionRuleH = 3;
constexpr int kDegradedStripH = 24;

// One bilingual line per condition, engine-owned (engine.h): a host names the
// condition and never the words, so the device, the preview and the WASM
// gallery all say the same thing in the same voice.
//
// Every Action line names the *gesture*, not the fault: a household that has
// just been told "the voice router returned 401" knows nothing it can act on,
// and 撳住綠色掣 is the one move that leads somewhere (it opens the settings
// page — the same instruction the provisioning screens give).
struct NoticeCopy { const char* zh; const char* en; };

NoticeCopy noticeCopyFor(NoticeCode code) {
  switch (code) {
    case NoticeCode::VoiceKeyRejected:
      return {"聲控暫時用唔到，撳住綠色掣開設定頁", "Voice needs attention — hold the green button"};
    case NoticeCode::StorageFailed:
      return {"機身儲存有問題，撳住綠色掣開設定頁", "Storage needs attention — hold the green button"};
    case NoticeCode::ConfigUnreadable:
      return {"讀唔到設定，撳住綠色掣開設定頁", "Settings couldn't be read — hold the green button"};
    case NoticeCode::None:
      break;
  }
  return {"", ""};
}

// 廣東話 first, always both — the page is read by whoever walks past it, not
// only by whoever configured it. `lang` only decides which half leads, exactly
// as it does on the no-data card.
std::string noticeLine(NoticeCopy copy, const char* lang) {
  if (!copy.zh[0]) return "";
  bool en = lang && strcmp(lang, "en") == 0;
  std::string a = en ? copy.en : copy.zh, b = en ? copy.zh : copy.en;
  return a + "  ·  " + b;
}

// The other half of the hazard-sign grammar: 45° bars, in the mark, at the
// banner's two ends. They sit OUTSIDE the text box on purpose — §9.1a-a's
// first rule is that type never lands on a texture, so the field directly
// behind the words stays flat and the stripes do their work in the margins,
// which is where a real hazard band puts them anyway.
constexpr int kHazardBlockW = 28;
void drawHazardStripes(Canvas& cv, int x, int y, int w, int h, Ink ink) {
  const int period = 10, bar = 5;  // 5 on, 5 off, measured along the diagonal
  for (int r = 0; r < h; r++)
    for (int i = 0; i < w; i++)
      if (((i + r) % period) < bar) cv.fillRect(x + i, y + r, 1, 1, ink);
}

// Action: the loudest thing standard chrome can say, and still a single line.
// Drawn under `"chrome": "none"` too — a household whose only page is a photo
// frame is exactly the one that would otherwise never learn its voice control
// stopped working, and 34 px off the top of a photo is a cheaper way to find
// out than a month of the button doing nothing.
//
// Every part of it that carries the signal is black: two 3px rules, a solid
// triangle, hazard bars at both ends. The yellow field is decoration laid
// between them — on the panel it is very nearly paper, and the banner has to
// read as a banner anyway. `--profile e1001` renders exactly that page (mono
// clamps the field to white), which is why the suite pins it as a golden.
void drawActionBanner(Canvas& cv, FontProvider& font, int x, int y, int w, NoticeCode code,
                      const char* lang, const DeviceProfile& profile) {
  const RolePaint warn = paintForRole(InkRole::Warn, profile);
  if (warn.field != Ink::White) cv.fillRect(x, y, w, kActionBannerH, warn.field);
  cv.fillRect(x, y, w, kActionRuleH, warn.mark);
  cv.fillRect(x, y + kActionBannerH - kActionRuleH, w, kActionRuleH, warn.mark);
  const int inner = y + kActionRuleH, innerH = kActionBannerH - 2 * kActionRuleH;
  drawHazardStripes(cv, x, inner, kHazardBlockW, innerH, warn.mark);
  drawHazardStripes(cv, x + w - kHazardBlockW, inner, kHazardBlockW, innerH, warn.mark);
  int tx = x + kHazardBlockW + 12;
  drawWarnTriangle(cv, tx, y + (kActionBannerH - kBannerTriH) / 2, kBannerTriW, kBannerTriH,
                   warn.mark, warn.field);
  tx += kBannerTriW + 10;
  const int right = x + w - kHazardBlockW - 12;
  const int px = 16;
  std::string line = fitLine(font, noticeLine(noticeCopyFor(code), lang), px, true, right - tx);
  drawTextRun(cv, font, tx, y + (kActionBannerH - 20) / 2 + font.ascent(px), line, px, warn.mark,
              true, tx, right);
}

// Degraded: the same triangle and one sentence, on nothing. It explains the
// footer's stale badge rather than repeating it — the badge says *when*, this
// says *what that means for what you're looking at* — which is why it is worth
// 24 px only once the data is genuinely old (Engine::staleDegraded).
void drawDegradedStrip(Canvas& cv, FontProvider& font, int x, int y, int w, const char* lang,
                       const DeviceProfile& profile) {
  const RolePaint warn = paintForRole(InkRole::Warn, profile);
  cv.fillRect(x, y, w, 1, warn.mark);
  int tx = x + 16;
  drawWarnTriangle(cv, tx, y + (kDegradedStripH - kWarnTriH) / 2 + 1, kWarnTriW, kWarnTriH,
                   warn.mark, warn.field);
  tx += kWarnTriW + 10;
  const int px = 16;
  NoticeCopy copy{"攞唔到新資料，顯示緊舊嘅", "Showing older data"};
  std::string line = fitLine(font, noticeLine(copy, lang), px, false, x + w - 16 - tx);
  drawTextRun(cv, font, tx, y + (kDegradedStripH - 20) / 2 + 1 + font.ascent(px), line, px,
              warn.mark, false, tx, x + w - 16);
}

// §11.4's data-warning trigger set, and only it: E_TYPE, E_BIND, E_ITER. The
// other things that land in the warning sink are deliberately not glyphed —
// a stale source has its own badge, the empty-state card is the whole page,
// and E_EXTRACT_MISS is fresh truth with a field absent (§11.3).
//
// Read back off the accumulated warning text rather than threaded through as a
// flag, because that text is the engine's own and is written in exactly three
// places; a flag would have to be carried through EvalCtx, every widget draw
// and the whole extraction path to say the same thing.
bool hasDataWarning(const std::string& warn) {
  return warn.find("E_TYPE") != std::string::npos || warn.find("E_BIND") != std::string::npos ||
         warn.find("E_ITER") != std::string::npos;
}

// §11.3, "the engine never renders a blank page": what the content band gets
// when every source failed and not one had a snapshot to fall back on
// (Engine::allSourcesEmpty()). Drawing the pack's widgets in that state
// produces a page-shaped ghost — every placeholder an empty string, every
// `when` guard hidden, a header and a footer around 404 px of nothing — which
// on a device that holds its last image with the power off is exactly what a
// dead device looks like.
//
// Calm on purpose. `info` border and `info` secondary type, no `danger`
// anywhere (§9.1a — the roles are the engine's own spelling too): an
// upstream source being down is not an emergency and is not the household's
// to repair, and red on this panel is reserved for weather warnings and a
// flat battery. The copy commits to that too — it says the device retries by
// itself, and asks nobody to do anything. (The firmware draws a full-screen
// sibling of this card, drawNoDataCard() in firmware/src/main.cpp, when it
// can tell the whole device is offline; same voice, bigger scope. This one is
// per-page and is the floor for every host that just calls render().)
//
// Flat by construction: no widget tree, no layout recursion, no JsonDocument.
// It is drawn straight onto the clip proxy inside a ClipScope for the content
// band, so it can no more reach the chrome bands than a widget can, and it
// adds nothing to the layout recursion's stack (see drawQr's note — the
// firmware's loop task has 16 KB).
void drawEmptyCard(ClipCanvas& cv, FontProvider& font, JsonVariantConst pack, const char* lang,
                   int bx, int by, int bw, int bh, const DeviceProfile& profile) {
  ClipScope clip(cv, bx, by, bw, bh);
  const int kCardW = 560, kCardH = 216;
  int cardW = std::min(kCardW, bw - 32), cardH = std::min(kCardH, bh - 16);
  if (cardW < 160 || cardH < 72) return;  // no room for a card that says anything
  int x = bx + (bw - cardW) / 2, y = by + (bh - cardH) / 2;

  const Ink info = inkForRole(InkRole::Info, profile);
  cv.fillRect(x, y, cardW, cardH, Ink::White);
  strokeRect(cv, x, y, cardW, cardH, info);
  strokeRect(cv, x + 1, y + 1, cardW - 2, cardH - 2, info);

  int cy = y + 24;
  const int bottom = y + cardH - 8;
  // The catalog's "cloud" — the same glyph the firmware's no-data card uses,
  // for the same reason: it reads as "the far end", not as "your fault".
  const uint8_t* bits = nullptr;
  if (cy + 48 <= bottom && iconBitmap("cloud", bits)) {
    blitIcon(cv, bits, x + (cardW - 48) / 2, cy, 2, info);
    cy += 48 + 16;
  }
  auto line = [&](const std::string& text, int px, int lineH, bool bold, Ink ink, int advance) {
    if (text.empty() || cy + lineH > bottom) return;
    std::string s = fitLine(font, text, px, bold, cardW - 32);
    int tw = textWidth(font, s, px, bold);
    drawTextRun(cv, font, x + (cardW - tw) / 2, cy + font.ascent(px), s, px, ink, bold, x + 16,
                x + cardW - 16);
    cy += advance;
  };

  // The page's own display name, even under standard chrome (which prints it
  // too): a household with several pages needs to know WHICH page lost its
  // data rather than read the card as "the device is broken" — and with
  // "chrome": "none" this is the only place it appears at all.
  const char* nameEn = pack["name"]["en"] | "";
  const char* nameZh = pack["name"]["zh-Hant"] | "";
  std::string title = nameZh;
  if (nameEn[0] && title != nameEn) {
    if (!title.empty()) title += "  ";
    title += nameEn;
  }
  line(title, 24, 30, true, Ink::Black, 36);
  line("暫時攞唔到資料", 24, 30, false, Ink::Black, 32);
  line("Can't reach this page's data right now", 16, 20, false, info, 28);
  // The one reassurance that is actually true and actually actionable-by-
  // nobody: it comes back on its own. `lang` picks which half leads for a
  // user who set the page to English; both always show — the card is read by
  // whoever walks past it, not only by whoever configured it.
  bool en = lang && strcmp(lang, "en") == 0;
  line(en ? "It retries by itself · 部機會自動再試" : "部機會自動再試 · It retries by itself", 16,
       20, false, info, 20);
}

}  // namespace

bool Engine::render(Canvas& target, FontProvider& font, time_t now, std::string& err,
                    const DeviceProfile& profile) {
  std::string warn;
  // EVERY paint below goes through the §9.1a-a amber weave — the local name
  // `canvas` is this proxy and not the caller's target, deliberately, so that
  // chrome, widgets and any future draw site are woven by construction rather
  // than by each remembering to ask. The real target is `target`, touched
  // nowhere else.
  AmberCanvas canvas(target, profile);
  // The widget tree draws through the §9.3(5) clip proxy; the chrome below
  // draws on `canvas` itself, so it owns its bands outright.
  ClipCanvas clipped(canvas);
  Ctx c{clipped, font, detail::EvalCtx(), ""};
  c.amber = &canvas;
  c.ev.params = params();
  c.ev.data = data();
  c.ev.pack = pack();
  c.ev.strings = pack_["strings"];  // §7.2: strings resolve in render strings only
  c.ev.lang = detail::langValue(pack(), params());
  c.ev.now = now;
  c.ev.warn = &warn;
  c.fetch = &fetch_;              // §9.10: image widgets reuse fetchAndExtract's FetchFn
  c.imageDecoder = imageDecoder_;  // §9.10: Engine::setImageDecoder(), may be null
  c.profile = profile;             // ROADMAP device capability profile (default kProfileE1002)
  int W = canvas.width(), H = canvas.height();
  canvas.fillRect(0, 0, W, H, Ink::White);

  // §11.3/§11.4: any source stale-serving this render gets a footer glyph
  // (standard chrome only); with `"chrome": "none"` the state is still
  // logged as a render warning (device-log-only glyph, per §11.4).
  if (anyStale_) {
    struct tm stTm = detail::hkLocal(oldestStale_);
    struct tm* st = &stTm;
    char buf[48];
    snprintf(buf, sizeof(buf), "stale since %02d:%02d", st->tm_hour, st->tm_min);
    detail::addWarn(&warn, buf);
  }

  int top = 0, bottom = H;
  const char* chrome = pack_["render"]["chrome"] | "standard";
  // Chrome type scale. The spec fixes the header/footer *bands* (44/32 px) but
  // not their type, so: title at `medium` bold, everything secondary at `small`,
  // all sharing one baseline per band. kHeaderBaseline centers a 30px line box
  // in the 44px band (7 + ascent 24); the footer centers a 20px box in 32px.
  const int kChromePx = 24, kChromeSmallPx = 16;
  const int kHeaderBaseline = 7 + font.ascent(kChromePx);
  const int kFooterBaseline = (H - 32) + 6 + font.ascent(kChromeSmallPx);
  const bool standardChrome = strcmp(chrome, "standard") == 0;
  if (standardChrome) {
    // header: 44px — pack name + time
    const char* nameEn = pack_["name"]["en"] | "";
    const char* nameZh = pack_["name"]["zh-Hant"] | nameEn;
    std::string title = std::string(nameZh) + "  " + nameEn;
    // G16: this reads as "now" but means "last render" — a hash-skip (the
    // single biggest battery lever in the design) leaves it showing whatever
    // time the panel was last actually drawn, which can be hours stale.
    // Label it so a healthy device never presents as a stopped clock.
    struct tm ltTm = detail::hkLocal(now);
    struct tm* lt = &ltTm;
    char clock[40];
    snprintf(clock, sizeof(clock), "更新 %02d:%02d / upd %02d:%02d", lt->tm_hour, lt->tm_min,
             lt->tm_hour, lt->tm_min);
    int clockW = textWidth(font, clock, kChromeSmallPx, false);
    int clockX = W - 16 - clockW;
    // The title yields to the clock rather than overprinting it — proportional
    // widths mean neither is a fixed reservation any more.
    drawTextRun(canvas, font, 16, kHeaderBaseline, title, kChromePx, Ink::Black, true, 0,
                clockX - 16);
    drawTextRun(canvas, font, clockX, kHeaderBaseline, clock, kChromeSmallPx, Ink::Black, false, 0,
                W);
    canvas.fillRect(0, 43, W, 1, Ink::Black);
    top = 44;
    bottom = H - 32;
  }

  // The footer draws AFTER the content (called at both exits below), for one
  // reason: its §11.4 data-warning glyph is a fact about the render that only
  // exists once the widgets have been through. Nothing else moves — the band
  // belongs to the chrome outright and the widget tree is clipped out of it,
  // so which order the two are painted in cannot change a pixel.
  auto drawFooter = [&]() {
    if (!standardChrome) return;
    // footer: 32px — source attribution + brand
    canvas.fillRect(0, H - 32, W, 1, Ink::Black);
    JsonVariantConst src0 = pack_["data"]["sources"][0];
    std::string host;
    const char* u = src0["url"] | "";
    if (strncmp(u, "https://", 8) == 0) {
      const char* p = u + 8;
      while (*p && *p != '/') host += *p++;
    }
    int chromeLeft = drawTextRun(canvas, font, 16, kFooterBaseline, host, kChromeSmallPx,
                                 Ink::Black, false, 0, W - 60);
    if (anyStale_) {
      // §11.4 stale glyph (for now: small text, right of the source
      // attribution) — "stale HH:MM" from the oldest currently-stale source.
      // `danger`, not `warn`: what is on the panel is being presented as the
      // truth and is not, which is the strongest thing this footer can say —
      // and §9.1a's `warn` is yellow, which at 16 px on white is a badge
      // nobody reads.
      struct tm stTm = detail::hkLocal(oldestStale_);
      struct tm* st = &stTm;
      char staleTxt[24];
      snprintf(staleTxt, sizeof(staleTxt), "stale %02d:%02d", st->tm_hour, st->tm_min);
      chromeLeft = drawTextRun(canvas, font, chromeLeft + 12, kFooterBaseline, staleTxt,
                               kChromeSmallPx, inkForRole(InkRole::Danger, profile), false, 0,
                               W - 60);
    }
    // §11.4 data-warning glyph — the Info tier, and the smallest thing this
    // chrome can say: E_TYPE/E_BIND/E_ITER happened somewhere on this page.
    // No words, because there are none a household could act on; the portal's
    // issues card and the device log carry the detail. Sits immediately right
    // of the stale badge, sharing the footer's own vertical centre.
    // `iterWarn_` because an E_ITER happened back in fetchAndExtract, whose
    // warning text went to the host and never touched this render's sink.
    if (hasDataWarning(warn) || iterWarn_) {
      const RolePaint warnPaint = paintForRole(InkRole::Warn, profile);
      drawWarnTriangle(canvas, chromeLeft + 12, (H - 32) + (32 - kWarnTriH) / 2, kWarnTriW,
                       kWarnTriH, warnPaint.mark, warnPaint.field);
      chromeLeft += 12 + kWarnTriW;
    }
    std::string brand = "YAT 日";
    int brandX = W - 16 - textWidth(font, brand, kChromeSmallPx, false);
    // Left edge of the right-hand cluster, narrowed by each piece of it that
    // is actually present — what the voice hint below is allowed to run into.
    int chromeRight = brandX;
    if (batteryPct_ >= 0) {
      // G25/§11.4: footer battery glyph, native x1 (24px), vertically
      // centered in the 32px footer band, just left of the brand mark.
      const int iconSize = kIconBase;
      int iconX = brandX - 8 - iconSize;
      int iconY = (H - 32) + (32 - iconSize) / 2;
      bool low = batteryPct_ <= 20;
      // Banded by charge, same idiom as sushiro's wait times: comfortably
      // charged reads `good`, a battery about to strand the panel mid-page is
      // `danger` (§9.1a — one of the two things the engine's own comments
      // reserve red for), and the band between is `warn` — getting worse,
      // not yet bad. Glyph shape is unchanged; only the ink varies.
      RolePaint batteryPaint = low                 ? paintForRole(InkRole::Danger, profile)
                                : batteryPct_ <= 50 ? paintForRole(InkRole::Warn, profile)
                                                    : paintForRole(InkRole::Good, profile);
      drawBatteryGlyph(canvas, iconX, iconY, batteryPaint, batteryPct_);
      chromeRight = iconX;
      if (low) {
        const char* warnTxt = batteryPct_ <= 8 ? "充電 charge" : "低電 low";
        int tw = textWidth(font, warnTxt, kChromeSmallPx, false);
        chromeRight = iconX - 8 - tw;
        drawTextRun(canvas, font, chromeRight, kFooterBaseline, warnTxt, kChromeSmallPx,
                    batteryPaint.mark, false, 0, iconX - 4);
      }
    }
    drawTextRun(canvas, font, brandX, kFooterBaseline, brand, kChromeSmallPx, Ink::Black, false, 0,
                W);
  };

  // §11.4a Action: drawn before anything decides how much room the content
  // has, and under any chrome (drawActionBanner's comment says why). It takes
  // its 34 px off the top of the content band rather than over it — a page
  // whose numbers are half-covered by a notice is two faults, not one.
  if (noticeLevel(notice_) == NoticeLevel::Action) {
    drawActionBanner(canvas, font, 0, top, W, notice_, c.ev.lang, profile);
    top += kActionBannerH;
  }
  // §11.4a Degraded: standard chrome only — it explains the footer's stale
  // badge, and a pack that declined the footer declined the badge too.
  const bool degraded = standardChrome && staleDegraded(now);
  if (degraded) {
    bottom -= kDegradedStripH;
    drawDegradedStrip(canvas, font, 0, bottom, W, c.ev.lang, profile);
  }

  // §11.3: every source failed with nothing on record, so there is no page to
  // draw — the widgets would substitute empty strings into every placeholder
  // and leave a page-shaped ghost. The card goes in the content band; the
  // chrome above and below is already drawn and stays exactly as it is (with
  // "chrome": "none" the band is the whole panel, and the card carries the
  // page name itself). Stale-serve deliberately does NOT come here: it has
  // content, and its footer badge already tells the truth about it.
  if (allSourcesEmpty()) {
    drawEmptyCard(clipped, font, pack(), c.ev.lang, 0, top, W, bottom - top, profile);
    detail::addWarn(&warn,
                    "empty state: every source failed with no snapshot — fallback card drawn "
                    "instead of the widgets (§11.3)");
    drawFooter();
    err = warn;
    return true;
  }

  // root = implicit column (§9.1)
  JsonDocument rootDoc;
  JsonObject root = rootDoc.to<JsonObject>();
  root["type"] = "column";
  root["children"] = pack_["render"]["widgets"];
  drawWidget(c, rootDoc.as<JsonVariantConst>(), 0, top, W, bottom - top, true);
  if (!c.err.empty()) { err = c.err; return false; }
  drawFooter();
  err = warn;  // non-fatal notices (§11.3/§11.4); empty when the render is clean
  return true;
}

}  // namespace yat
