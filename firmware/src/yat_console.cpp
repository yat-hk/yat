// Generated by the main.cpp module split: the code below is a verbatim
// slice of the original single-translation-unit firmware/src/main.cpp.

#include "yat_console.h"

#include <stdio.h>
#include <string.h>

#include <LittleFS.h>
#include <Preferences.h>
#include <WiFi.h>

#include "yat_buttons.h"
#include "yat_config.h"
#include "yat_errors.h"
#include "yat_hw.h"
#include "yat_llm.h"
#include "yat_net.h"
#include "yat_portal.h"
#include "yat_voice.h"
#include "yat_state.h"

// ---------------- serial file protocol (ARCHITECTURE §4) ----------------
//
// Line protocol over Serial, active whenever awake: YAT LS / GET / PUT / RM /
// STATUS / REBOOT. This is the foundation the BLE/WebSerial toolbox (v0.5)
// shares a command layer with (`yat_provision`); v0.2 ships the serial half
// only. PUT is guarded by a path-prefix whitelist so the protocol can only
// ever touch config.json and pack files, never arbitrary firmware state.


// Set by YAT PORTAL, acted on by maybeRunRequestedPortal() once the console
// window it arrived in has closed. Not entered from the command dispatch
// itself: runContentPortal() never returns, so jumping there mid-line would
// abandon whatever else is still sitting in the Serial1 buffer.
volatile bool g_portalRequested = false;

// Set for good on entry to runContentPortal(), which never returns. The portal
// loop pumps the same console this flag guards, so a second `YAT PORTAL` typed
// during a live session — or one left queued when the session ends — would
// otherwise re-enter runContentPortal() from inside itself: a second WebServer,
// a second engine render and a second copy of every local, stacked on the 32 KB
// loop task. The command answers "OK portal" either way; the device is already
// in the mode being asked for.
bool g_inContentPortal = false;

static bool pathAllowed(const String& path) {
  if (path.indexOf("..") >= 0) return false;
  if (path == "/config.json") return true;
  if (path.startsWith("/packs/") && path.length() > 7) return true;
  return false;
}

static void cmdLs() {
  if (!g_fsReady) {
    Serial1.println("ERR filesystem not mounted");
    return;
  }
  int count = 0;
  if (LittleFS.exists("/config.json")) {
    File f = LittleFS.open("/config.json", "r");
    if (f) {
      Serial1.printf("/config.json %u\n", (unsigned)f.size());
      f.close();
      count++;
    }
  }
  File dir = LittleFS.open("/packs");
  if (dir && dir.isDirectory()) {
    File entry = dir.openNextFile();
    while (entry) {
      if (!entry.isDirectory()) {
        Serial1.printf("%s %u\n", entry.path(), (unsigned)entry.size());
        count++;
      }
      entry = dir.openNextFile();
    }
  }
  Serial1.printf("OK %d files\n", count);
}

static void cmdGet(const String& args) {
  String path = args;
  path.trim();
  if (!pathAllowed(path)) {
    Serial1.println("ERR path not allowed");
    return;
  }
  if (!g_fsReady) {
    Serial1.println("ERR filesystem not mounted");
    return;
  }
  if (!LittleFS.exists(path)) {
    Serial1.println("ERR not found");
    return;
  }
  File f = LittleFS.open(path, "r");
  if (!f) {
    Serial1.println("ERR open failed");
    return;
  }
  Serial1.printf("OK %u\n", (unsigned)f.size());
  uint8_t buf[256];
  while (f.available()) {
    size_t chunk = f.read(buf, sizeof(buf));
    if (chunk == 0) break;
    Serial1.write(buf, chunk);
  }
  f.close();
}

static void cmdPut(const String& args) {
  int sp = args.indexOf(' ');
  if (sp < 0) {
    Serial1.println("ERR usage: PUT <path> <bytes>");
    return;
  }
  String path = args.substring(0, sp);
  long len = args.substring(sp + 1).toInt();
  if (len <= 0 || len > 65536) {  // PACK-SPEC §12.1 pack-file cap
    Serial1.println("ERR bad length");
    return;
  }
  if (!pathAllowed(path)) {
    Serial1.println("ERR path not allowed");
    return;
  }
  if (!g_fsReady) {
    Serial1.println("ERR filesystem not mounted");
    return;
  }

  std::string buf;
  buf.resize((size_t)len);
  Serial1.setTimeout(15000);  // 65536 B @ 115200 baud ~= 5.7 s; leave headroom
  size_t got = Serial1.readBytes(reinterpret_cast<uint8_t*>(&buf[0]), (size_t)len);
  Serial1.setTimeout(1000);   // restore Arduino default
  LOGF("[console] PUT %s: len=%ld got=%u\n", path.c_str(), len, (unsigned)got);
  if (got != (size_t)len) {
    Serial1.println("ERR short read");
    LOGF("[console] PUT short read %u/%ld\n", (unsigned)got, len);
    return;
  }

  // Structural JSON check before writing — both config.json and pack files
  // are JSON, and rejecting garbage here beats persisting a truncated/corrupt
  // write. Full pack-schema validation still happens at Engine::load time.
  // NestingLimit(24) matches the engine's loader (engine/src/extract.cpp): a
  // legal widget tree nests deeper than ArduinoJson's default limit of 10 —
  // most gallery packs are 12-14 levels — so the default would reject valid,
  // renderable packs here as "invalid json" and nothing would ever install.
  JsonDocument check;
  DeserializationError de = deserializeJson(check, buf, DeserializationOption::NestingLimit(24));
  if (de) {
    Serial1.println("ERR invalid json, not written");
    LOGF("[console] PUT invalid json (%s) — head: %.80s\n", de.c_str(), buf.c_str());
    return;
  }

  if (path.startsWith("/packs/") && !LittleFS.exists("/packs")) LittleFS.mkdir("/packs");
  if (!littlefsWriteFile(path.c_str(), buf.data(), buf.size())) {
    Serial1.println("ERR write failed");
    return;
  }
  Serial1.printf("OK %u written\n", (unsigned)buf.size());
  LOGF("[console] wrote %s (%u bytes)\n", path.c_str(), (unsigned)buf.size());
}

static void cmdRm(const String& args) {
  String path = args;
  path.trim();
  if (!pathAllowed(path)) {
    Serial1.println("ERR path not allowed");
    return;
  }
  if (!g_fsReady) {
    Serial1.println("ERR filesystem not mounted");
    return;
  }
  if (!LittleFS.exists(path)) {
    Serial1.println("ERR not found");
    return;
  }
  Serial1.println(LittleFS.remove(path) ? "OK removed" : "ERR remove failed");
}

// stt_key (NVS "yat"/"stt_key") is Task C's STT provider credential — set/
// cleared by YAT SECRET stt below. STATUS reports only whether it's present
// (non-empty), never the value itself.
bool sttKeyPresent() {
  Preferences prefs;
  prefs.begin("yat", true);
  String v = prefs.getString("stt_key", "");
  prefs.end();
  return v.length() > 0;
}

static constexpr size_t kStatusPageIdBytes = 96;

static void cmdStatus() {
  const char* pageId =
      (g_activePageIdx >= 0 && (size_t)g_activePageIdx < g_pages.size())
          ? g_pages[g_activePageIdx].id.c_str()
          : "";
  // "ip" is the STA address, empty when this cycle never joined a network —
  // the setup site reads it to print the portal URL a desktop browser can
  // type, so an unconnected device must say "" rather than "0.0.0.0".
  String ip = WiFi.status() == WL_CONNECTED ? WiFi.localIP().toString() : String("");
  // g_takeoverSignal is always one of our own short codes ("TC8NE", "WRAINB",
  // optionally " (SIMULATED)" appended by YAT TAKEOVER) or empty — never
  // attacker/API-controlled text, so no JSON-string escaping is needed here.
  // "fs_format" is true when this boot had to format the filesystem to mount
  // it: every pack and the page list are gone, and the setup site would
  // otherwise have no way to tell a wiped device from an unconfigured one.
  // Page ids come out of config.json, where nothing bounds their length, and
  // this response is a fixed buffer — so with two of them in it now, clip both
  // on a UTF-8 boundary rather than let snprintf cut the line into malformed
  // JSON. 96 bytes is many times any real page id ("weather", 「天氣」) and the
  // ellipsis makes a clipped one visibly clipped.
  //
  // 768, not the 512 this started at: "llm_ready" pushed the fixed part past
  // where a long page_id still had room to fit beside it, and "rendered_page"
  // adds a SECOND page id of the same kind. 800 once "loop_min" joined them,
  // 832 once "llm_provider" did — its longest value is "openrouter", so the
  // field costs at most 28 bytes and the round number keeps the headroom the
  // two clipped page ids were given. 864 once "model" did: a fixed 5-character
  // literal, 16 bytes of field.
  //
  // "model" is this build's YAT_MODEL_NAME ("e1002" | "e1001") — the same value
  // GET /api/status reports, offered here too because this is the door the
  // browser flasher comes in by, and it is the one place a computer can ask a
  // device which panel it has before choosing a release asset for it.
  //
  // "render_ok"/"rendered_page" are what the panel was last actually given, not
  // what this cycle intends — see g_renderOk. page_id above is the intent; the
  // two of them agreeing is the only honest basis for a ✓ anywhere.
  //
  // "llm_provider" is one of llmProvider()'s three literals, never any part of
  // the stored key, so it needs no more escaping than "takeover" does.
  const char* llmProv = llmProvider();
  char buf[864];
  snprintf(buf, sizeof buf,
           "{\"fw\":\"%s\",\"model\":\"" YAT_MODEL_NAME "\",\"battery_mv\":%d,\"ip\":\"%s\","
           "\"last_hash\":\"0x%08x\","
           "\"next_wake_s\":%llu,\"pages\":%u,\"page\":%d,\"page_id\":\"%s\",\"voice_ready\":%s,"
           "\"llm_ready\":%s,\"llm_provider\":\"%s\",\"voice_seconds\":%d,\"loop_min\":%d,"
           "\"takeover\":%s,\"signal\":\"%s\","
           "\"fs_format\":%s,\"render_ok\":%s,\"rendered_page\":\"%s\"}",
           FW_VERSION, (int)(batteryVolts() * 1000.0f), ip.c_str(), g_lastHash,
           (unsigned long long)g_plannedSleepSeconds, (unsigned)g_pages.size(), g_activePageIdx,
           utf8Clip(pageId, kStatusPageIdBytes).c_str(), sttKeyPresent() ? "true" : "false",
           llmProv[0] ? "true" : "false", llmProv, g_voiceSeconds, g_loopMin,
           g_takeoverActive ? "true" : "false", g_takeoverSignal.c_str(),
           g_fsFormatted ? "true" : "false", g_renderOk ? "true" : "false",
           utf8Clip(g_renderedPage.c_str(), kStatusPageIdBytes).c_str());
  Serial1.println(buf);
}

// YAT ERRORS: the error ring (see recordError), newest first, one line each —
// "<epoch> <code> <context>", with "-" for an entry that has no context and a
// 0 epoch for one recorded before the clock was synced. Deliberately the same
// shape as YAT PAGES: whitespace-separated fields and a closing OK, so a test
// script can read it with split() and a person can read it at a glance. The
// same eight rows GET /api/status serves as "errors" — this is the door for
// somebody at a terminal, that one is the door for the portal.
static void cmdErrors() {
  for (size_t i = 0; i < ERR_RING_N; i++) {
    const ErrEntry* e = errAt(i);
    if (!e) break;
    Serial1.printf("%lu %s %s\n", (unsigned long)e->t, e->code, e->page[0] ? e->page : "-");
  }
  Serial1.println("OK");
}

// YAT PAGES: one line per configured page, "<idx> <id> <pack>", "*" prefixed
// on the active one, then "OK". g_pages/g_activePageIdx are set once per
// cycle in setup() and kept current across YAT USE — see their declarations.
static void cmdPages() {
  for (size_t i = 0; i < g_pages.size(); i++) {
    Serial1.printf("%s%u %s %s\n", (int)i == g_activePageIdx ? "*" : "", (unsigned)i,
                  g_pages[i].id.c_str(), g_pages[i].pack.c_str());
  }
  Serial1.println("OK");
}

// YAT USE <id-or-index>: match by page id first (exact string match), then
// fall back to a numeric index if the argument is all digits. Persists to
// NVS immediately (savePageIdx) and sets g_serialForceRender so the hash-skip
// check later this same cycle renders the new page instead of waiting for
// the next wake, if this command arrives early enough in the cycle to matter
// (the wifi-connect console window, before the pack is loaded) — otherwise
// the switch still takes effect starting next cycle.
static void cmdUse(const String& args) {
  String a = args;
  a.trim();
  if (a.length() == 0) {
    Serial1.println("ERR usage: USE <id-or-index>");
    return;
  }
  int found = -1;
  for (size_t i = 0; i < g_pages.size(); i++) {
    if (a == g_pages[i].id.c_str()) {
      found = (int)i;
      break;
    }
  }
  if (found < 0) {
    bool allDigits = a.length() > 0;
    for (size_t i = 0; i < a.length(); i++) {
      if (!isDigit(a[i])) {
        allDigits = false;
        break;
      }
    }
    if (allDigits) {
      long idx = a.toInt();
      if (idx >= 0 && idx < (long)g_pages.size()) found = (int)idx;
    }
  }
  if (found < 0) {
    Serial1.println("ERR no such page");
    return;
  }
  g_activePageIdx = found;
  savePageIdx(g_activePageIdx);
  g_serialForceRender = true;
  Serial1.printf("OK %d %s\n", g_activePageIdx, g_pages[g_activePageIdx].id.c_str());
  LOGF("[console] YAT USE -> page %d (\"%s\")\n", g_activePageIdx,
       g_pages[g_activePageIdx].id.c_str());
}

// YAT SAY <text>: drives voiceDispatch() — the same decision the microphone
// path takes with a transcript in hand, minus the microphone. A page match
// switches the active page the same way YAT USE does (persist to NVS,
// g_serialForceRender=true) and replies "MATCH <idx> <id>". A todo intent
// (voice intents section of yat_voice.cpp) mutates the list, persists
// config.json, makes the todo page active and replies with one of:
//
//   TODO ADD <items> <open>
//   TODO DONE <item-idx> <items> <open>
//   TODO CLEAR <removed> <items> <open>
//
// where <items>/<open> are the list's length and its open count AFTER the
// change. Everything else — no page named, a verb that could not be carried
// out, an item two open entries could answer to, empty text — replies
// "NOMATCH", exactly matching what the device does audibly: one "didn't catch
// that" tone for every refusal, whatever the reason. Which reason it was is on
// the LOGF line beside it.
//
// The one thing this deliberately does NOT do is the LLM tier. That would put a
// metered API call behind a debugging command and make its answer depend on a
// remote service, so a test that wanted the keyword path could never be sure it
// got it. What runs here is everything that runs on-device.
static void cmdSay(const String& args) {
  // Arduino String -> std::string is a raw byte copy; no encoding-aware
  // operation has touched args besides handleConsoleLine's leading/trailing
  // trim(), so the UTF-8 bytes reach normalizeUtf8() untouched.
  std::string text(args.c_str());
  const VoiceOutcome act = voiceDispatch(text, /*allowLlm=*/false);
  switch (act.kind) {
    case VoiceActionKind::Page:
      Serial1.printf("MATCH %d %s\n", act.pageIdx, g_pages[act.pageIdx].id.c_str());
      LOGF("[console] YAT SAY \"%s\" -> page %d (\"%s\")\n", text.c_str(), act.pageIdx,
           g_pages[act.pageIdx].id.c_str());
      return;
    case VoiceActionKind::TodoAdd:
      Serial1.printf("TODO ADD %d %d\n", act.items, act.openItems);
      LOGF("[console] YAT SAY \"%s\" -> todo add (%d item(s), %d open)\n", text.c_str(), act.items,
           act.openItems);
      return;
    case VoiceActionKind::TodoDone:
      Serial1.printf("TODO DONE %d %d %d\n", act.itemIdx, act.items, act.openItems);
      LOGF("[console] YAT SAY \"%s\" -> todo done item %d (%d open left)\n", text.c_str(),
           act.itemIdx, act.openItems);
      return;
    case VoiceActionKind::TodoClear:
      Serial1.printf("TODO CLEAR %d %d %d\n", act.removed, act.items, act.openItems);
      LOGF("[console] YAT SAY \"%s\" -> todo clear (%d removed, %d left)\n", text.c_str(),
           act.removed, act.items);
      return;
    case VoiceActionKind::None:
      Serial1.println("NOMATCH");
      LOGF("[console] YAT SAY \"%s\" -> NOMATCH\n", text.c_str());
      return;
  }
}

// YAT SECRET <stt|llm> <value>: two secret names exist — "stt" (the STT
// provider key, PRD §4.4) and "llm" (the DeepSeek, OpenRouter or NVIDIA key the
// voice router falls back to when no keyword matched; which service it is comes
// from the key's own prefix, see llmProviderFor). Anything else is ERR rather than silently
// ignored. <value> of "-" clears the stored key (an explicit sentinel, not
// an empty string, since a phone keyboard/voice-typed value could produce an
// accidental blank). Stored in Preferences namespace "yat", keys "stt_key" /
// "llm_key" — the same namespace wifi creds/hash/epoch/page_idx already use.
// The value is never echoed and never logged; only its length is.
static void cmdSecret(const String& args) {
  int sp = args.indexOf(' ');
  String name = sp < 0 ? args : args.substring(0, sp);
  String value = sp < 0 ? String("") : args.substring(sp + 1);
  name.trim();
  value.trim();
  const char* nvsKey = name == "stt" ? "stt_key" : (name == "llm" ? "llm_key" : nullptr);
  if (!nvsKey || value.length() == 0) {
    Serial1.println("ERR usage: SECRET <stt|llm> <value-or-->");
    return;
  }
  // The same ceiling POST /api/secret enforces. Nothing either provider issues
  // comes close; a value this long is a paste of the wrong thing, and storing
  // it would only produce a confusing 401 later.
  if (value.length() > CONTENT_PORTAL_MAX_SECRET) {
    Serial1.println("ERR too long");
    LOGF("[console] YAT SECRET %s rejected: %u chars over the %u cap\n", name.c_str(),
         (unsigned)value.length(), (unsigned)CONTENT_PORTAL_MAX_SECRET);
    return;
  }
  Preferences prefs;
  prefs.begin("yat", false);
  if (value == "-") {
    prefs.remove(nvsKey);
    LOGF("[console] YAT SECRET %s cleared\n", name.c_str());
  } else {
    prefs.putString(nvsKey, value);
    LOGF("[console] YAT SECRET %s set (%u chars)\n", name.c_str(), (unsigned)value.length());
  }
  prefs.end();
  Serial1.println("OK");
}

// YAT TAKEOVER 0|1|2: debug override for the warning-takeover policy (PRD
// §4.2/§5.1, docs/UX-FLOWS.md G15) — there is no way to force a real T8 or
// black rainstorm signal for on-device testing, so this forces the DECISION
// instead. 0 clears the override (back to the real warnsum check next wake);
// 1 simulates a T8 typhoon signal (TC8NE); 2 simulates a Black Rainstorm
// Warning (WRAINB). Persisted in NVS ("yat"/"takeover_sim") so it survives
// the sleep between setting it and the next wake's warnsum check actually
// picking it up; every simulated cycle logs "[takeover] SIMULATED ..." so a
// test run can never be mistaken for a real signal on the wire or in STATUS.
static void cmdTakeover(const String& args) {
  String a = args;
  a.trim();
  bool digitsOnly = a.length() > 0;
  for (size_t i = 0; i < a.length(); i++) {
    if (!isDigit(a[i])) {
      digitsOnly = false;
      break;
    }
  }
  long v = digitsOnly ? a.toInt() : -1;
  if (v < 0 || v > 2) {
    Serial1.println("ERR usage: TAKEOVER 0|1|2");
    return;
  }
  Preferences prefs;
  prefs.begin("yat", false);
  prefs.putUChar("takeover_sim", (uint8_t)v);
  prefs.end();
  static const char* const kNames[3] = {"off", "simulate T8 (TC8NE)", "simulate Black Rain (WRAINB)"};
  Serial1.printf("OK %ld %s\n", v, kNames[v]);
  LOGF("[console] YAT TAKEOVER %ld (%s) — takes effect from this cycle's warnsum check onward "
       "(now, if it hasn't run yet) or next wake\n",
       v, kNames[v]);
}

// YAT PORTAL: opens the content portal exactly as the green button does —
// the dev/recovery door into setup mode, and the only way to drive it from a
// test script. Subject to the same battery guard the gesture is, answering
// "ERR lowbatt" rather than a screen because whoever sent this is looking at a
// terminal, not at the panel.
static void cmdPortal() {
  if (g_inContentPortal) {
    // Already there — say so and change nothing. Re-entering would nest a whole
    // second portal session inside the running one (see g_inContentPortal).
    Serial1.println("OK portal");
    LOGF("[portal] YAT PORTAL ignored — already in the content portal\n");
    return;
  }
  float volts = batteryVolts();
  if (volts < CONTENT_PORTAL_MIN_VOLTS) {
    Serial1.println("ERR lowbatt");
    LOGF("[portal] YAT PORTAL refused — battery %.2f V below the %.2f V setup floor\n", volts,
         CONTENT_PORTAL_MIN_VOLTS);
    return;
  }
  Serial1.println("OK portal");
  Serial1.flush();
  g_portalRequested = true;
  LOGF("[portal] YAT PORTAL — entering content portal when this console window closes\n");
}

static void handleConsoleLine(const String& rawLine) {
  String line = rawLine;
  line.trim();
  if (line.length() == 0) return;
  if (!line.startsWith("YAT ")) {
    Serial1.println("ERR expected \"YAT <CMD>\"");
    return;
  }
  String rest = line.substring(4);
  rest.trim();
  int sp = rest.indexOf(' ');
  String cmd = sp < 0 ? rest : rest.substring(0, sp);
  String args = sp < 0 ? String("") : rest.substring(sp + 1);
  args.trim();
  LOGF("[console] << YAT %s %s\n", cmd.c_str(), args.c_str());

  if (cmd == "LS") {
    cmdLs();
  } else if (cmd == "GET") {
    cmdGet(args);
  } else if (cmd == "PUT") {
    cmdPut(args);
  } else if (cmd == "RM") {
    cmdRm(args);
  } else if (cmd == "STATUS") {
    cmdStatus();
  } else if (cmd == "PAGES") {
    cmdPages();
  } else if (cmd == "ERRORS") {
    cmdErrors();
  } else if (cmd == "USE") {
    cmdUse(args);
  } else if (cmd == "SAY") {
    cmdSay(args);
  } else if (cmd == "SECRET") {
    cmdSecret(args);
  } else if (cmd == "TAKEOVER") {
    cmdTakeover(args);
  } else if (cmd == "PORTAL") {
    cmdPortal();
  } else if (cmd == "REBOOT") {
    Serial1.println("OK rebooting");
    Serial1.flush();
    delay(50);
    ESP.restart();
  } else {
    Serial1.println("ERR unknown command");
  }
}

// Defined in the provisioning section below (needs the ImprovWiFi instance
// declared there); forward-declared here so consoleWindow() can dispatch to
// it without reordering the whole file. Demuxes one Serial "message" to
// either the Improv-serial state machine or this section's YAT line handler
// — Improv-serial is active whenever awake, alongside the YAT protocol
// (ARCHITECTURE §8, ROADMAP v0.2), distinguished by the IMPROV magic header
// vs the "YAT " prefix.
void pumpConsoleByte();

// Blocks up to windowMs waiting for "YAT ..." lines or Improv-serial packets;
// any activity extends the window (so a slow human typing a command doesn't
// get cut off mid-session).
void consoleWindow(uint32_t windowMs) {
  uint32_t t0 = millis();
  bool any = false;
  uint32_t idleMs = windowMs;  // short wait for the first byte...
  LOGF("[console] window open %lu ms\n", (unsigned long)windowMs);
  while (millis() - t0 < idleMs) {
    // The densest checkpoint there is: while this loop runs, a press is acted
    // on within ~20 ms of the finger coming up (button-latch section above).
    processKeyLatches("console window");
    if (Serial1.available()) {
      any = true;
      pumpConsoleByte();
      // YAT PORTAL must fire NOW, not after the session idle runs out — a live
      // session tolerates 3 min of quiet, and waiting that long between
      // "OK portal" and the portal actually starting reads as a dead device.
      if (g_portalRequested) break;
      t0 = millis();
      // ...then, once a session is live, tolerate long gaps between commands so
      // the device doesn't sleep (and drop native USB) mid content-setup.
      idleMs = CONSOLE_SESSION_IDLE_MS;
    } else {
      delay(20);
    }
  }
  LOGF("[console] window closed%s\n", any ? "" : " (no activity)");
}

// Acts on a YAT PORTAL received during the window that just closed. Called
// after every consoleWindow() rather than from the command dispatch so the
// serial line is quiet before the portal takes the CPU; never returns when it
// fires (runContentPortal ends in deep sleep like every other mode here).
void maybeRunRequestedPortal() {
  if (!g_portalRequested) return;
  g_portalRequested = false;
  // Second half of the re-entry guard: the portal's exit path sleeps through
  // lowLevelSleep(), which opens one last console window and calls this — a
  // request that slipped in before the guard was set (or from the Improv
  // pump) must not restart the session that is already ending.
  if (g_inContentPortal) {
    LOGF("[portal] portal request dropped — this cycle is already leaving the content portal\n");
    return;
  }
  runContentPortal(PortalEntry::Console);
}

// Called at a few points during the awake cycle: if bytes are already
// sitting in the Serial buffer, open a full console window right there
// instead of making the sender wait for the end-of-cycle window. This is a
// checkpoint model, not a true interrupt — mid-fetch/mid-refresh is still not
// preemptible in a single-threaded setup() (see report open questions).
void maybeEnterConsole(const char* when) {
  // Buttons ride the same checkpoints, but unconditionally: a press has no
  // Serial bytes to announce itself with, and these three call sites are the
  // only places the cycle pauses between WiFi, fetch and the panel refresh.
  processKeyLatches(when);
  if (Serial1.available()) {
    LOGF("[console] activity during %s — entering console window\n", when);
    consoleWindow(CONSOLE_WINDOW_MS);
    maybeRunRequestedPortal();
  }
}

// ---------------- Improv-serial (ARCHITECTURE §8) ----------------
//
// jnthas/Improv-WiFi-Library implements the improv-wifi.com Serial packet
// framing/checksum/state-machine; setCustomConnectWiFi() routes a received
// WIFI_SETTINGS command through our own connect + NVS save instead of the
// library's fire-and-forget default, so Improv-provisioned credentials land
// in the same Preferences store as the portal/secrets.h paths.
ImprovWiFi g_improv(&Serial1);

bool improvConnectCb(const char* ssid, const char* pass) {
  LOGF("[improv] credentials received for \"%s\" — connecting...\n", ssid);
  WiFi.begin(ssid, pass);
  uint32_t t0 = millis();
  while (WiFi.status() != WL_CONNECTED && millis() - t0 < WIFI_TIMEOUT_MS) delay(100);
  if (WiFi.status() != WL_CONNECTED) {
    LOGF("[improv] connect failed\n");
    return false;
  }
  saveWifiCreds(ssid, pass);
  g_improvSaved = true;
  return true;
}

void improvErrorCb(ImprovTypes::Error err) { LOGF("[improv] error 0x%02x\n", (unsigned)err); }

void improvConnectedCb(const char* ssid, const char*) {
  LOGF("[improv] provisioned via Improv-serial (%s)\n", ssid);
}

// Demuxes one Serial "message": Improv packets always start with the literal
// byte 'I' (the "IMPROV" magic), which a "YAT <CMD>" line never does, so a
// single-byte peek is enough to route. The Improv branch feeds the parser
// EXACTLY one packet's worth of bytes — 6 magic + version + type + length +
// <length> data + checksum — because handleSerial() consumes one byte per
// call and an open-ended "drain until 50 ms quiet" here used to swallow any
// YAT line that followed an Improv packet within the window (the site sends
// both back-to-back on connect). A stray 'I' that isn't a real packet costs
// at most one bounded burst; the parser resyncs on magic mismatch and a real
// YAT command always starts 'Y', so nothing is misrouted.
void pumpConsoleByte() {
  if (!Serial1.available()) return;
  if (Serial1.peek() == 'I') {
    uint16_t fed = 0, need = 9;
    uint32_t last = millis();
    while (fed < need && millis() - last < 250) {
      if (!Serial1.available()) {
        delay(1);
        continue;
      }
      if (fed == 8) need = 10 + Serial1.peek();  // length byte
      g_improv.handleSerial();  // consumes exactly one byte
      fed++;
      last = millis();
    }
    return;
  }
  String line = Serial1.readStringUntil('\n');
  handleConsoleLine(line);
}
