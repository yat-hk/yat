// Generated by the main.cpp module split: the code below is a verbatim
// slice of the original single-translation-unit firmware/src/main.cpp.

#include "yat_hw.h"

#include <Arduino.h>
#include <Wire.h>

// ---------------- sensors ----------------

// SHT4x high-precision one-shot (0xFD). Feeds the panel's waveform temperature
// compensation, which is why it runs before the refresh and not after.
bool sht4xRead(float& t, float& h) {
  Wire.beginTransmission(ADDR_SHT4X);
  Wire.write(0xFD);
  if (Wire.endTransmission() != 0) return false;
  delay(10);
  if (Wire.requestFrom(ADDR_SHT4X, (uint8_t)6) != 6) return false;
  uint8_t b[6];
  for (int i = 0; i < 6; i++) b[i] = Wire.read();
  t = -45.0f + 175.0f * ((b[0] << 8) | b[1]) / 65535.0f;
  h = constrain(-6.0f + 125.0f * ((b[3] << 8) | b[4]) / 65535.0f, 0.0f, 100.0f);
  return true;
}

float batteryVolts() {
  digitalWrite(PIN_BAT_EN, HIGH);
  delay(20);
  uint32_t sum = 0;
  for (int i = 0; i < 16; i++) sum += analogReadMilliVolts(PIN_BAT_ADC);
  digitalWrite(PIN_BAT_EN, LOW);
  return (sum / 16) * 2.0f / 1000.0f;  // on-board 1:2 divider
}

// G25/G26: see BATTERY_EMPTY_V/BATTERY_FULL_V's declaration for why this is
// deliberately a straight line rather than a real discharge-curve model.
int batteryPercent(float volts) {
  float pct = (volts - BATTERY_EMPTY_V) / (BATTERY_FULL_V - BATTERY_EMPTY_V) * 100.0f;
  if (pct < 0) pct = 0;
  if (pct > 100) pct = 100;
  return (int)(pct + 0.5f);
}
