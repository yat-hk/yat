#pragma once
// Generated by the main.cpp module split: the code below is a verbatim
// slice of the original single-translation-unit firmware/src/main.cpp.

#include <string>
#include <vector>

// Before TFT_eSPI.h, exactly as the original single-TU include order had it:
// Seeed_GFX suppresses FS.h's `using fs::FS`, so anything that pulls in
// WebServer.h afterwards needs the global name to exist already.
#include <FS.h>

#include "TFT_eSPI.h"
#include <pngle.h>
#include <yat/engine.h>

#include "yat_common.h"

extern EPaper epaper;

// ---------------- canvas / font shims ----------------

// The model define and the panel Seeed_GFX was actually configured for are set
// in two different places in platformio.ini (YAT_MODEL_* and
// BOARD_SCREEN_COMBO), and getting them out of step would not fail anywhere
// obvious — it would build clean and then drive the panel through the wrong
// ink table, which on a device somebody has already flashed is a screen that
// never comes back. So check the pairing here, where both facts are finally
// visible in one translation unit. USE_COLORFULL_EPAPER is Seeed_GFX's own
// witness of the E6 path (Dynamic_Setup.h defines it for combo 521 and not for
// 520), and EPD_COLOR_DEPTH comes from whichever *_Defines.h the driver pulled
// in — 4 for the ED2208, 1 for the UC8179.
#if defined(YAT_MODEL_E1001)
#ifdef USE_COLORFULL_EPAPER
#error "YAT_MODEL_E1001 built against a colour panel setup — BOARD_SCREEN_COMBO should be 520"
#endif
static_assert(EPD_COLOR_DEPTH == 1, "E1001 expects the UC8179's 1bpp sprite");
#else
#ifndef USE_COLORFULL_EPAPER
#error "YAT_MODEL_E1002 built against a mono panel setup — BOARD_SCREEN_COMBO should be 521"
#endif
static_assert(EPD_COLOR_DEPTH == 4, "E1002 expects the ED2208's 4bpp sprite");
#endif
// Both panels are the same size today, and the engine profile says so too
// (kProfileE1001/kProfileE1002 are both 800x480). A model whose setup header
// disagrees with SCREEN_W/SCREEN_H would silently render off the edge.
static_assert(EPD_WIDTH == SCREEN_W && EPD_HEIGHT == SCREEN_H,
              "panel setup header and SCREEN_W/SCREEN_H disagree");
static_assert(kPanelProfile.width == SCREEN_W && kPanelProfile.height == SCREEN_H,
              "engine DeviceProfile and SCREEN_W/SCREEN_H disagree");

// What one yat::Ink is worth to the panel, indexed by yat::Ink. The two models
// need genuinely different tables, and the difference is not cosmetic — a
// straight copy of the E1002 table onto an E1001 would draw four of the six
// inks in WHITE, i.e. invisibly.
//
// E1002 (BOARD_SCREEN_COMBO=521 -> ED2208 -> USE_COLORFULL_EPAPER): the
// TFT_* constants ARE the raw 4bpp E6 ink codes (Seeed_GFX TFT_eSPI.h §6:
// TFT_BLACK 0xF, TFT_WHITE 0x0, TFT_RED 0x6 ...), and TFT_eSprite::drawPixel's
// 4bpp branch masks with 0x0F and packs two per byte, so they go straight into
// the sprite framebuffer.
//
// E1001 (BOARD_SCREEN_COMBO=520 -> UC8179): USE_COLORFULL_EPAPER is never
// defined on this path, so the same TFT_* names revert to their ordinary
// RGB565 values — and the sprite is 1bpp (UC8179_Defines.h EPD_COLOR_DEPTH 1),
// where drawPixel treats the colour as a BOOLEAN: `if (color) set the bit else
// clear it`. Every RGB565 value except TFT_BLACK's 0x0000 is non-zero, so
// TFT_RED/YELLOW/GREEN/BLUE would each set the bit — the same bit TFT_WHITE
// sets — and a red low-battery heading would come out white on white. Hence
// the explicit clamp: white stays white, everything else becomes a mark.
//
// The engine's Mono profile (yat_common.h's kPanelProfile) already clamps at
// the level where a pack asks for an ink by name or by role. This table is the
// backstop underneath it, and it is not redundant: the firmware's own cards call
// yat::Ink::Red/Blue/Green on the canvas directly (yat_screens.cpp,
// yat_portal.cpp, yat_ota.cpp), never through inkForRole, so without this they
// would be the screens that vanished.
#if defined(YAT_MODEL_E1001)
// 1bpp: the value's only meaning is zero vs non-zero. These two static_asserts
// are the whole assumption, so a Seeed_GFX release that inverts the polarity
// fails the build instead of shipping a white-on-white panel.
static_assert(TFT_BLACK == 0x0000, "1bpp drawPixel treats 0 as the mark; TFT_BLACK must be 0");
static_assert(TFT_WHITE != 0x0000, "1bpp drawPixel treats non-zero as bare panel; TFT_WHITE must not be 0");
static const uint16_t INK[6] = {TFT_BLACK, TFT_WHITE, TFT_BLACK,
                                TFT_BLACK, TFT_BLACK, TFT_BLACK};
#else
static const uint16_t INK[6] = {TFT_BLACK, TFT_WHITE, TFT_RED,
                                TFT_YELLOW, TFT_GREEN, TFT_BLUE};
#endif

struct EPaperCanvas : yat::Canvas {
  int width() const override { return SCREEN_W; }
  int height() const override { return SCREEN_H; }

  void drawPixel(int x, int y, yat::Ink ink) override {
    epaper.drawPixel(x, y, INK[(int)ink]);
  }

  void fillRect(int x, int y, int w, int h, yat::Ink ink) override {
    epaper.fillRect(x, y, w, h, INK[(int)ink]);
  }
};

// ---------------- image decode (§9.10, pngle) ----------------
//
// yat::ImageDecoder backed by pngle (kikuchan98/pngle, MIT —
// github.com/kikuchan/pngle), a small streaming PNG decoder with no
// filesystem/heap assumptions of its own. pngle_feed() is called with the
// whole already-fetched, already-size-capped body in one shot; it calls back
// once with the image dimensions (pngleOnInit) and then once per decoded run
// of pixels (pngleOnDraw — despite taking x,y,w,h, a run is very often a
// single pixel, but need not be), which is composited onto the white
// background canvas.h's `image` widget contract expects (no transparency on
// an e-paper panel). engine/src/render.cpp re-checks the decoded w×h against
// the §9.10 800×480 cap *after* decode() returns, but a highly-compressible
// PNG can claim far larger IHDR dimensions than its ≤204800-byte fetched size
// would suggest (a decompression-bomb shape), so pngleOnInit enforces the
// same cap itself before ever sizing the output buffer.
struct PngleDecodeCtx {
  int w = 0, h = 0;
  std::vector<uint8_t>* rgb = nullptr;
  bool tooBig = false;
};

static void pngleOnInit(pngle_t* png, uint32_t w, uint32_t h) {
  auto* ctx = static_cast<PngleDecodeCtx*>(pngle_get_user_data(png));
  if ((uint64_t)w * h > 800ULL * 480ULL) {
    ctx->tooBig = true;
    return;
  }
  ctx->w = (int)w;
  ctx->h = (int)h;
  ctx->rgb->assign((size_t)w * h * 3, 255);  // white background; alpha composites onto it below
}

static void pngleOnDraw(pngle_t* png, uint32_t x, uint32_t y, uint32_t w, uint32_t h,
                        const uint8_t rgba[4]) {
  auto* ctx = static_cast<PngleDecodeCtx*>(pngle_get_user_data(png));
  if (ctx->tooBig || !ctx->rgb) return;
  uint32_t a = rgba[3];
  for (uint32_t j = y; j < y + h && (int)j < ctx->h; j++) {
    for (uint32_t i = x; i < x + w && (int)i < ctx->w; i++) {
      uint8_t* px = ctx->rgb->data() + ((size_t)j * ctx->w + i) * 3;
      px[0] = (uint8_t)((rgba[0] * a + 255 * (255 - a)) / 255);
      px[1] = (uint8_t)((rgba[1] * a + 255 * (255 - a)) / 255);
      px[2] = (uint8_t)((rgba[2] * a + 255 * (255 - a)) / 255);
    }
  }
}

struct PngleImageDecoder : yat::ImageDecoder {
  bool decode(const std::string& png, int& w, int& h, std::vector<uint8_t>& rgb) override {
    pngle_t* pngle = pngle_new();
    if (!pngle) return false;
    PngleDecodeCtx ctx;
    ctx.rgb = &rgb;
    pngle_set_user_data(pngle, &ctx);
    pngle_set_init_callback(pngle, pngleOnInit);
    pngle_set_draw_callback(pngle, pngleOnDraw);

    const uint8_t* data = reinterpret_cast<const uint8_t*>(png.data());
    size_t total = png.size(), fedTotal = 0;
    bool ok = true;
    while (fedTotal < total) {
      int fed = pngle_feed(pngle, data + fedTotal, total - fedTotal);
      if (fed < 0) {
        LOGF("[image] pngle decode failed: %s\n", pngle_error(pngle));
        ok = false;
        break;
      }
      if (fed == 0) {
        // Wants more data, but the whole (size-capped) fetched body is
        // already fed — a truncated or malformed stream.
        LOGF("[image] pngle: truncated/malformed PNG stream\n");
        ok = false;
        break;
      }
      fedTotal += (size_t)fed;
    }
    bool tooBig = ctx.tooBig;
    int cw = ctx.w, ch = ctx.h;
    pngle_destroy(pngle);
    if (tooBig) LOGF("[image] pngle: decoded pixels exceed 800x480 cap, rejecting\n");
    if (!ok || tooBig || cw <= 0 || ch <= 0) return false;
    w = cw;
    h = ch;
    return true;
  }
};

// ---------------- sensors ----------------

bool sht4xRead(float& t, float& h);
float batteryVolts();
int batteryPercent(float volts);
