// Generated by the main.cpp module split: the code below is a verbatim
// slice of the original single-translation-unit firmware/src/main.cpp.

#include "yat_screens.h"

#include <stdio.h>
#include <string.h>

#include <LittleFS.h>
#include <Preferences.h>

#include "qrcodegen.h"

#include <yat/icons.h>

#include "yat_config.h"
#include "yat_sched.h"
#include "yat_voice.h"
#include "yat_state.h"

namespace prov {

size_t utf8Next(const std::string& s, size_t i, uint16_t& code) {
  unsigned char c = s[i];
  if (c < 0x80) {
    code = c;
    return i + 1;
  }
  if ((c & 0xE0) == 0xC0 && i + 1 < s.size()) {
    code = ((c & 0x1F) << 6) | (s[i + 1] & 0x3F);
    return i + 2;
  }
  if ((c & 0xF0) == 0xE0 && i + 2 < s.size()) {
    code = ((c & 0x0F) << 12) | ((s[i + 1] & 0x3F) << 6) | (s[i + 2] & 0x3F);
    return i + 3;
  }
  code = 0xFFFD;
  return i + 1;
}

void drawGlyph(yat::Canvas& cv, const yat::GlyphInfo& g, int penX, int baselineY, yat::Ink ink) {
  if (!g.bitmap || g.bw == 0) return;
  int x0 = penX + g.xOffset, y0 = baselineY + g.yOffset;
  for (int row = 0; row < g.bh; row++) {
    const uint8_t* r = g.bitmap + (size_t)row * g.stride;
    for (int col = 0; col < g.bw; col++) {
      if (!(r[col >> 3] & (0x80 >> (col & 7)))) continue;
      int px = x0 + col * g.scale;
      cv.fillRect(px, y0 + row * g.scale, g.scale, g.scale, ink);
      if (g.smear) cv.fillRect(px + 1, y0 + row * g.scale, g.scale, g.scale, ink);
    }
  }
}

int drawText(yat::Canvas& cv, yat::FontProvider& font, int x, int y, const std::string& s, int px,
             yat::Ink ink, bool bold) {
  int baseline = y + font.ascent(px);
  uint16_t code;
  for (size_t i = 0; i < s.size();) {
    i = utf8Next(s, i, code);
    yat::GlyphInfo g;
    if (!font.glyph(px, code, bold, g)) continue;  // no tofu on a boot screen
    drawGlyph(cv, g, x, baseline, ink);
    x += g.advance;
  }
  return x;
}

int textWidth(const std::string& s, int px, bool bold) {
  int w = 0;
  uint16_t code;
  for (size_t i = 0; i < s.size();) {
    i = utf8Next(s, i, code);
    yat::GlyphInfo g;
    if (yat::fontGlyph(px, code, bold, g)) w += g.advance;
  }
  return w;
}

// Same qrcodegen call convention as engine/src/render.cpp's "qr" widget
// (§9.11): always black-on-white, ECC medium, a 4-module quiet zone.
void drawQR(yat::Canvas& cv, const char* text, int x, int y, int size) {
  uint8_t qr0[qrcodegen_BUFFER_LEN_MAX];
  uint8_t tempBuf[qrcodegen_BUFFER_LEN_MAX];
  cv.fillRect(x, y, size, size, yat::Ink::White);
  if (!qrcodegen_encodeText(text, tempBuf, qr0, qrcodegen_Ecc_MEDIUM, qrcodegen_VERSION_MIN,
                             qrcodegen_VERSION_MAX, qrcodegen_Mask_AUTO, /*boostEcl=*/false)) {
    return;  // encode failure -- leave the box blank rather than wedge the boot
  }
  int modules = qrcodegen_getSize(qr0);
  const int quiet = 4;
  int total = modules + quiet * 2;
  int scale = size / total;
  if (scale < 1) scale = 1;
  int px = total * scale;
  int offX = x + (size - px) / 2, offY = y + (size - px) / 2;
  for (int my = 0; my < modules; my++)
    for (int mx = 0; mx < modules; mx++)
      if (qrcodegen_getModule(qr0, mx, my))
        cv.fillRect(offX + (mx + quiet) * scale, offY + (my + quiet) * scale, scale, scale,
                    yat::Ink::Black);
}

// Same §9.9 catalog + draw loop as engine/src/render.cpp's "icon" widget
// (kept in sync by hand — these firmware-owned screens run before any pack
// is loaded, so they draw directly rather than through a widget tree). `size`
// should be a multiple of yat::kIconBase (24) for a clean integer scale —
// small=24, medium=48, large=96. An off-catalog name draws nothing rather
// than wedging the boot; every name used below is a real catalog entry.
void drawIcon(yat::Canvas& cv, const char* name, int x, int y, int size, yat::Ink ink) {
  const uint8_t* bits = nullptr;
  if (!yat::iconBitmap(name, bits)) return;
  int scale = size / yat::kIconBase;
  if (scale < 1) scale = 1;
  for (int row = 0; row < yat::kIconBase; row++) {
    const uint8_t* r = bits + row * yat::kIconStride;
    uint32_t packed = ((uint32_t)r[0] << 16) | ((uint32_t)r[1] << 8) | (uint32_t)r[2];
    for (int col = 0; col < yat::kIconBase; col++)
      if (packed & (0x800000u >> col))
        cv.fillRect(x + col * scale, y + row * scale, scale, scale, ink);
  }
}

}  // namespace prov

// G4 (PRD's own "#1 predictable support issue"): nothing told a phone-only
// user the AP/home network has to be 2.4 GHz. Same wording wherever the user
// might be looking — the e-paper screen (drawProvisioningScreen, below) and
// the portal page (runProvisioningMode's setCustomHeadElement, below) — so
// keep the two literals in sync if this ever changes.
static const char WIFI_24GHZ_NOTICE[] = "只支援 2.4GHz WiFi · 2.4 GHz networks only";

// Provisioning screen: chrome mirrors the engine's "standard" chrome
// (engine/src/render.cpp Engine::render — 44px header + rule, 32px footer +
// rule, brand bottom-right) so the device looks like itself even before any
// pack has loaded. Bilingual per PRD §4.1 (zh-Hant / EN); reasonZh/reasonEn
// name which of the three triggers brought the device here.
void drawProvisioningScreen(const char* reasonZh, const char* reasonEn) {
  EPaperCanvas canvas;
  yat::DefaultFontProvider font;
  const int W = SCREEN_W, H = SCREEN_H;
  canvas.fillRect(0, 0, W, H, yat::Ink::White);

  prov::drawText(canvas, font, 16, 7, "設定 WiFi   Set up WiFi", 24, yat::Ink::Black, true);
  canvas.fillRect(0, 43, W, 1, yat::Ink::Black);
  if (reasonZh && reasonEn) {
    char buf[96];
    snprintf(buf, sizeof(buf), "%s / %s", reasonZh, reasonEn);
    prov::drawText(canvas, font, 16, 54, buf, 16, yat::Ink::Blue);
  }

  // ONE QR per screen — a user-tested rule, not a style choice: two same-weight
  // scan targets made people scan the fallback first or freeze. The QR joins
  // the AP; everything the second QR used to do (the page didn't pop up, the
  // camera can't scan) is now the subordinate TEXT block on the right.
  const int qrSize = 260, qrY = 88, qrX = 40;
  prov::drawQR(canvas, g_qrWifiPayload, qrX, qrY, qrSize);
  {
    const char* zh = "用手機掃我";
    const char* en = "Scan with your phone";
    int cx = qrX + qrSize / 2;
    prov::drawText(canvas, font, cx - prov::textWidth(zh, 16) / 2, qrY + qrSize + 12, zh, 16,
                   yat::Ink::Black);
    prov::drawText(canvas, font, cx - prov::textWidth(en, 16) / 2, qrY + qrSize + 32, en, 16,
                   yat::Ink::Black);
  }

  const int rx = 340;
  prov::drawText(canvas, font, rx, 96, "手機掃左邊個 QR", 32, yat::Ink::Black, true);
  prov::drawText(canvas, font, rx, 140, "跟住等設定頁自動彈出（大約 10 秒）", 24, yat::Ink::Black);
  prov::drawText(canvas, font, rx, 176, "Scan the QR, then wait — the setup", 16, yat::Ink::Black);
  prov::drawText(canvas, font, rx, 196, "page opens on its own.", 16, yat::Ink::Black);

  // G4: 2.4 GHz reminder, right where the network gets picked.
  prov::drawText(canvas, font, rx, 224, WIFI_24GHZ_NOTICE, 16, yat::Ink::Blue);

  // The fallback block: everything QR ② used to do, as text a person only
  // reads when the happy path failed. Blue rule marks it as the side door.
  canvas.fillRect(rx, 258, 4, 108, yat::Ink::Blue);
  const int fx = rx + 16;
  prov::drawText(canvas, font, fx, 264, "頁面唔彈？或者掃唔到？ No page? Can't scan?", 16,
                 yat::Ink::Black, true);
  char manualLine[112];
  snprintf(manualLine, sizeof(manualLine), "WiFi「%s」 密碼 %s", g_apSsid, g_apPass);
  prov::drawText(canvas, font, fx, 288, manualLine, 24, yat::Ink::Black);
  prov::drawText(canvas, font, fx, 324, "手動連咗之後，喺瀏覽器開 then open", 16, yat::Ink::Black);
  prov::drawText(canvas, font, fx, 344, "http://192.168.4.1", 24, yat::Ink::Blue, true);

  canvas.fillRect(0, H - 32, W, 1, yat::Ink::Black);
  char fwLine[32];
  snprintf(fwLine, sizeof(fwLine), "fw %s", FW_VERSION);
  prov::drawText(canvas, font, 16, H - 26, fwLine, 16, yat::Ink::Black);
  std::string brand = "YAT 日";
  prov::drawText(canvas, font, W - 16 - prov::textWidth(brand, 16), H - 26, brand, 16,
                 yat::Ink::Black);
}

// Shared bottom rule + "fw x.y.z" / "YAT 日" line every firmware-owned status
// screen draws (provisioning above, offline/low-battery below) — pulled out
// once these screens are outnumbering the copies of it.
void drawStandardFooter(yat::Canvas& canvas, yat::FontProvider& font) {
  const int W = SCREEN_W, H = SCREEN_H;
  canvas.fillRect(0, H - 32, W, 1, yat::Ink::Black);
  char fwLine[32];
  snprintf(fwLine, sizeof(fwLine), "fw %s", FW_VERSION);
  prov::drawText(canvas, font, 16, H - 26, fwLine, 16, yat::Ink::Black);
  std::string brand = "YAT 日";
  prov::drawText(canvas, font, W - 16 - prov::textWidth(brand, 16), H - 26, brand, 16,
                 yat::Ink::Black);
}



ScreenCard loadScreenCard() {
  Preferences prefs;
  prefs.begin("yat", true);
  uint8_t v = prefs.getUChar("card_on_screen", 0);
  prefs.end();
  return v <= (uint8_t)ScreenCard::SafeMode ? (ScreenCard)v : ScreenCard::None;
}

void saveScreenCard(ScreenCard card) {
  Preferences prefs;
  prefs.begin("yat", false);
  prefs.putUChar("card_on_screen", (uint8_t)card);
  prefs.end();
}

// docs/UX-FLOWS.md G5/G12, docs/UX-NONTECH.md §6 (May's S8): the device's own
// channel for the one case that otherwise leaves the panel silently showing
// nothing new — the WiFi join itself never came up. Everything on it points at
// the household's own network, so it is ONLY for that case; a cycle that joined
// WiFi fine and lost its sources upstream gets drawNoDataCard() below, which
// blames nobody's router. Deliberately NOT drawn for a stale-serve cycle (old
// data plus the footer's own "stale" marker is the right, calmer signal for
// that — see engine/src/render.cpp), only for a cycle with nothing at all, old
// or new, to show. Same chrome + prov:: helpers as drawProvisioningScreen so
// the device still looks like itself; see trackOfflineCycle() below for why
// this is only called on the first such cycle in a streak.
void drawOfflineCard() {
  LOGF("[epd] init (offline card)...\n");
  epaper.begin();
  g_panelReady = true;

  EPaperCanvas canvas;
  yat::DefaultFontProvider font;
  const int W = SCREEN_W, H = SCREEN_H;
  canvas.fillRect(0, 0, W, H, yat::Ink::White);

  prov::drawText(canvas, font, 16, 7, "上唔到網   Can't reach the internet", 24, yat::Ink::Black,
                 true);
  canvas.fillRect(0, 43, W, 1, yat::Ink::Black);

  const int iconSize = 96;
  prov::drawIcon(canvas, "wifi", (W - iconSize) / 2, 84, iconSize, yat::Ink::Black);

  auto centerLine = [&](int y, const char* zh, const char* en) {
    prov::drawText(canvas, font, (W - prov::textWidth(zh, 16)) / 2, y, zh, 16, yat::Ink::Black);
    prov::drawText(canvas, font, (W - prov::textWidth(en, 16)) / 2, y + 18, en, 16,
                   yat::Ink::Black);
  };
  centerLine(210, "檢查下屋企 WiFi。", "Check your home WiFi.");
  centerLine(256, "如果搬咗屋或者換咗路由器：", "Moved house or new router?");
  // Never "5 秒". The threshold is measured from the press, but the press
  // happens while the device is asleep and the sampling only starts once boot
  // reaches readKey0GestureAtWake() — so a real hold is 5 to 10 seconds of
  // somebody's thumb, and telling them "5" is how a correct hold gets released
  // one second early and reads as a device that ignores its own button. The
  // beep at the threshold (beepHoldConfirmed) is the only honest signal there
  // is, and it is what this points at.
  centerLine(302, "撳住綠色掣，聽到「嘀」一聲先放手（通常 5–10 秒），就可以重新設定",
             "Hold the green button until it beeps (usually 5–10 s) to set up again.");

  drawStandardFooter(canvas, font);

  panelRefresh("");
}

// The other half of G5/G12: WiFi joined, and the pack's own sources are what
// went quiet. The offline card above would blame the household's router and
// send them to hold the green button — a re-provisioning that fixes nothing and
// costs them their working credentials. Nothing here is actionable on purpose:
// an upstream outage is not the user's to repair, and the device already
// retries on its own cadence. Names the page so a multi-page device says WHICH
// page lost its data rather than implying the whole thing is broken.
void drawNoDataCard(const char* pageId) {
  LOGF("[epd] init (no-data card, page \"%s\")...\n", pageId ? pageId : "?");
  epaper.begin();
  g_panelReady = true;

  EPaperCanvas canvas;
  yat::DefaultFontProvider font;
  const int W = SCREEN_W, H = SCREEN_H;
  canvas.fillRect(0, 0, W, H, yat::Ink::White);

  prov::drawText(canvas, font, 16, 7, "暫時攞唔到資料   No data right now", 24, yat::Ink::Black,
                 true);
  canvas.fillRect(0, 43, W, 1, yat::Ink::Black);

  const int iconSize = 96;
  prov::drawIcon(canvas, "cloud", (W - iconSize) / 2, 76, iconSize, yat::Ink::Black);

  char pageLine[96];
  snprintf(pageLine, sizeof pageLine, "版 page: %s", pageId && *pageId ? pageId : "—");
  prov::drawText(canvas, font, (W - prov::textWidth(pageLine, 16)) / 2, 186, pageLine, 16,
                 yat::Ink::Black);

  auto centerLine = [&](int y, const char* zh, const char* en) {
    prov::drawText(canvas, font, (W - prov::textWidth(zh, 16)) / 2, y, zh, 16, yat::Ink::Black);
    prov::drawText(canvas, font, (W - prov::textWidth(en, 16)) / 2, y + 18, en, 16,
                   yat::Ink::Black);
  };
  centerLine(232, "呢版嘅資料來源暫時攞唔到。", "This page's data source isn't answering.");
  centerLine(278, "你屋企嘅 Wi-Fi 冇問題。", "Your Wi-Fi is fine.");
  centerLine(324, "遲啲會自動再試。", "It will retry by itself.");

  drawStandardFooter(canvas, font);

  panelRefresh("");
}

// What replaces the setup screen when the WiFi portal times out with nobody
// having completed it (audit #15). E-paper holds its last image with the power
// off, so the alternative is a panel left showing two live-looking QR codes and
// an AP name for a network that has been down for hours — someone who walks up
// tomorrow scans a code that goes nowhere and concludes the device is broken.
// This says what happened and gives them the one gesture that undoes it. The AP
// is already down by the time this is called (the power rule: never refresh
// with the transmitter up) — see runProvisioningMode's timeout branch.
void drawSetupClosedCard() {
  LOGF("[epd] init (setup-closed card)...\n");
  epaper.begin();
  g_panelReady = true;

  EPaperCanvas canvas;
  yat::DefaultFontProvider font;
  const int W = SCREEN_W, H = SCREEN_H;
  canvas.fillRect(0, 0, W, H, yat::Ink::White);

  prov::drawText(canvas, font, 16, 7, "設定閂咗   Setup closed", 24, yat::Ink::Black, true);
  canvas.fillRect(0, 43, W, 1, yat::Ink::Black);

  const int iconSize = 96;
  prov::drawIcon(canvas, "clock", (W - iconSize) / 2, 84, iconSize, yat::Ink::Black);

  auto centerLine = [&](int y, const char* zh, const char* en) {
    prov::drawText(canvas, font, (W - prov::textWidth(zh, 16)) / 2, y, zh, 16, yat::Ink::Black);
    prov::drawText(canvas, font, (W - prov::textWidth(en, 16)) / 2, y + 18, en, 16,
                   yat::Ink::Black);
  };
  centerLine(210, "等咗 10 分鐘冇人設定，所以停咗。", "Setup waited 10 minutes and closed.");
  centerLine(256, "撳住綠色掣，聽到「嘀」一聲先放手（通常 5–10 秒），就可以再開。",
             "Hold the green button until it beeps (usually 5–10 s) to open it again.");
  centerLine(302, "部機會自己再試連 WiFi。", "The device keeps trying your Wi-Fi on its own.");

  drawStandardFooter(canvas, font);

  panelRefresh("");
}

// audit #18: the panel's half of the crash-loop breaker (PANIC_SAFE_MODE_N).
// The hard part of this card is tone. From the household's side nothing visibly
// happened — the screen simply stopped changing — and the true explanation
// ("the firmware faulted three times running") is both frightening and useless
// to them. So it says what the device DID (stopped, on purpose), what they can
// do about it (the same green button every other screen here points at, leading
// to the page picker where a bad page can be swapped out), and that doing
// nothing is also a valid answer, because the device will try again by itself.
// Deliberately no error code, no page name, no blame: the log has all of that
// and the panel is not a debugger.
void drawSafeModeCard() {
  LOGF("[epd] init (safe-mode card)...\n");
  epaper.begin();
  g_panelReady = true;

  EPaperCanvas canvas;
  yat::DefaultFontProvider font;
  const int W = SCREEN_W, H = SCREEN_H;
  canvas.fillRect(0, 0, W, H, yat::Ink::White);

  prov::drawText(canvas, font, 16, 7, "暫時停低咗   Paused for now", 24, yat::Ink::Black, true);
  canvas.fillRect(0, 43, W, 1, yat::Ink::Black);

  const int iconSize = 96;
  prov::drawIcon(canvas, "info", (W - iconSize) / 2, 84, iconSize, yat::Ink::Black);

  auto centerLine = [&](int y, const char* zh, const char* en) {
    prov::drawText(canvas, font, (W - prov::textWidth(zh, 16)) / 2, y, zh, 16, yat::Ink::Black);
    prov::drawText(canvas, font, (W - prov::textWidth(en, 16)) / 2, y + 18, en, 16,
                   yat::Ink::Black);
  };
  centerLine(210, "部機重開咗幾次，所以暫時唔畫版住。",
             "The device restarted a few times, so it has paused its pages.");
  // 「試吓」 is gone along with the 5 秒 claim, and not only for the copy rule:
  // 吓 (U+5413) is not in the 16px face the cards draw with, and a codepoint
  // prov::drawText cannot find is drawn as nothing at all — the line has been
  // rendering as 「揀過另一版試」 on real hardware.
  centerLine(256, "撳住綠色掣，聽到「嘀」一聲先放手（通常 5–10 秒），開設定揀過另一版。",
             "Hold the green button until it beeps (usually 5–10 s), then pick another page in setup.");
  centerLine(302, "唔理佢都得——一個鐘之後部機會自己再試。",
             "Or leave it — the device tries again by itself in an hour.");

  drawStandardFooter(canvas, font);

  panelRefresh("");
}

// ---------------- help card (◀+▶) ----------------
//
// Everything a household needs in order to use this device without a phone in
// their hand: which pages they have, what each one answers to out loud, and
// what the three buttons do. The two arrows pressed together are the only
// gesture that was still unassigned, which makes it the natural place for
// "what can this thing do" — and it is discoverable from the panel itself,
// since every normally-rendered page's footer already prints that page's own
// voice words (engine/src/render.cpp) and setup.html says the rest.

// Trims `s` to at most `maxW` px at face size `px`, ellipsizing on a codepoint
// boundary. Same intent as the engine's own `ellipsize`, which is file-private
// to render.cpp; the firmware screens have no widget tree to clip against, so
// every column here has to measure itself.
static std::string fitText(const std::string& s, int px, int maxW, bool bold = false) {
  if (prov::textWidth(s, px, bold) <= maxW) return s;
  static const char* kEllipsis = "…";
  int ellW = prov::textWidth(kEllipsis, px, bold);
  std::string out = s;
  while (!out.empty() && prov::textWidth(out, px, bold) + ellW > maxW) {
    size_t cut = out.size();
    while (cut > 0 && ((unsigned char)out[cut - 1] & 0xC0) == 0x80) cut--;  // UTF-8 continuation
    if (cut > 0) cut--;
    out.resize(cut);
  }
  while (!out.empty() && out.back() == ' ') out.pop_back();
  return out + kEllipsis;
}

// One row of the card's page list, gathered before the canvas exists so a
// pack's JsonDocument and the render never hold memory at the same time.
struct HelpPageRow {
  std::string name;   // "現時天氣 Weather Now", or the page id if the pack is unreadable
  std::string words;  // "「天氣」「weather」", already bracketed; empty if the page has none
};

// Reads each page's pack file for its display name and takes its voice words
// straight out of the matcher's own cache — so the card can only ever print
// words the device would actually act on, including a household's config.json
// overrides. Deliberately NOT folded into buildPageAliasCache(): that runs on
// every single wake, and re-parsing every pack for a name is work only this
// card ever needs.
static void collectHelpRows(std::vector<HelpPageRow>& rows) {
  rows.clear();
  for (size_t i = 0; i < g_pages.size(); i++) {
    const ConfigPage& page = g_pages[i];
    HelpPageRow row;
    if (g_fsReady) {
      std::string packJson;
      std::string path = "/packs/" + page.pack + ".yat-pack.json";
      if (littlefsReadFile(path.c_str(), packJson)) {
        JsonDocument doc;  // scoped: freed before the next page's read
        if (!deserializeJson(doc, packJson, DeserializationOption::NestingLimit(24))) {
          const char* en = doc["name"]["en"] | "";
          const char* zh = doc["name"]["zh-Hant"] | "";
          if (zh[0] != '\0') row.name = zh;
          if (en[0] != '\0') row.name += (row.name.empty() ? "" : "  ") + std::string(en);
        }
      }
    }
    // A page whose pack went missing still belongs on this list — it is one of
    // the household's pages, and the id is what the settings page calls it.
    if (row.name.empty()) row.name = page.id;

    // Up to three words, best first: the household's own aliases, then
    // Cantonese, then English. Jyutping is skipped entirely (kAliasJyut) —
    // it is a spelling for the matcher, not something anybody says.
    int shown = 0;
    if (i < g_pageAliases.size()) {
      for (uint8_t group = kAliasUser; group <= kAliasEn && shown < 3; group++) {
        for (const NormalizedAlias& alias : g_pageAliases[i].aliases) {
          if (alias.group != group || alias.display.empty()) continue;
          row.words += "「" + alias.display + "」";
          if (++shown >= 3) break;
        }
      }
    }
    rows.push_back(row);
  }
}

void drawHelpCard(int batteryPct) {
  std::vector<HelpPageRow> rows;
  collectHelpRows(rows);

  LOGF("[epd] init (help card, %u page(s))...\n", (unsigned)rows.size());
  epaper.begin();
  g_panelReady = true;

  EPaperCanvas canvas;
  yat::DefaultFontProvider font;
  const int W = SCREEN_W, H = SCREEN_H;
  canvas.fillRect(0, 0, W, H, yat::Ink::White);

  prov::drawText(canvas, font, 16, 7, "幫助 · Help", 24, yat::Ink::Black, true);
  char battLine[24];
  snprintf(battLine, sizeof battLine, "電量 battery %d%%", batteryPct);
  prov::drawText(canvas, font, W - 16 - prov::textWidth(battLine, 16), 14, battLine, 16,
                 batteryPct <= 20 ? yat::Ink::Red : yat::Ink::Black);
  canvas.fillRect(0, 43, W, 1, yat::Ink::Black);

  // Bottom block first: it is fixed, and what is left over is what the page
  // list gets. Worked upward from the footer rule so adding a line here can
  // never silently push the last page row under it.
  const int kFooterRuleY = H - 32;
  const int kDismissY = kFooterRuleY - 24;
  const int kSetupEnY = kDismissY - 20;
  const int kSetupZhY = kSetupEnY - 20;
  const int kLegendY = kSetupZhY - 30;
  const int kLegendHeadY = kLegendY - 22;

  prov::drawText(canvas, font, 16, 52, "你嘅版 Your pages", 16, yat::Ink::Blue);

  const int kRowH = 22;
  const int kListTop = 76;
  const int kNameX = 40, kWordsX = 340;
  int maxRows = (kLegendHeadY - 12 - kListTop) / kRowH;
  if (maxRows < 1) maxRows = 1;
  int listed = (int)rows.size() < maxRows ? (int)rows.size() : maxRows;
  // One row is given up to say how many pages did not fit, rather than ending
  // the list somewhere arbitrary and letting a 16-page household believe four
  // of their pages are gone.
  const bool truncated = (int)rows.size() > listed;
  if (truncated) listed--;

  if (rows.empty()) {
    prov::drawText(canvas, font, kNameX, kListTop, "（仲未揀版 · no pages yet）", 16,
                   yat::Ink::Black);
  }
  for (int i = 0; i < listed; i++) {
    int y = kListTop + i * kRowH;
    char num[8];
    snprintf(num, sizeof num, "%d.", i + 1);
    prov::drawText(canvas, font, 16, y, num, 16,
                   i == g_activePageIdx ? yat::Ink::Blue : yat::Ink::Black);
    // The page currently on the panel is marked, because "which one am I
    // looking at" is the other half of the question this card answers.
    prov::drawText(canvas, font, kNameX, y, fitText(rows[i].name, 16, kWordsX - kNameX - 12), 16,
                   i == g_activePageIdx ? yat::Ink::Blue : yat::Ink::Black,
                   i == g_activePageIdx);
    if (rows[i].words.empty()) {
      prov::drawText(canvas, font, kWordsX, y, "（冇設定叫法 · no voice words）", 16,
                     yat::Ink::Black);
    } else {
      prov::drawText(canvas, font, kWordsX, y, fitText(rows[i].words, 16, W - 16 - kWordsX), 16,
                     yat::Ink::Black);
    }
  }
  if (truncated) {
    char more[64];
    snprintf(more, sizeof more, "…仲有 %d 版 · %d more page(s)", (int)rows.size() - listed,
             (int)rows.size() - listed);
    prov::drawText(canvas, font, kNameX, kListTop + listed * kRowH, more, 16, yat::Ink::Black);
  }

  prov::drawText(canvas, font, 16, kLegendHeadY, "掣 Buttons", 16, yat::Ink::Blue);
  // The green dot is the green button, in the panel's own green ink — the same
  // stand-in the page footers use, so the two read as one vocabulary.
  //
  // ← → rather than the ◀ ▶ the spec drafts used: the panel's faces carry no
  // U+25C0/U+25B6, and prov::drawText draws nothing at all for a codepoint it
  // cannot find, so those would have left a button legend with no buttons in
  // it. the website's setup page says ← → for the same reason — one vocabulary.
  int x = prov::drawText(canvas, font, 40, kLegendY, "← → 轉版 previous/next    ", 16,
                         yat::Ink::Black);
  x = prov::drawText(canvas, font, x, kLegendY, "●", 16, yat::Ink::Green);
  x = prov::drawText(canvas, font, x + 4, kLegendY, "一撳 tap = 講嘢 speak    ", 16,
                     yat::Ink::Black);
  x = prov::drawText(canvas, font, x, kLegendY, "●", 16, yat::Ink::Green);
  // The legend is a key, not an instruction, so it names the gesture by its
  // end condition (a sound) rather than by a duration it cannot promise; the
  // two lines below are where the full version lives.
  prov::drawText(canvas, font, x + 4, kLegendY, "撳住直到有聲 hold = 設定 setup", 16,
                 yat::Ink::Black);

  prov::drawText(canvas, font, 40, kSetupZhY,
                 "想加或者改版：撳住綠色掣，聽到「嘀」一聲先放手（通常 5–10 秒），再用手機掃 QR",
                 16, yat::Ink::Black);
  prov::drawText(canvas, font, 40, kSetupEnY,
                 "To add or change pages: hold the green button until it beeps (5–10 s), then scan the QR.",
                 16, yat::Ink::Black);

  const char* dismiss = "撳任何掣返去 · Press any button to go back";
  prov::drawText(canvas, font, (W - prov::textWidth(dismiss, 16)) / 2, kDismissY, dismiss, 16,
                 yat::Ink::Blue);

  drawStandardFooter(canvas, font);

  panelRefresh("");
}

// G25/G26: rendered instead of the normal cycle whenever batteryPercent()
// reads below LOW_BATTERY_PCT — see its call site in setup(). Red ink on the
// icon and percent only, so the one thing demanding attention is the thing
// drawn red; the rest of the chrome stays black like every other
// firmware-owned card.
void drawLowBatteryCard(int pct) {
  LOGF("[epd] init (low battery card)...\n");
  epaper.begin();
  g_panelReady = true;

  EPaperCanvas canvas;
  yat::DefaultFontProvider font;
  const int W = SCREEN_W, H = SCREEN_H;
  canvas.fillRect(0, 0, W, H, yat::Ink::White);

  prov::drawText(canvas, font, 16, 7, "低電量   Low battery", 24, yat::Ink::Red, true);
  canvas.fillRect(0, 43, W, 1, yat::Ink::Black);

  const int iconSize = 96;
  prov::drawIcon(canvas, "battery", (W - iconSize) / 2, 90, iconSize, yat::Ink::Red);

  char pctLine[8];
  snprintf(pctLine, sizeof(pctLine), "%d%%", pct);
  prov::drawText(canvas, font, (W - prov::textWidth(pctLine, 32, true)) / 2, 90 + iconSize + 12,
                 pctLine, 32, yat::Ink::Red, true);

  prov::drawText(canvas, font, (W - prov::textWidth("請充電   Please charge", 16)) / 2, 300,
                 "請充電   Please charge", 16, yat::Ink::Black);

  // This card is drawn once per low-battery streak (see its call site), so the
  // percent above is a snapshot and the panel will not change on its own the
  // moment the charger goes in. Say what actually brings the screen back.
  prov::drawText(canvas, font, (W - prov::textWidth("叉滿電後撳任何掣", 16)) / 2, 344,
                 "叉滿電後撳任何掣", 16, yat::Ink::Black);
  prov::drawText(canvas, font, (W - prov::textWidth("After charging, press any button.", 16)) / 2,
                 362, "After charging, press any button.", 16, yat::Ink::Black);

  drawStandardFooter(canvas, font);

  panelRefresh("");
}

// G5/G12: true iff every field the engine extracted this cycle is null —
// i.e. no source had anything to offer, not even a stale snapshot. A pack
// declaring zero extract fields would vacuously read as "all null" too, but
// every real pack has at least one, so this never fires for a cycle that
// actually fetched something.
bool engineDataAllNull(JsonVariantConst data) {
  for (JsonPairConst kv : data.as<JsonObjectConst>())
    if (!kv.value().isNull()) return false;
  return true;
}

// G5/G12: tracks consecutive "no data at all" cycles in NVS ("yat"/
// "offline_n") so drawOfflineCard() — and the ~30 s refresh it costs — is
// only spent on the FIRST cycle of a streak, the same state-transition
// pattern g_takeoverChanged uses for the warning-takeover page (see "Warning
// takeover" below). Returns true exactly on the transition INTO offline
// (draw the card); sets `recovered` true on the transition back OUT of it,
// so the caller can force a normal-page render this cycle even if the hash
// happens to match the offline card's own last-stored value.
bool trackOfflineCycle(bool offlineThisCycle, bool& recovered) {
  Preferences prefs;
  prefs.begin("yat", false);
  uint32_t prevCount = prefs.getUInt("offline_n", 0);
  uint32_t newCount = offlineThisCycle ? prevCount + 1 : 0;
  prefs.putUInt("offline_n", newCount);
  prefs.end();

  bool firstOffline = offlineThisCycle && prevCount == 0;
  recovered = !offlineThisCycle && prevCount > 0;
  LOGF("[offline] %s -- consecutive=%u%s%s\n", offlineThisCycle ? "offline" : "online",
       (unsigned)newCount, firstOffline ? " (first -- drawing card)" : "",
       recovered ? " (recovered -- forcing render)" : "");
  return firstOffline;
}
