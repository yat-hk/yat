// Generated by the main.cpp module split: the code below is a verbatim
// slice of the original single-translation-unit firmware/src/main.cpp.

#include "yat_portal.h"

#include <cctype>
#include <stdio.h>
#include <string.h>

#include <ArduinoJson.h>
#include <ESPmDNS.h>
#include <LittleFS.h>
#include <Preferences.h>
#include <WebServer.h>
#include <WiFi.h>

#include "portal_page.h"
#include "welcome_pack.h"

#include "yat_beep.h"
#include "yat_buttons.h"
#include "yat_config.h"
#include "yat_console.h"
#include "yat_errors.h"
#include "yat_hw.h"
#include "yat_llm.h"
#include "yat_net.h"
#include "yat_ota.h"
#include "yat_provision.h"
#include "yat_sched.h"
#include "yat_screens.h"
#include "yat_voice.h"
#include "yat_state.h"

// ---------------- content portal (device-hosted setup) ----------------
//
// The content half of setup, and the only half a phone can do on its own. The
// device brings up an HTTP server on the LAN (and on its own AP as a fallback),
// puts the URL and a QR for it on the panel, and serves a ~1.7 KB bootstrap
// that pulls the real UI down from the public site — portal_page.h explains why
// that is the only direction browsers allow. The site keeps owning the pack
// library; the device owns the files and the panel. No USB, no serial, no
// desktop: the recurring "change what it shows" errand costs a button hold.
//
// Three things arrive here, all leaving the same way:
//   - green button held 5 s with credentials on file -> straight in
//   - the same gesture, or a first boot, with no credentials -> WiFi
//     provisioning first, then in, with no reboot between the two
//   - `YAT PORTAL` on the console (dev/recovery, and how a test rig drives it)
//
// Power rule, learned the hard way — see runProvisioningMode's comment: the AP
// radio and a 30 s panel refresh must never draw at once. So every refresh in
// here happens with the AP down. Screen B is drawn before the AP first comes
// up; the mid-session apply refresh drops the AP and restores it afterwards.
// STA stays up throughout, because STA + refresh is what every normal cycle
// already does and has never browned out. The HTTP server is not a radio and is
// not part of that rule: it starts listening before the refresh, so the address
// printed on screen B answers from the moment the ink is readable.

static WebServer* g_portalServer = nullptr;
static uint32_t g_portalLastHitMs = 0;
static bool g_portalDone = false;          // POST /api/done
static bool g_portalApplyPending = false;  // POST /api/apply; the refresh itself is the loop's job

// Every /api/* hit restarts the idle clock (D2). Returns the seconds that were
// left BEFORE this hit — which is what /api/status reports as "idle_s", so the
// UI can say how long setup has left instead of guessing. Reporting seconds
// *elapsed* would be useless here: the request asking the question is itself
// the thing that resets the clock, so the answer would always be zero.
static uint32_t portalTouchIdle() {
  uint32_t elapsed = millis() - g_portalLastHitMs;
  g_portalLastHitMs = millis();
  return elapsed >= CONTENT_PORTAL_IDLE_MS ? 0 : (CONTENT_PORTAL_IDLE_MS - elapsed) / 1000;
}

static void jsonEscapeInto(const char* s, std::string& out) {
  for (const char* p = s; *p; p++) {
    unsigned char c = (unsigned char)*p;
    switch (c) {
      case '"': out += "\\\""; break;
      case '\\': out += "\\\\"; break;
      case '\n': out += "\\n"; break;
      case '\r': out += "\\r"; break;
      case '\t': out += "\\t"; break;
      default:
        // UTF-8 continuation bytes pass through untouched — JSON strings carry
        // them literally. Only C0 controls need the \u form.
        if (c < 0x20) {
          char esc[8];
          snprintf(esc, sizeof esc, "\\u%04x", c);
          out += esc;
        } else {
          out += (char)c;
        }
    }
  }
}

static void jsonAppendInt(std::string& out, long v) {
  char buf[24];
  snprintf(buf, sizeof buf, "%ld", v);
  out += buf;
}

static void portalSendJson(int code, const std::string& body) {
  g_portalServer->send(code, "application/json", body.c_str());
}

// The error kinds the portal contract names, so the UI can say something
// specific rather than "something went wrong": badjson, toobig, badname,
// nospace, notfound, busy, fs, and fwold.
//
// "fs" is deliberately separate from "nospace". Both used to answer !g_fsReady,
// which made the UI tell a household with an unmountable filesystem to delete a
// page to make room — advice that cannot work and that costs them a page for
// nothing. A volume that is full is a user problem; a volume that would not
// mount is a device problem, and only the site can say so if the device says
// which one it is. They carry different status codes to match: 507 stays
// reserved for nospace, and "fs" answers 503 — the storage is not there right
// now, which is what a 503 means.
//
// `detail` is optional and, today, only carried by badjson: "parse" (the bytes
// are not JSON), "nesting" (valid JSON past ArduinoJson's depth limit — the
// failure a deep gallery pack hits, and one whose fix is nothing like the
// others') or "schema" (parsed fine, wrong shape). One badjson word for three
// unrelated faults sent people to re-download a file that was never the
// problem. Those three tokens are a sealed cross-lane contract: the site has a
// bilingual sentence per token and generic copy for anything else, so a fourth
// token cannot be added here without telling the site lane first.
//
// fwold is PACK-SPEC's min_firmware gate (portalHandlePackPost): the pack
// parsed fine and its id and body are both fine, but it names a firmware
// version this device has not reached yet, so installing it would put a page
// on the panel whose behaviour the household was never told is partial (the
// motivating case: a pack whose voice intents are silent on older firmware).
// It carries its OWN field, `need` — the pack's min_firmware value, verbatim
// — rather than reusing `detail`: `detail` is sealed to badjson's three
// parse-outcome words above, and a version string is a different kind of
// fact, not a fourth spelling of "how the JSON failed". `need` is its own
// sealed cross-lane contract in exactly the same way: the site reads it to
// name the version in its bilingual sentence, so renaming or repurposing that
// field breaks that lane silently. See portalSendFwOld.
static void portalSendError(int code, const char* kind, const char* detail = nullptr) {
  char buf[80];
  if (detail)
    snprintf(buf, sizeof buf, "{\"error\":\"%s\",\"detail\":\"%s\"}", kind, detail);
  else
    snprintf(buf, sizeof buf, "{\"error\":\"%s\"}", kind);
  g_portalServer->send(code, "application/json", buf);
}

// fwold's own sender: {"error":"fwold","need":"X.Y.Z"}. 409 Conflict, not 400
// — the request itself is well-formed (unlike badjson/badname/toobig) and
// will succeed unmodified once the device's firmware changes; that is what
// distinguishes a conflict with current state from a bad request, and it is
// the same reasoning that already gives OTA_ERR_BUSY 409 above in
// portalHandleUpdatePost. Built through jsonEscapeInto rather than a fixed
// snprintf buffer because `need` is a pack's min_firmware value echoed back
// verbatim: PACK-SPEC restricts it to ^[0-9]+\.[0-9]+\.[0-9]+$, but that is a
// publish-time check this device does not re-run, so a hostile or corrupt
// pack's string is untrusted the same way an SSID or a page id is above.
static void portalSendFwOld(const char* need) {
  std::string body = "{\"error\":\"fwold\",\"need\":\"";
  jsonEscapeInto(need, body);
  body += "\"}";
  g_portalServer->send(409, "application/json", body.c_str());
}

// Which of badjson's three details an ArduinoJson failure is. TooDeep is the
// one worth splitting out by name: it means the file IS valid JSON and the
// device simply would not go that deep, which is a firmware limit rather than
// anything the user did to the file.
static const char* portalJsonDetail(DeserializationError de) {
  return de == DeserializationError::TooDeep ? "nesting" : "parse";
}

// Pack ids become filenames under /packs/, so they are checked, not trusted:
// the same [a-z0-9-] shape PACK-SPEC §3 already restricts them to, which also
// makes "../" and every other traversal spelling unrepresentable.
static bool portalPackIdOk(const String& id) {
  if (id.length() < 1 || id.length() > 48) return false;
  for (unsigned i = 0; i < id.length(); i++) {
    char c = id[i];
    if (!((c >= 'a' && c <= 'z') || (c >= '0' && c <= '9') || c == '-')) return false;
  }
  return true;
}

static std::string portalPackPath(const String& id) {
  return std::string("/packs/") + id.c_str() + ".yat-pack.json";
}

// Parses the leading "X.Y.Z" off a version string, stopping at the first
// character that is not a digit or '.'. That boundary is deliberately the
// same one the site's firmwareIsAtLeast() (device-portal.js) treats a build
// suffix as starting at, so a "-dev+hash" or "+hash" tail is ignored on both
// sides of the wire the same way: a -dev build of X.Y.Z counts as X.Y.Z here,
// matching FW_VERSION's own shape ("0.4.0+a1b2c3d", historically
// "0.4.0-dev+hash"). A part with no digits before the next '.' or the string
// end defaults to 0, so "0.4" parses as 0.4.0. Returns false only when there
// was no digit anywhere, which the caller reads as "cannot tell" rather than
// "fails the check" — see portalFirmwareAtLeast.
static bool portalParseSemver(const char* s, int out[3]) {
  out[0] = out[1] = out[2] = 0;
  if (!s) return false;
  int part = 0;
  bool sawDigit = false;
  for (; *s && part < 3; s++) {
    if (*s >= '0' && *s <= '9') {
      sawDigit = true;
      if (out[part] < 1000000) out[part] = out[part] * 10 + (*s - '0');
    } else if (*s == '.') {
      part++;
    } else {
      break;
    }
  }
  return sawDigit;
}

// True when the device's own firmware is numerically >= a pack's
// min_firmware requirement (PACK-SPEC's optional root member). Either side
// failing to parse as digits-and-dots returns true — never blocks — on the
// same reasoning as portalPackVersion's "0.0.0" fallback: FW_VERSION is this
// firmware's own compile-time constant, and a min_firmware that does not even
// parse is a pack-authoring mistake the schema should have caught upstream,
// not something worth bricking an install over down here.
static bool portalFirmwareAtLeast(const char* fw, const char* need) {
  int have[3], want[3];
  if (!portalParseSemver(fw, have) || !portalParseSemver(need, want)) return true;
  for (int i = 0; i < 3; i++) {
    if (have[i] != want[i]) return have[i] > want[i];
  }
  return true;
}

// Request bodies come through WebServer's own buffered read (server.arg
// ("plain")) rather than its streaming raw-handler path, because the raw path
// skips query-string parsing entirely — with a raw handler registered,
// "?id=<packId>" never reaches arg(), and the API contract puts the pack id
// exactly there. The read is still bounded in the ways that matter on this
// board: sdkconfig sets CONFIG_SPIRAM_MALLOC_ALWAYSINTERNAL=4096, so any body
// over 4 KB is served out of the 8 MB PSRAM and never touches the ~300 KB
// internal heap; WebServer grows that buffer from what the socket actually
// delivered, so an inflated Content-Length costs nothing on its own; and a
// failed allocation drops the request instead of the device. This check
// enforces the contract's 64 KB ceiling on top of all that.
static bool portalBodyTooBig() {
  return (size_t)g_portalServer->clientContentLength() > CONTENT_PORTAL_MAX_BODY;
}

static void portalHandleRoot() {
  portalTouchIdle();
  g_portalServer->send(200, "text/html; charset=utf-8", PORTAL_PAGE);
}

static void portalHandleStatus() {
  uint32_t idleLeft = portalTouchIdle();
  const char* pageId = (g_activePageIdx >= 0 && (size_t)g_activePageIdx < g_pages.size())
                           ? g_pages[g_activePageIdx].id.c_str()
                           : "";
  // Built up rather than snprintf'd into a fixed buffer: the SSID and the page
  // id are user-supplied strings of no guaranteed length, and a truncated
  // response here would be malformed JSON rather than a short one.
  std::string body = "{\"fw\":\"";
  jsonEscapeInto(FW_VERSION, body);
  // Which panel this device has ("e1002" | "e1001"), from the build's own
  // YAT_MODEL_NAME — a compile-time literal of our own, never request-derived,
  // so it needs no escaping. The setup site reads it for the two things it
  // cannot otherwise know: which release asset this device would take, and
  // whether to preview a pack in six inks or in black and white.
  body += "\",\"model\":\"";
  body += MODEL_NAME;
  body += "\",\"battery_mv\":";
  jsonAppendInt(body, (long)(batteryVolts() * 1000.0f));
  body += ",\"ssid\":\"";
  jsonEscapeInto(WiFi.SSID().c_str(), body);
  body += "\",\"ip\":\"";
  if (WiFi.status() == WL_CONNECTED) body += WiFi.localIP().toString().c_str();
  body += "\",\"ap_ssid\":\"";
  jsonEscapeInto(g_apSsid, body);
  body += "\",\"pages\":";
  jsonAppendInt(body, (long)g_pages.size());
  body += ",\"page_id\":\"";
  jsonEscapeInto(pageId, body);
  // Presence only, exactly as serial STATUS reports it — the portal's voice
  // section needs to say "有 key / no key" and there is no route that returns
  // the value itself.
  body += "\",\"voice_ready\":";
  body += sttKeyPresent() ? "true" : "false";
  // Same rule for the router key: presence only, so the portal's second key
  // field can show "有 key / no key" without any route that returns the value.
  // "llm_provider" says WHICH of the two services that key is for — the device
  // works it out from the key's own prefix, and this is how a support
  // conversation tells a DeepSeek outage from an OpenRouter one without anyone
  // reading a credential aloud. One of llmProvider()'s three literals ("",
  // "deepseek", "openrouter"), so it needs no escaping and carries no part of
  // the key.
  const char* llmProv = llmProvider();
  body += ",\"llm_ready\":";
  body += llmProv[0] ? "true" : "false";
  body += ",\"llm_provider\":\"";
  body += llmProv;
  body += '"';
  // Where THIS build's OTA route will download from ("owner/repo"), so the
  // portal checks that repo's releases rather than assuming the production one.
  // Ordinary builds report yat-hk/yat; an OTA-rehearsal build (compile-time
  // YAT_OTA_REPO_PATH override) reports its throwaway repo, and the update card
  // follows automatically. A compile-time literal, never request-derived.
  body += ",\"ota_repo\":\"";
  body += otaRepoSlug();
  body += '"';
  // Auto-rotate, as the config on the device actually parsed — 0, 30, 60 or 180
  // and nothing else, whatever config.json literally says. The portal offers
  // exactly those four, so a device holding a hand-edited 45 shows up here as
  // the 60 it will really rotate at rather than as a value with no option.
  body += ",\"loop_min\":";
  jsonAppendInt(body, (long)g_loopMin);
  body += ",\"idle_s\":";
  jsonAppendInt(body, (long)idleLeft);
  // audit #23. "page_id" above is what this device INTENDS to show; these two
  // are what its panel was last actually given (see g_renderOk). The portal's
  // saved card polls this route after an apply and may only claim success when
  // render_ok is true AND rendered_page is the page the user picked — a pack
  // that loads but will not draw, a warning takeover that preempted the
  // playlist, or a firmware card that got there first all land here as an
  // honest mismatch rather than as a ✓ over a screen showing something else.
  body += ",\"render_ok\":";
  body += g_renderOk ? "true" : "false";
  body += ",\"rendered_page\":\"";
  jsonEscapeInto(g_renderedPage.c_str(), body);
  // The error ring (see recordError), newest first, so the portal's issues card
  // can render the array in the order it receives it. Always present, empty
  // when nothing has failed — an absent key and an empty list would mean the
  // same thing to the UI, and one of them is a firmware version check waiting
  // to happen. At most eight objects of ~60 bytes, on a std::string that PSRAM
  // backs, so this cannot be the thing that makes a status response too big.
  body += "\",\"errors\":[";
  for (size_t i = 0; i < ERR_RING_N; i++) {
    const ErrEntry* e = errAt(i);
    if (!e) break;
    if (i) body += ',';
    body += "{\"t\":";
    jsonAppendInt(body, (long)e->t);
    body += ",\"code\":\"";
    jsonEscapeInto(e->code, body);
    body += "\",\"page\":\"";
    jsonEscapeInto(e->page, body);
    body += "\"}";
  }
  body += "]}";
  portalSendJson(200, body);
}

// The file as it stands, or the built-in default when there isn't one yet — a
// first-run portal needs something to edit, not a 404.
static void portalHandleConfig() {
  portalTouchIdle();
  std::string raw;
  if (g_fsReady && littlefsReadFile("/config.json", raw) && !raw.empty()) {
    portalSendJson(200, raw);
    return;
  }
  portalSendJson(200, DEFAULT_CONFIG_JSON);
}

// What the installed copy of a pack calls itself, read out of the file the
// device is actually holding. The portal has no other way to know: it can see
// the gallery's current version and it can see that a pack id is installed,
// and without this the two can never be compared — which is how a page that
// gained a feature months ago stays on the old copy forever with nothing
// anywhere saying so.
//
// Parsed under a filter, so a 60 KB pack costs a document of a few dozen bytes
// rather than its whole widget tree; the list route is called once per portal
// load with at most sixteen files behind it.
//
// Never fatal. A file that will not parse, or one carrying no version at all,
// still has to appear in the list — so it reports "0.0.0", which every real
// gallery version is newer than. A corrupt pack therefore offers an update,
// and taking it re-uploads the file, which is precisely the repair.
static std::string portalPackVersion(File& f) {
  static const char kUnknown[] = "0.0.0";
  size_t sz = f.size();
  // Matches the cap POST /api/pack enforces: anything larger did not come from
  // this portal and is not worth reading into memory to find out.
  if (!sz || sz > CONTENT_PORTAL_MAX_BODY) return kUnknown;
  std::string raw;
  raw.resize(sz);
  if (f.read(reinterpret_cast<uint8_t*>(&raw[0]), sz) != sz) return kUnknown;
  JsonDocument filter;
  filter["version"] = true;
  JsonDocument doc;
  // NestingLimit(24) for the same reason every other pack parse here needs it:
  // the filter still walks past everything it discards, and a legal widget
  // tree nests deeper than ArduinoJson's default of 10.
  if (deserializeJson(doc, raw, DeserializationOption::Filter(filter),
                      DeserializationOption::NestingLimit(24))) {
    return kUnknown;
  }
  const char* v = doc["version"].is<const char*>() ? doc["version"].as<const char*>() : nullptr;
  if (!v || !*v) return kUnknown;
  std::string out(v);
  // A version is a handful of digits and dots. Anything longer is junk that
  // has no business being echoed back at full length.
  if (out.size() > 32) out.resize(32);
  return out;
}

static void portalHandlePacks() {
  portalTouchIdle();
  std::string body = "[";
  bool first = true;
  if (g_fsReady) {
    File dir = LittleFS.open("/packs");
    if (dir && dir.isDirectory()) {
      File entry = dir.openNextFile();
      while (entry) {
        if (!entry.isDirectory()) {
          // Cores differ on whether name() is a basename or a full path, so
          // take everything after the last slash either way.
          String name = entry.name();
          int slash = name.lastIndexOf('/');
          if (slash >= 0) name = name.substring(slash + 1);
          static const char kSuffix[] = ".yat-pack.json";
          if (name.endsWith(kSuffix)) {
            name.remove(name.length() - (sizeof(kSuffix) - 1));
            // Both read before the handle moves on: portalPackVersion consumes
            // this entry's bytes, and size() after a full read is still the
            // file's size, but taking it first keeps that a fact rather than
            // an assumption.
            const long size = (long)entry.size();
            const std::string version = portalPackVersion(entry);
            if (!first) body += ",";
            first = false;
            body += "{\"id\":\"";
            jsonEscapeInto(name.c_str(), body);
            body += "\",\"size\":";
            jsonAppendInt(body, size);
            body += ",\"version\":\"";
            jsonEscapeInto(version.c_str(), body);
            body += "\"}";
          }
        }
        entry = dir.openNextFile();
      }
    }
  }
  body += "]";
  portalSendJson(200, body);
}

static void portalHandlePackPost() {
  portalTouchIdle();
  String id = g_portalServer->arg("id");
  if (!portalPackIdOk(id)) {
    portalSendError(400, "badname");
    return;
  }
  if (portalBodyTooBig()) {
    portalSendError(413, "toobig");
    return;
  }
  if (!g_fsReady) {
    portalSendError(503, "fs");
    return;
  }
  String body = g_portalServer->arg("plain");
  // NestingLimit(24) matches the engine's loader and the serial PUT path: a
  // legal widget tree nests deeper than ArduinoJson's default of 10 and most
  // gallery packs sit at 12-14, so the default would reject packs that render
  // perfectly well.
  JsonDocument check;
  DeserializationError de =
      deserializeJson(check, body.c_str(), DeserializationOption::NestingLimit(24));
  if (de) {
    LOGF("[portal] POST /api/pack?id=%s rejected: %s\n", id.c_str(), de.c_str());
    portalSendError(400, "badjson", portalJsonDetail(de));
    return;
  }
  // PACK-SPEC's optional min_firmware gate. Checked here, on install, and
  // nowhere else: the engine's own loader never looks at this field, so a
  // pack already on the device from before it needed a newer firmware keeps
  // rendering exactly as it does today — this is a one-time admission check,
  // not a running condition. Clamped to 32 like portalPackVersion's own
  // "version" field: min_firmware is untrusted input, not yet vetted against
  // PACK-SPEC's ^[0-9]+\.[0-9]+\.[0-9]+$ pattern by anything on this device.
  const char* minFw = check["min_firmware"].is<const char*>() ? check["min_firmware"].as<const char*>() : nullptr;
  if (minFw && *minFw) {
    char need[32];
    strncpy(need, minFw, sizeof need - 1);
    need[sizeof need - 1] = '\0';
    if (!portalFirmwareAtLeast(FW_VERSION, need)) {
      LOGF("[portal] POST /api/pack?id=%s rejected: needs firmware >= %s (have %s)\n",
           id.c_str(), need, FW_VERSION);
      portalSendFwOld(need);
      return;
    }
  }
  if (!LittleFS.exists("/packs")) LittleFS.mkdir("/packs");
  std::string path = portalPackPath(id);
  if (!littlefsWriteFile(path.c_str(), body.c_str(), body.length())) {
    LOGF("[portal] write %s FAILED\n", path.c_str());
    portalSendError(507, "nospace");
    return;
  }
  LOGF("[portal] wrote %s (%u bytes)\n", path.c_str(), (unsigned)body.length());
  std::string out = "{\"ok\":true,\"size\":";
  jsonAppendInt(out, (long)body.length());
  out += "}";
  portalSendJson(200, out);
}

static void portalHandlePackDelete() {
  portalTouchIdle();
  String id = g_portalServer->arg("id");
  if (!portalPackIdOk(id)) {
    portalSendError(400, "badname");
    return;
  }
  // A dead filesystem is not a missing file: "that page isn't on the device"
  // reads as job-done to whoever just asked for it to be removed, and the next
  // apply then fails on a pack the UI believes is already gone.
  if (!g_fsReady) {
    portalSendError(503, "fs");
    return;
  }
  std::string path = portalPackPath(id);
  if (!LittleFS.exists(path.c_str())) {
    portalSendError(404, "notfound");
    return;
  }
  if (!LittleFS.remove(path.c_str())) {
    portalSendError(500, "busy");
    return;
  }
  LOGF("[portal] removed %s\n", path.c_str());
  portalSendJson(200, "{\"ok\":true}");
}

static void portalHandleApply() {
  portalTouchIdle();
  if (!g_fsReady) {
    portalSendError(503, "fs");
    return;
  }
  if (portalBodyTooBig()) {
    portalSendError(413, "toobig");
    return;
  }
  String body = g_portalServer->arg("plain");
  JsonDocument doc;
  DeserializationError de =
      deserializeJson(doc, body.c_str(), DeserializationOption::NestingLimit(24));
  if (de || (doc["v"] | 0) != 2) {
    LOGF("[portal] apply rejected: %s\n", de ? de.c_str() : "not a v2 config");
    portalSendError(400, "badjson", de ? portalJsonDetail(de) : "schema");
    return;
  }

  // Validated in full before a byte is written, against the same parser
  // loadConfig() will use on the way back in — 1..16 pages, each with an id
  // and a pack — and then against the filesystem. The client uploads packs
  // first and applies last for exactly this reason: config.json is the commit
  // point, so an interrupted session can leave orphan pack files (harmless)
  // but never a config pointing at a pack that isn't there (a broken screen).
  DeviceConfig probe;
  if (!parsePagesFromV2(doc["pages"], probe)) {
    LOGF("[portal] apply rejected: bad pages[] (need 1..16 entries with id+pack)\n");
    portalSendError(400, "badjson", "schema");
    return;
  }
  for (const ConfigPage& p : probe.pages) {
    std::string path = "/packs/" + p.pack + ".yat-pack.json";
    if (!LittleFS.exists(path.c_str())) {
      LOGF("[portal] apply rejected: page \"%s\" wants pack \"%s\", which is not installed\n",
           p.id.c_str(), p.pack.c_str());
      portalSendError(400, "notfound");
      return;
    }
  }
  if (!littlefsWriteFile("/config.json", body.c_str(), body.length())) {
    LOGF("[portal] /config.json write FAILED\n");
    portalSendError(507, "nospace");
    return;
  }

  // Page 1 of the list the user just built is what the panel shows next; an
  // index saved against the old list means nothing now.
  g_activePageIdx = 0;
  savePageIdx(0);

  // Answer and hang up BEFORE the refresh starts. The server is deaf for the
  // whole refresh, and a phone still waiting on this response would simply
  // time out; the portal polls /api/status instead and gets its answer when
  // the server comes back. The refresh itself is left to the portal loop so it
  // runs with the request fully torn down.
  //
  // "refresh_s" is how long the phone should expect to wait, and it is a claim
  // about this model's panel — PANEL_REFRESH_S (yat_common.h), not a literal,
  // because the E1001's mono panel and the E1002's Spectra 6 do not take the
  // same time and the phone's countdown should not say they do.
  std::string applyReply = "{\"ok\":true,\"refresh_s\":";
  jsonAppendInt(applyReply, (long)PANEL_REFRESH_S);
  applyReply += '}';
  g_portalServer->send(200, "application/json", applyReply.c_str());
  g_portalServer->client().flush();
  g_portalServer->client().stop();
  g_portalApplyPending = true;
  LOGF("[portal] apply: %u byte config, %u page(s) — refreshing the panel\n",
       (unsigned)body.length(), (unsigned)probe.pages.size());
}

// ---------------- firmware update (yat_ota.cpp) ----------------
//
// POST /api/update {"tag":"v0.4.1"} — install that release, over the
// household's own WiFi, with no computer involved.
//
// The request may carry a TAG AND NOTHING ELSE. It cannot supply a URL, a
// host, a filename or a partition; yat_ota.cpp builds the URL itself out of
// constants after otaTagValid() has checked the tag against
// ^v[0-9]+\.[0-9]+\.[0-9]+$. That is deliberate and load-bearing: this portal
// is unauthenticated on the LAN, so the shape of this route decides what a
// household's other WiFi devices could talk it into. As written, the worst
// they can do is install a different genuine YAT release — see the residual
// noted at the top of yat_ota.cpp.
//
// Answers immediately and lets the portal loop do the work, exactly as
// /api/apply does and for the same reason: the download takes minutes and the
// server is single-threaded, so a handler that waited for it would be holding
// the socket the progress poll needs.
static void portalHandleUpdatePost() {
  portalTouchIdle();
  if (portalBodyTooBig()) {
    portalSendError(413, "toobig");
    return;
  }
  JsonDocument doc;
  DeserializationError de = deserializeJson(doc, g_portalServer->arg("plain").c_str(),
                                            DeserializationOption::NestingLimit(4));
  const char* tag = doc["tag"] | "";
  if (de || !tag[0]) {
    // Nothing from the body is logged, here or anywhere below. The tag becomes
    // loggable only once otaTagValid() has vouched for its shape.
    LOGF("[portal] POST /api/update rejected: %s\n", de ? "unparseable body" : "no tag");
    portalSendError(400, de ? "badjson" : "badtag", de ? portalJsonDetail(de) : nullptr);
    return;
  }
  if (!otaArm(tag)) {
    const char* why = otaDetail();
    const int code = !strcmp(why, OTA_ERR_BUSY) ? 409 : (!strcmp(why, OTA_ERR_OFFLINE) ? 503 : 400);
    LOGF("[portal] POST /api/update refused: %s\n", why);
    portalSendError(code, why);
    return;
  }
  std::string body = "{\"ok\":true,\"tag\":\"";
  jsonEscapeInto(otaTag(), body);
  body += "\"}";
  portalSendJson(200, body);
}

// GET /api/update — where the download has got to. Polling rather than SSE:
// the phone is already polling /api/status through every other wait in this
// portal, WebServer has no streaming-response idiom that survives its
// single-client loop, and one more two-second GET is the smallest thing that
// could possibly work.
static void portalHandleUpdateGet() {
  portalTouchIdle();
  const OtaState st = otaState();
  std::string body = "{\"state\":\"";
  switch (st) {
    case OtaState::Idle: body += "idle"; break;
    // One word for both, because the panel refresh at the start of an update
    // IS part of the download from where the phone is standing, and a state
    // the progress bar has no meaning in would just make it jump.
    case OtaState::Drawing:
    case OtaState::Downloading: body += "downloading"; break;
    case OtaState::Verifying: body += "verifying"; break;
    case OtaState::Ok: body += "ok"; break;
    case OtaState::Error: body += "error"; break;
  }
  body += '"';
  if (otaTag()[0]) {
    body += ",\"tag\":\"";
    jsonEscapeInto(otaTag(), body);
    body += '"';
  }
  if (st == OtaState::Downloading || st == OtaState::Drawing) {
    body += ",\"pct\":";
    jsonAppendInt(body, (long)otaPercent());
  }
  if (st == OtaState::Error) {
    body += ",\"detail\":\"";
    jsonEscapeInto(otaDetail(), body);
    body += '"';
  }
  body += '}';
  portalSendJson(200, body);
  // Only now, with the answer written: the reboot is allowed to happen as soon
  // as the phone has seen "ok" once, and "seen" has to mean the bytes left,
  // not that we were about to send them.
  if (st == OtaState::Ok) otaOkWasSeen();
}

static void portalHandleDone() {
  portalTouchIdle();
  g_portalServer->send(200, "application/json", "{\"ok\":true}");
  g_portalServer->client().flush();
  g_portalServer->client().stop();
  g_portalDone = true;
  LOGF("[portal] done from the portal\n");
}

// POST /api/secret {"name":"stt"|"llm","value":"<key>"[,"verify":true]} — the
// HTTP twin of the console's YAT SECRET (serial protocol section, above), so
// the voice keys can be set from a phone instead of a terminal. Same NVS slots,
// same discipline: the value is never logged, never echoed, and no route ever
// hands it back — /api/status reports presence only. An empty value clears the
// key, as do the "-"/"--" sentinels the console path spells it with. "stt" and
// "llm" are the only names that exist, so anything else is an error rather than
// a silent no-op.
//
// "verify":true adds the live check documented above, and changes the reply to
// one of exactly three shapes the portal reads:
//
//   {"ok":true,"verified":true}                            key tested, works, saved
//   400 {"error":"badkey"}                                  provider rejected it, NOT saved
//   {"ok":true,"verified":false,"detail":"offline"|"unknown"}  saved, could not be tested
//
// Without "verify" the reply stays exactly {"ok":true}, which is also what a
// clear answers whether or not verify was asked for: there is no key to test,
// and a "verified" field on that response would only be a claim about nothing.
static void portalHandleSecret() {
  portalTouchIdle();
  if (portalBodyTooBig()) {
    portalSendError(413, "toobig");
    return;
  }
  String body = g_portalServer->arg("plain");
  JsonDocument doc;
  DeserializationError de = deserializeJson(doc, body.c_str());
  if (de || !doc["name"].is<const char*>() || !doc["value"].is<const char*>()) {
    // Logs what failed, never any part of the body: the body carries the key.
    LOGF("[portal] POST /api/secret rejected: %s\n", de ? de.c_str() : "missing name/value");
    portalSendError(400, "badjson", de ? portalJsonDetail(de) : "schema");
    return;
  }
  const char* name = doc["name"].as<const char*>();
  const char* nvsKey = strcmp(name, "stt") == 0
                           ? "stt_key"
                           : (strcmp(name, "llm") == 0 ? "llm_key" : nullptr);
  if (!nvsKey) {
    LOGF("[portal] POST /api/secret rejected: unknown secret name\n");
    portalSendError(400, "badname");
    return;
  }
  const char* value = doc["value"].as<const char*>();
  size_t len = strlen(value);
  if (len > CONTENT_PORTAL_MAX_SECRET) {
    LOGF("[portal] POST /api/secret rejected: value %u chars over the %u cap\n", (unsigned)len,
         (unsigned)CONTENT_PORTAL_MAX_SECRET);
    portalSendError(413, "toobig");
    return;
  }
  // The name is one of the two literals matched just above, never the request's
  // own bytes — this log line can't be steered by whoever posted the body.
  const char* label = nvsKey[0] == 's' ? "voice" : "smart-voice";
  const bool clearing = len == 0 || strcmp(value, "-") == 0 || strcmp(value, "--") == 0;

  // Verification happens before a single byte is written, which is the whole
  // point: a key the provider has already refused must not be allowed to
  // overwrite the one on file, because the household would then have neither.
  KeyVerdict verdict = KeyVerdict::Unreachable;
  const bool doVerify = !clearing && (doc["verify"] | false);
  if (doVerify) {
    verdict = verifySecretKey(nvsKey[0] == 's', value);
    if (verdict == KeyVerdict::Rejected) {
      LOGF("[portal] %s key REJECTED by the provider — not saved\n", label);
      portalSendError(400, "badkey");
      return;
    }
  }

  Preferences prefs;
  prefs.begin("yat", false);
  if (clearing) {
    prefs.remove(nvsKey);
    LOGF("[portal] %s key cleared\n", label);
  } else {
    prefs.putString(nvsKey, value);
    LOGF("[portal] %s key set (%u chars)\n", label, (unsigned)len);
  }
  prefs.end();

  if (!doVerify) {
    portalSendJson(200, "{\"ok\":true}");
    return;
  }
  if (verdict == KeyVerdict::Valid) {
    portalSendJson(200, "{\"ok\":true,\"verified\":true}");
    return;
  }
  portalSendJson(200, verdict == KeyVerdict::Unreachable
                          ? "{\"ok\":true,\"verified\":false,\"detail\":\"offline\"}"
                          : "{\"ok\":true,\"verified\":false,\"detail\":\"unknown\"}");
}

static void portalHandleNotFound() {
  portalTouchIdle();
  // Anything that isn't /api/* gets the bootstrap. A phone probes a handful of
  // captive-portal check URLs the second it joins an AP, and a device that
  // answers those with its own setup page is friendlier than one that 404s at
  // the exact moment someone is looking for it.
  if (g_portalServer->method() == HTTP_GET && !g_portalServer->uri().startsWith("/api/")) {
    g_portalServer->send(200, "text/html; charset=utf-8", PORTAL_PAGE);
    return;
  }
  portalSendError(404, "notfound");
}

// "YAT-A13C" → "yat-a13c": mDNS hostnames are conventionally lowercase, and
// the screen must print exactly what MDNS.begin() registered.
static const char* portalMdnsHost() {
  static char host[sizeof(g_apSsid)] = {0};
  if (!host[0]) {
    for (size_t i = 0; i + 1 < sizeof(host) && g_apSsid[i]; ++i)
      host[i] = (char)tolower((unsigned char)g_apSsid[i]);
  }
  return host;
}

static void portalApUp() {
  WiFi.mode(WIFI_AP_STA);
  if (WiFi.softAP(g_apSsid, g_apPass))
    LOGF("[portal] AP \"%s\" up at %s\n", g_apSsid, WiFi.softAPIP().toString().c_str());
  else
    LOGF("[portal] softAP(\"%s\") FAILED — portal reachable on the LAN only\n", g_apSsid);
}

static void portalApDown() {
  WiFi.softAPdisconnect(false);
  WiFi.mode(WIFI_STA);
}

// Screen B: the portal is live, here is how to reach it. Two QRs by design
// (D4) — the big one is the LAN URL, which is what works on an ordinary home
// network, and the small one joins the device's own AP, the fallback for a
// router with client isolation switched on. The size difference is the point:
// nobody should take the harder path by accident. With no LAN address at all
// (saved credentials that won't connect) the two swap roles, because then the
// AP is the only door there is.
static void drawContentPortalScreen(const char* lanIp) {
  EPaperCanvas canvas;
  yat::DefaultFontProvider font;
  const int W = SCREEN_W, H = SCREEN_H;
  canvas.fillRect(0, 0, W, H, yat::Ink::White);

  char lanUrl[56] = {0};
  const bool haveLan = lanIp && lanIp[0];
  if (haveLan) snprintf(lanUrl, sizeof lanUrl, "http://%s", lanIp);

  prov::drawText(canvas, font, 16, 7, "揀內容   Choose what it shows", 24, yat::Ink::Black, true);
  canvas.fillRect(0, 43, W, 1, yat::Ink::Black);

  auto line = [&](int x, int y, const char* s, int px, yat::Ink ink, bool bold = false) {
    prov::drawText(canvas, font, x, y, s, px, ink, bold);
  };

  const int bigSize = 232, bigX = 40, bigY = 84;
  prov::drawQR(canvas, haveLan ? lanUrl : g_qrWifiPayload, bigX, bigY, bigSize);
  auto centerUnder = [&](const char* zh, const char* en) {
    int cx = bigX + bigSize / 2;
    line(cx - prov::textWidth(zh, 16) / 2, bigY + bigSize + 8, zh, 16, yat::Ink::Black);
    line(cx - prov::textWidth(en, 16) / 2, bigY + bigSize + 28, en, 16, yat::Ink::Black);
  };

  const int rx = 300;  // right column
  char manual[112];
  snprintf(manual, sizeof manual, "WiFi「%s」 密碼 %s", g_apSsid, g_apPass);

  if (haveLan) {
    // ONE QR per screen (same user-tested rule as drawProvisioningScreen): the
    // old small join-the-AP QR competed for the scan and is now the text-only
    // last resort below, marked by the blue side rule.
    centerUnder("用手機掃我", "Scan me with your phone");

    line(rx, 88, "用手機掃左邊個 QR code", 24, yat::Ink::Black, true);
    line(rx, 124, "Scan the QR code with your phone", 16, yat::Ink::Black);
    line(rx, 152, "或者喺電腦打呢個網址 On a computer:", 16, yat::Ink::Black);
    char localUrl[40];
    snprintf(localUrl, sizeof localUrl, "http://%s.local", portalMdnsHost());
    line(rx, 174, localUrl, 32, yat::Ink::Blue, true);
    char altUrl[72];
    snprintf(altUrl, sizeof altUrl, "唔得就試 or try  %s", lanUrl);
    line(rx, 218, altUrl, 16, yat::Ink::Blue);

    canvas.fillRect(rx, 252, 4, 96, yat::Ink::Blue);
    const int fx = rx + 16;
    line(fx, 258, "兩樣都唔得？ Neither works?", 16, yat::Ink::Black, true);
    line(fx, 280, manual, 24, yat::Ink::Black);
    line(fx, 314, "手機手動連咗之後，喺瀏覽器開 then open", 16, yat::Ink::Black);
    line(fx, 334, "http://192.168.4.1", 24, yat::Ink::Blue, true);
  } else {
    centerUnder("① 掃我連上裝置嘅 WiFi", "Scan to join the device's Wi-Fi");

    line(rx, 88, "屋企 WiFi 連唔上", 24, yat::Ink::Red, true);
    line(rx, 124, "Can't reach your home Wi-Fi — set up over", 16, yat::Ink::Black);
    line(rx, 144, "the device's own network instead.", 16, yat::Ink::Black);
    line(rx, 176, "② 連咗之後，喺瀏覽器打：", 16, yat::Ink::Black);
    line(rx, 198, "http://192.168.4.1", 32, yat::Ink::Blue, true);
    line(rx, 244, manual, 16, yat::Ink::Black);
    line(rx, 274, "想改 WiFi？撳住綠色掣，聽到「嘀」一聲先放手。", 16, yat::Ink::Black);
    line(rx, 294, "To change Wi-Fi, hold the green button until", 16, yat::Ink::Black);
    line(rx, 314, "it beeps (usually 5–10 s).", 16, yat::Ink::Black);
  }

  // D2: the timeout is stated where the person waiting on it can read it.
  const char* idleLine = "10 分鐘冇郁過就會自動離開設定 · Setup closes itself after 10 idle minutes";
  line((W - prov::textWidth(idleLine, 16)) / 2, 414, idleLine, 16, yat::Ink::Blue);

  drawStandardFooter(canvas, font);
}

// Screen C's footer band, drawn over the engine's standard chrome footer after
// a normal page render. The band is the whole difference between screen C and
// screen D, and it is why D3 insists on a final redraw: an e-paper panel holds
// its image forever, so a "setup is running" strip left behind after setup
// ended would be a lie with no expiry.
static void drawSetupFooterBanner(yat::Canvas& canvas, yat::FontProvider& font, const char* url) {
  const int W = SCREEN_W, H = SCREEN_H;
  const int bandY = H - 34;
  canvas.fillRect(0, bandY, W, 34, yat::Ink::White);
  canvas.fillRect(0, bandY, W, 2, yat::Ink::Blue);
  const char* left = "設定緊 · 喺手機撳「完成」收工 · Setup mode — tap Done on your phone";
  prov::drawText(canvas, font, 16, bandY + 9, left, 16, yat::Ink::Blue);
  if (url && url[0])
    prov::drawText(canvas, font, W - 16 - prov::textWidth(url, 16), bandY + 9, url, 16,
                   yat::Ink::Blue);
}

// Screens C and D: the configured content, rendered and pushed to the panel.
// `bannerUrl` non-null adds the setup band (screen C, straight after an apply);
// nullptr renders the page exactly as it normally looks (screen D, the last
// thing drawn on every exit from setup, whichever exit it was). Reloads
// config.json first, because an apply has just rewritten it underneath us.
static void portalRenderContent(const char* bannerUrl, DeviceConfig& cfg, SleepPlan& planOut) {
  cfg = loadConfig(g_fsReady);
  g_pages = cfg.pages;
  g_voiceSeconds = cfg.voiceSeconds;
  buildPageAliasCache();
  if (g_activePageIdx < 0 || (size_t)g_activePageIdx >= g_pages.size()) {
    g_activePageIdx = 0;
    savePageIdx(0);
  }

  yat::Engine eng;
  LittleFsStateStore stateStore;
  if (g_fsReady) eng.setStateStore(&stateStore);
  PngleImageDecoder imgDecoder;
  eng.setImageDecoder(&imgDecoder);
  eng.setBatteryPercent(batteryPercent(batteryVolts()));

  // Same "try the active page, then the rest, then a built-in" ladder the
  // normal cycle uses — a pack that passed apply's existence check can still
  // fail to load, and setup must not end on a blank panel.
  std::string packJson, err;
  bool loaded = false, onWelcomeFallback = false;
  for (size_t attempt = 0; attempt < g_pages.size(); attempt++) {
    size_t idx = ((size_t)g_activePageIdx + attempt) % g_pages.size();
    const ConfigPage& page = g_pages[idx];
    std::string candidate;
    std::string path = "/packs/" + page.pack + ".yat-pack.json";
    if (!(g_fsReady && littlefsReadFile(path.c_str(), candidate))) {
      LOGF("[portal] page %u (\"%s\") pack \"%s\" unreadable — trying next\n", (unsigned)idx,
           page.id.c_str(), page.pack.c_str());
      continue;
    }
    std::string loadErr;
    const char* paramsArg = page.paramsJson.empty() ? nullptr : page.paramsJson.c_str();
    if (!eng.load(candidate.c_str(), paramsArg, loadErr)) {
      LOGF("[portal] page %u (\"%s\") pack \"%s\" failed to load (%s) — trying next\n",
           (unsigned)idx, page.id.c_str(), page.pack.c_str(), loadErr.c_str());
      continue;
    }
    LOGF("[portal] page %u (\"%s\") pack \"%s\" loaded (%u bytes)\n", (unsigned)idx,
         page.id.c_str(), page.pack.c_str(), (unsigned)candidate.size());
    if ((int)idx != g_activePageIdx) {
      g_activePageIdx = (int)idx;
      savePageIdx(g_activePageIdx);
    }
    loaded = true;
    break;
  }
  if (!loaded) {
    // D5: with nothing configured that renders, the welcome pack IS the
    // content — and its copy now points back at the same green button that
    // opened this portal, so the panel stays a working instruction instead of
    // becoming a dead end.
    LOGF("[portal] no configured page loaded — falling back to the embedded welcome pack\n");
    packJson.assign(WELCOME_PACK);
    if (!eng.load(packJson.c_str(), nullptr, err)) {
      LOGF("[portal] embedded welcome pack failed to load (%s) — leaving the panel alone\n",
           err.c_str());
      // Not one page of the household's loaded and neither did the built-in, so
      // there is no page to name — only the fact that nothing was drawn.
      noteRenderResult(false, "");
      planOut = {(uint64_t)RETRY_MIN * 60ULL, "portal exit, nothing renderable"};
      return;
    }
    onWelcomeFallback = true;
  }

  time_t now = time(nullptr);
  err.clear();
  // Unlike the normal cycle, a failed fetch is not fatal here: something has
  // to replace the setup screen, and a page of nulls with the chrome's own
  // stale/empty markers beats leaving "scan this QR" on the panel for good.
  errCopyField(g_fetchErrPage, sizeof g_fetchErrPage,
               onWelcomeFallback ? "" : g_pages[g_activePageIdx].id.c_str());
  g_fetchErrRecord = true;
  // fetchPackSource(), not httpsFetch(): same reasoning as main.cpp's cycle —
  // this is the previewed/applied pack's own declared sources.
  const bool portalExtractOk = eng.fetchAndExtract(fetchPackSource, now, err);
  g_fetchErrRecord = false;
  if (!portalExtractOk)
    LOGF("[portal] extract failed (%s) — rendering with whatever came back\n", err.c_str());

  EPaperCanvas canvas;
  yat::DefaultFontProvider font;
  std::string renderErr;
  // The page this session is trying to put on the panel — the first entry of
  // the list the user just applied, in the apply case. Recorded before the
  // render so a failure can name it (audit #23): the setup site's saved-card
  // needs to say WHICH page the device could not draw, and after the welcome
  // fallback below has run there is nothing left in scope that remembers.
  const std::string wantPage =
      onWelcomeFallback ? std::string() : g_pages[g_activePageIdx].id;
  std::string drawnPage = wantPage;
  bool rendered = eng.render(canvas, font, now, renderErr, kPanelProfile);
  if (!rendered && !onWelcomeFallback) {
    // A pack that loads but won't render does not get the last word here: D3
    // says setup always ends on real content, and the alternative is a panel
    // frozen on "scan this QR" with no session behind it. One retry on the
    // embedded welcome pack, whose copy at least tells someone what to do.
    LOGF("[portal] render failed (%s) — retrying on the embedded welcome pack\n",
         renderErr.c_str());
    packJson.assign(WELCOME_PACK);
    std::string retryErr;
    if (eng.load(packJson.c_str(), nullptr, retryErr)) {
      eng.fetchAndExtract(fetchPackSource, now, retryErr);  // no sources in that pack; costs nothing
      canvas.fillRect(0, 0, SCREEN_W, SCREEN_H, yat::Ink::White);
      rendered = eng.render(canvas, font, now, retryErr, kPanelProfile);
      // Whatever ends up on the ink, it is the welcome pack and not the page
      // that was asked for — say so rather than let the ✓ copy claim otherwise.
      if (rendered) drawnPage.clear();
    }
  }
  if (!rendered) {
    LOGF("[portal] nothing would render — leaving the panel as it is\n");
    // The panel still holds whatever it held before, so the record has to say
    // the render failed AND which page failed — that pair is exactly what lets
    // the site drop the ✓ and name the page instead of guessing.
    noteRenderResult(false, wantPage);
    planOut = {(uint64_t)RETRY_MIN * 60ULL, "portal exit, render failed"};
    return;
  }
  if (bannerUrl) drawSetupFooterBanner(canvas, font, bannerUrl);
  logStackHeadroom("the portal's page render");

  panelRefresh(drawnPage);

  // Keep hash-skip honest: the panel now holds this data, so the next
  // scheduled wake must compare against it and not against whatever was on
  // screen before setup started. Same for the stale badge — a setup session
  // that ends on stale sources has the badge on screen, and the next wake must
  // not read that as a fresh-to-stale transition worth a refresh of its own.
  uint32_t hash = eng.dataHash(now);
  g_lastHash = hash;
  Preferences prefs;
  prefs.begin("yat", false);
  prefs.putUInt("hash", hash);
  prefs.putUChar("was_stale", eng.anyStale() ? 1 : 0);
  // A pack loaded, rendered and reached the panel — the same proof of health the
  // normal cycle's own ending takes, and setup is where a household lands after
  // swapping out whatever was crashing (audit #18).
  clearPanicStreak(prefs, "setup put content on the panel");
  prefs.end();
  // Real content is on the panel, so no firmware card is — including one that
  // went up before this session started. Left stale, the marker would suppress
  // the redraw of an offline card the household can no longer see.
  saveScreenCard(ScreenCard::None);

  planOut = computeSleepPlan(eng.pack()["schedule"], cfg, time(nullptr),
                             time(nullptr) > CLOCK_SANE_EPOCH);
}

// D1: a setup mode was asked for, but there isn't enough charge to spend on it.
// Setup mode is the most expensive thing this firmware does — an AP, a WiFi
// client and up to two full refreshes — so it is the one mode worth declining
// outright: a session that browns out halfway through is worse than one that
// never started. Says so on the panel and goes back to the ordinary cadence.
// `userInitiated` picks the last line: the green-button gesture needs to be
// repeated by a person, while the automatic entries (first boot with no
// credentials, three failed joins) resume on their own once there is charge —
// telling someone to hold a button for those would be busywork.
//
// The buzz always sounds, but the card is drawn only on the first refusal of a
// streak: a second hold five minutes later is the same answer, and the ~30 s
// refresh it would cost comes out of the battery this card exists to protect.
[[noreturn]] void refuseSetupLowBattery(float volts, bool userInitiated) {
  LOGF("[portal] setup refused — battery %.2f V is under the %.2f V floor\n", volts,
       CONTENT_PORTAL_MIN_VOLTS);
  // The buzz answers a person who just pressed something. The automatic entries
  // re-check on the failure ladder (deepSleepError) until the charger goes in,
  // and a shelf device buzzing at nobody on every one of those is its own bug.
  if (userInitiated) beepError();
  if (loadScreenCard() == ScreenCard::SetupRefused) {
    LOGF("[portal] setup-refused card already on the panel — no refresh this wake\n");
    deepSleepError("setup refused: low battery, card unchanged");
  }
  saveScreenCard(ScreenCard::SetupRefused);
  if (!g_panelReady) {
    LOGF("[epd] init (setup-refused card)...\n");
    epaper.begin();
    g_panelReady = true;
  }

  EPaperCanvas canvas;
  yat::DefaultFontProvider font;
  const int W = SCREEN_W, H = SCREEN_H;
  canvas.fillRect(0, 0, W, H, yat::Ink::White);

  prov::drawText(canvas, font, 16, 7, "叉住電先設定   Plug in to set up", 24, yat::Ink::Red, true);
  canvas.fillRect(0, 43, W, 1, yat::Ink::Black);

  const int iconSize = 96;
  prov::drawIcon(canvas, "battery", (W - iconSize) / 2, 84, iconSize, yat::Ink::Red);

  char voltLine[24];
  snprintf(voltLine, sizeof voltLine, "%.2f V", volts);
  prov::drawText(canvas, font, (W - prov::textWidth(voltLine, 32, true)) / 2, 84 + iconSize + 10,
                 voltLine, 32, yat::Ink::Red, true);

  auto centerLine = [&](int y, const char* zh, const char* en) {
    prov::drawText(canvas, font, (W - prov::textWidth(zh, 16)) / 2, y, zh, 16, yat::Ink::Black);
    prov::drawText(canvas, font, (W - prov::textWidth(en, 16)) / 2, y + 18, en, 16,
                   yat::Ink::Black);
  };
  centerLine(262, "設定要開 WiFi 熱點同刷新畫面，而家嘅電唔夠。",
             "Setup runs a Wi-Fi hotspot and redraws the screen — not enough charge for that now.");
  if (userInitiated) {
    centerLine(312, "插上 USB-C 電源，再撳住綠色掣直到聽到「嘀」一聲。",
               "Plug in USB-C, then hold the green button until it beeps (usually 5–10 s).");
  } else {
    centerLine(312, "插上 USB-C 電源，夠電就會自己再嚟過。",
               "Plug in USB-C — it will pick this up again by itself once charged.");
  }
  // Was "the screen keeps updating as usual", which hash-skip makes a lie: this
  // card sits on the panel until something actually renders over it, and that
  // only happens when the data moves (or when the charge comes back and setup()
  // forces a render — see g_cardCleared).
  centerLine(362, "叉返電，個芒就會返返正常。", "Once it is charged, the screen goes back to normal.");

  drawStandardFooter(canvas, font);

  panelRefresh("");

  // Same ladder as every other failed cycle: a device sitting under the setup
  // floor is not going to charge itself, and re-checking every five minutes
  // through the night is how the last of the charge goes. A press wakes it.
  deepSleepError("setup refused: low battery");
}

[[noreturn]] void runContentPortal(PortalEntry entry) {
  const char* entryName = entry == PortalEntry::Gesture        ? "green button"
                          : entry == PortalEntry::Provisioned  ? "straight from WiFi setup"
                                                               : "YAT PORTAL";
  LOGF("[portal] entering content portal (%s)\n", entryName);
  g_keySetupMode = true;    // never returns: the page buttons only acknowledge from here
  g_inContentPortal = true;  // and never re-enters: see the flag's declaration
  g_portalRequested = false;  // whatever asked for this has been served

  // STA first, and STA only: the LAN address is most of what screen B says,
  // and there is no point drawing that screen before we know whether we have
  // one. The AP stays down until after the refresh below (power rule).
  if (WiFi.status() != WL_CONNECTED) {
    WiFi.mode(WIFI_STA);
    WifiCreds creds = loadWifiCreds();
    if (creds.valid) wifiConnect(creds.ssid.c_str(), creds.pass.c_str());
  }
  const bool staUp = WiFi.status() == WL_CONNECTED;

  // The green button is the only door back into WiFi setup, and every screen
  // that mentions it (the offline card, the setup screens) promises exactly
  // that. Saved credentials that no longer work — new router, changed password,
  // moved house — used to land the gesture here anyway, on an AP-only content
  // portal that cannot change a WiFi password, leaving the household with no
  // way back short of erasing the flash. Hand it to provisioning instead, which
  // comes straight back in here (thenPortal) once credentials land, so the
  // gesture still ends where it always did. Only for the gesture: Provisioned
  // just came FROM there and would bounce forever, and Console has a terminal
  // attached to explain itself.
  if (!staUp && entry == PortalEntry::Gesture) {
    LOGF("[portal] saved credentials will not connect — sending the gesture to WiFi setup\n");
    runProvisioningMode("連唔到 WiFi", "saved WiFi would not connect",
                        /*thenPortal=*/true, /*userInitiated=*/true);  // [[noreturn]]
  }

  String lanIp = staUp ? WiFi.localIP().toString() : String("");
  if (staUp) {
    LOGF("[portal] STA up, LAN address %s\n", lanIp.c_str());
    syncTime();  // screens C and D draw a clock; get it right before rendering one
    // mDNS makes the desktop path typeable: http://yat-a13c.local instead of a
    // raw IP. Registered before the screen draws because the screen prints it.
    // Phones keep using the QR (Android browsers don't resolve .local).
    static bool mdnsUp = false;
    if (!mdnsUp && MDNS.begin(portalMdnsHost())) {
      mdnsUp = true;
      MDNS.addService("http", "tcp", 80);
      LOGF("[portal] mDNS http://%s.local\n", portalMdnsHost());
    }
  } else {
    LOGF("[portal] no LAN address — the portal will be reachable on the AP only\n");
  }
  char portalUrl[56];
  snprintf(portalUrl, sizeof portalUrl, "http://%s", staUp ? lanIp.c_str() : "192.168.4.1");

  beepEnterSetup();  // audible "I'm in setup mode" before the ~30 s blocking refresh

  // Static, and wired up once: setup always ends in deep sleep, but a second
  // `YAT PORTAL` during the exit console window re-enters this function, and
  // WebServer only ever appends to its handler list.
  static WebServer server(80);
  static bool routesRegistered = false;
  g_portalServer = &server;
  if (!routesRegistered) {
    routesRegistered = true;
    server.on("/", HTTP_GET, portalHandleRoot);
    server.on("/api/status", HTTP_GET, portalHandleStatus);
    server.on("/api/config", HTTP_GET, portalHandleConfig);
    server.on("/api/packs", HTTP_GET, portalHandlePacks);
    server.on("/api/pack", HTTP_POST, portalHandlePackPost);
    server.on("/api/pack", HTTP_DELETE, portalHandlePackDelete);
    server.on("/api/apply", HTTP_POST, portalHandleApply);
    server.on("/api/done", HTTP_POST, portalHandleDone);
    server.on("/api/secret", HTTP_POST, portalHandleSecret);
    server.on("/api/update", HTTP_POST, portalHandleUpdatePost);
    server.on("/api/update", HTTP_GET, portalHandleUpdateGet);
    server.onNotFound(portalHandleNotFound);
  }
  // Listening BEFORE the refresh, not after. STA is already associated by here,
  // so the LAN address the screen is about to print is live and routable — and
  // the panel is legible somewhere in the middle of that ~30 s refresh, not at
  // the end of it. Starting the server afterwards meant the first phone to scan
  // the QR while the ink was still settling got a connection refused, which
  // browsers turn into "this site can't be reached" — the wrong answer to the
  // right action, and one that teaches people the QR does not work. The socket
  // binds 0.0.0.0, so it is already listening on the AP interface too by the
  // time portalApUp() creates it, exactly as it stays listening across the
  // apply refresh's portalApDown()/portalApUp() pair further down.
  //
  // handleClient() cannot run during the blocking refresh, so an early request
  // waits in the TCP backlog and is answered the moment the loop below starts:
  // a phone that connects at second five sees the page load slowly, instead of
  // seeing it fail.
  server.begin();
  LOGF("[portal] server listening before the refresh — %s and http://192.168.4.1\n", portalUrl);

  if (!g_panelReady) {
    LOGF("[epd] init...\n");
    epaper.begin();
    g_panelReady = true;
  }
  drawContentPortalScreen(staUp ? lanIp.c_str() : nullptr);
  logStackHeadroom("the setup screen (QR)");
  panelRefresh("");

  // Radio up only now that the big refresh is behind us — the brownout rule is
  // about the AP's transmitter, which is why the server above could go first
  // and this cannot (see this section's header comment).
  portalApUp();

  DeviceConfig cfg = loadConfig(g_fsReady);
  SleepPlan plan{(uint64_t)SCHEDULE_MIN * 60ULL, "portal exit, default cadence"};
  g_portalLastHitMs = millis();
  g_portalDone = false;
  g_portalApplyPending = false;

  const char* exitWhy = "done";
  uint32_t lastBlink = millis();
  bool ledOn = false;
  for (;;) {
    server.handleClient();
    pumpConsoleByte();  // the CH340 console stays live all through setup
    processKeyLatches("setup mode");

    if (g_portalApplyPending) {
      g_portalApplyPending = false;
      LOGF("[portal] applying — dropping the AP for the refresh\n");
      portalApDown();
      portalRenderContent(portalUrl, cfg, plan);
      portalApUp();
      // The refresh is our time, not the user's: don't let 35 s of panel work
      // eat a third of their idle window.
      g_portalLastHitMs = millis();
      LOGF("[portal] applied — AP back up, server listening again\n");
    }

    // The update card goes onto the panel before a byte is downloaded, so the
    // ink reads 「更新緊韌體… 唔好熄電源」 for the whole of the wait rather
    // than for the moment after it. Same AP/refresh dance as the apply above
    // — the brownout rule is about the AP's transmitter, not about which
    // screen is being drawn — and the STA link the download needs is what
    // stays up through it.
    if (otaWantsCard()) {
      LOGF("[portal] update starting — dropping the AP to draw the update card\n");
      portalApDown();
      otaDrawCard();
      portalApUp();
      otaCardDrawn();
      g_portalLastHitMs = millis();
      LOGF("[portal] update card is up — starting the download\n");
    }
    if (otaBusy()) {
      // A download is minutes of work with no /api/* hit behind it once the
      // phone's polls stop landing (a phone that locked its screen, a browser
      // that suspended the tab). Letting the idle clock run would drop the
      // device out of setup mid-write, which is the one moment it must not.
      // otaPump() itself is bounded, so the loop still answers the polls that
      // do arrive.
      g_portalLastHitMs = millis();
      otaPump();
    }

    if (g_portalDone) break;
    if (millis() - g_portalLastHitMs > CONTENT_PORTAL_IDLE_MS) {
      exitWhy = "idle timeout";
      break;
    }

    if (millis() - lastBlink > 500) {  // slow heartbeat: setup mode is running
      lastBlink = millis();
      ledOn = !ledOn;
      digitalWrite(PIN_LED, ledOn ? LOW : HIGH);
    }
    delay(2);
  }

  // D3: both exits are the same exit. Whatever happened, the panel gets one
  // final render of the real content with no setup band on it before the
  // device goes back to its ordinary cadence — an e-paper screen left holding
  // live-looking setup instructions would still be showing them tomorrow.
  LOGF("[portal] leaving setup (%s)\n", exitWhy);
  server.stop();
  g_portalServer = nullptr;
  portalApDown();
  digitalWrite(PIN_LED, HIGH);
  portalRenderContent(nullptr, cfg, plan);
  LOGF("[sched] %s\n", plan.reason.c_str());
  deepSleepScheduled(plan.seconds, "content portal exit");
}
