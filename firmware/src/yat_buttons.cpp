// Generated by the main.cpp module split: the code below is a verbatim
// slice of the original single-translation-unit firmware/src/main.cpp.

#include "yat_buttons.h"

#include <Arduino.h>
#include <Preferences.h>
#include <WiFi.h>
#include <driver/rtc_io.h>
#include <esp_timer.h>

#include "yat_beep.h"
#include "yat_config.h"
#include "yat_voice.h"
#include "yat_state.h"

// ---------------- button latches (presses made while awake) ----------------
//
// All three buttons are ext1 deep-sleep wake sources (see lowLevelSleep), which
// covers the case the device spends most of its life in: asleep, a press wakes
// it, and the wake path acts on the reason it woke. On its own that does
// nothing at all for a press made while the device is ALREADY awake — and
// awake is exactly when a household presses, because the two longest things
// this firmware does are the most visible: a ~30 s panel refresh and a WiFi
// join of up to 15 s, both of which block the single setup() task solid. A
// press during either used to vanish without a sound, which is read (correctly)
// as "the buttons don't work".
//
// Polling cannot fix that — there is no loop of ours to poll from inside
// epaper.update(). So the press is caught by a GPIO interrupt that does nothing
// but latch a flag and a timestamp, and the WORK happens later, at the
// checkpoints that already exist between the blocking steps: consoleWindow()'s
// idle loop, every maybeEnterConsole() call site, both portal loops, and once
// more just before the device goes back to sleep. Same checkpoint model the
// serial console already uses (see maybeEnterConsole) — mid-refresh is still
// not preemptible, but nothing is lost while it isn't.
static constexpr int KEY_PINS[3] = {PIN_KEY0, PIN_KEY1, PIN_KEY2};
static constexpr const char* KEY_NAMES[3] = {"KEY0", "KEY1", "KEY2"};
// One press is one action however dirty the contact: a second falling edge
// this soon after the last accepted one is switch bounce, not a second press.
static constexpr uint32_t KEY_DEBOUNCE_MS = 250;
// A KEY0 press still held this long is the 5 s provisioning hold, which stays
// a wake-time gesture — see processKeyLatches().
static constexpr uint32_t KEY0_HOLD_ABANDON_MS = 5000;
// Two arrows "at the same time" as a hand actually manages it. No finger pair
// closes two contacts on the same millisecond, so a lone arrow latch is not
// decidable until this window has passed — processKeyLatches() waits it out
// before treating one as a page-step. Wide enough for an unhurried two-thumb
// press, short enough that the wait is invisible against the ~30 s refresh
// either outcome buys.
static constexpr uint32_t KEY_BOTH_WINDOW_MS = 400;

static portMUX_TYPE g_keyMux = portMUX_INITIALIZER_UNLOCKED;
static volatile bool g_keyLatched[3] = {false, false, false};
static volatile uint32_t g_keyEdgeMs[3] = {0, 0, 0};
// True for a button that was still physically down at the moment the
// interrupts were armed. That press is either the one that woke this boot
// (already acted on by the wake path) or one made blind during boot, which the
// wake path cannot see either way — what matters is that the contact bounce
// when the finger finally lifts must not read as a fresh press. Cleared at the
// first checkpoint that sees the pin high again, taking any latch with it.
static bool g_keyHeldAtArm[3] = {false, false, false};
static bool g_keyIntsArmed = false;
// Setup mode — WiFi provisioning or the content portal — owns the screen: the
// page buttons only acknowledge there, and KEY0 does nothing at all.
bool g_keySetupMode = false;
// Set once this cycle has committed to a pack: past that point the active page
// index no longer decides what gets drawn, so a press that changes it needs a
// fresh cycle rather than this one (see lowLevelSleep).
bool g_packCommitted = false;
// A press changed the active page this cycle — bypass the hash-skip the same
// way g_serialForceRender does...
bool g_keyForceRender = false;
// ...and, when the change landed after g_packCommitted, cut the sleep short so
// the next cycle draws it instead of leaving the user's press for the next
// scheduled wake.
bool g_keyRerenderPending = false;

// Latch only: no logging, no beeping, no NVS, nothing that can block.
// esp_timer_get_time() is the clock to read here — it lives in IRAM, where
// millis()'s wrapper does not — and the timestamp is what makes the debounce
// above possible and what tells a KEY0 tap from a hold later.
static void IRAM_ATTR keyIsr(void* arg) {
  const uint32_t idx = (uint32_t)(uintptr_t)arg;
  const uint32_t nowMs = (uint32_t)(esp_timer_get_time() / 1000);
  portENTER_CRITICAL_ISR(&g_keyMux);
  if (nowMs - g_keyEdgeMs[idx] >= KEY_DEBOUNCE_MS) {
    g_keyEdgeMs[idx] = nowMs;
    g_keyLatched[idx] = true;
  }
  portEXIT_CRITICAL_ISR(&g_keyMux);
}

static bool keyLatchPending(int i) { return g_keyLatched[i]; }

static void clearKeyLatch(int i) {
  portENTER_CRITICAL(&g_keyMux);
  g_keyLatched[i] = false;
  portEXIT_CRITICAL(&g_keyMux);
}

void armButtonInterrupts() {
  if (g_keyIntsArmed) return;
  for (int i = 0; i < 3; i++) {
    // A pin that woke us through ext1 is still routed to the RTC IO mux
    // (lowLevelSleep arms it there); hand the pad back to the digital GPIO
    // matrix before attaching a digital interrupt to it, or the interrupt is
    // attached to something that isn't driving it. Harmless on a pin that was
    // never RTC-armed, and on KEY0 after readKey0GestureAtWake() already did it.
    rtc_gpio_deinit((gpio_num_t)KEY_PINS[i]);
    pinMode(KEY_PINS[i], INPUT_PULLUP);
  }
  delay(2);  // let the pull-ups settle after the mux switch before sampling
  for (int i = 0; i < 3; i++) {
    g_keyHeldAtArm[i] = digitalRead(KEY_PINS[i]) == LOW;
    g_keyLatched[i] = false;
    g_keyEdgeMs[i] = (uint32_t)millis();
    attachInterruptArg(KEY_PINS[i], keyIsr, (void*)(uintptr_t)i, FALLING);
  }
  g_keyIntsArmed = true;
  // Still holding both arrows this far into the boot — a slower press than
  // sampleArrowsAtWake() could catch, but unmistakably the same gesture. The
  // latches for both are about to be suppressed as "held at arm", so without
  // this the press would produce nothing at all.
  if (!g_keySetupMode && g_keyHeldAtArm[1] && g_keyHeldAtArm[2]) g_helpRequested = true;
  LOGF("[keys] awake presses armed%s%s%s%s\n", g_keyHeldAtArm[0] ? " (KEY0 down)" : "",
       g_keyHeldAtArm[1] ? " (KEY1 down)" : "", g_keyHeldAtArm[2] ? " (KEY2 down)" : "",
       g_helpRequested ? " — both arrows held: help" : "");
}

// Called on the way into deep sleep, before the ext1 arming below it: a
// digital GPIO interrupt left attached to a pad that is about to be handed to
// the RTC mux has no business firing during the handover, and from there on
// ext1 is what owns these pins.
void disarmButtonInterrupts() {
  if (!g_keyIntsArmed) return;
  for (int i = 0; i < 3; i++) detachInterrupt(KEY_PINS[i]);
  g_keyIntsArmed = false;
}


// ---------------- button latches, part two: acting on them ----------------
//
// The latching half is at the top of this file, next to the pins. This half
// needs the beep vocabulary, the page list and the voice capture above it, so
// it lives here; the two are wired together by processKeyLatches()'s forward
// declaration up there.

// This cycle's WiFi credentials, mirrored for a KEY0 tap caught mid-cycle: the
// wake path hands runVoiceCapture() setup()'s own `creds` local, and a
// checkpoint several frames deep inside consoleWindow() cannot reach it.
WifiCreds g_keyCreds;

// Steps the active page exactly the way the wake path does (setup()'s
// KEY1/KEY2 block): wrap in both directions, persist to NVS immediately, and
// leave g_activePageIdx as the in-memory mirror of what is stored.
static void keyStepPage(int delta) {
  const size_t numPages = g_pages.size();
  if (numPages <= 1) {
    // There is nowhere to step to. Redrawing the page already on the panel
    // would cost a full 30 s refresh to produce the identical image, which is
    // the worst thing this button could do with the household's battery — so
    // this is the one press answered with a sound and deliberately nothing
    // else. Same soft "noted" double as a KEY0 tap on an unconfigured device.
    LOGF("[keys] page step ignored — %u page configured, nowhere to step\n", (unsigned)numPages);
    beepNoKey();
    return;
  }
  beepPageStep();  // acknowledge first: the press was now, the screen is 30 s away
  const int n = (int)numPages;
  g_activePageIdx = (g_activePageIdx + delta + n) % n;
  savePageIdx(g_activePageIdx);
  g_keyForceRender = true;
  if (g_packCommitted) g_keyRerenderPending = true;
  LOGF("[keys] page %s -> idx %d (\"%s\")%s\n", delta > 0 ? "forward" : "back", g_activePageIdx,
       g_pages[g_activePageIdx].id.c_str(),
       g_keyRerenderPending ? " — after this cycle picked its pack, re-running" : "");
}

// A KEY0 tap during the awake cycle, routed into the same runVoiceCapture()
// the wake path uses — including its no-STT-key branch, which beeps the soft
// beepNoKey() double and never powers the mic.
static void keyVoiceTap() {
  if (!g_keyCreds.valid) {
    // No credentials on file yet, so there is nothing to upload a clip to.
    // Same reading as the missing-key case: on a device this fresh, pressing
    // the biggest button is not a fault.
    LOGF("[keys] KEY0 tap with no WiFi credentials — nothing to transcribe\n");
    beepNoKey();
    return;
  }
  const int before = g_activePageIdx;
  bool wifiUp = WiFi.status() == WL_CONNECTED;
  runVoiceCapture(g_keyCreds, wifiUp);
  // A match already set g_serialForceRender, which covers the hash-skip. What
  // runVoiceCapture() cannot know is whether this cycle has already picked its
  // pack, in which case the page it matched needs a fresh cycle to be drawn.
  if (g_activePageIdx != before && g_packCommitted) g_keyRerenderPending = true;
}

// A both-arrows press made while the device is awake cannot be answered from
// where it is caught — the cycle is running, and the card costs a 30 s refresh
// that would fight whatever this cycle is about to draw. So it is recorded and
// answered by the next cycle, which is a fresh boot a second later
// (g_keyRerenderPending), and a plain global would not survive the sleep in
// between. NVS "help_req" is a one-shot: setup() takes it and clears it, so a
// request can never outlive the wake it was made for. Separate from the
// "card_on_screen" marker on purpose — that one records what IS on the panel,
// this one records what has been ASKED for and is not yet drawn.
static void requestHelpNextCycle() {
  Preferences prefs;
  prefs.begin("yat", false);
  prefs.putUChar("help_req", 1);
  prefs.end();
}

bool takeHelpRequest() {
  Preferences prefs;
  prefs.begin("yat", false);
  bool want = prefs.getUChar("help_req", 0) != 0;
  if (want) prefs.putUChar("help_req", 0);
  prefs.end();
  return want;
}

void processKeyLatches(const char* where, bool lastChance) {
  if (!g_keyIntsArmed) return;
  // The both-arrows window below works by leaving a lone arrow latch pending
  // for a later checkpoint to decide. At the last checkpoint before deep sleep
  // there is no later one — the press would sleep un-acted-on, and with the
  // finger already lifted nothing would wake the device to finish the job. So
  // this one waits the window out instead of deferring. It costs at most
  // KEY_BOTH_WINDOW_MS, only on a cycle where an arrow was pressed this late,
  // against a sleep about to last minutes.
  if (lastChance) {
    for (int i = 1; i <= 2; i++) {
      if (!keyLatchPending(i) || g_keyHeldAtArm[i]) continue;
      uint32_t age = millis() - g_keyEdgeMs[i];
      if (age < KEY_BOTH_WINDOW_MS) delay(KEY_BOTH_WINDOW_MS - age);
    }
  }
  for (int i = 0; i < 3; i++) {
    if (g_keyHeldAtArm[i]) {
      // Still the press that was in flight when the interrupts came up. Wait
      // for the finger to lift, then throw away whatever its release bounce
      // latched: one press, one action.
      if (digitalRead(KEY_PINS[i]) == HIGH) {
        g_keyHeldAtArm[i] = false;
        clearKeyLatch(i);
      }
      continue;
    }
    if (!keyLatchPending(i)) continue;

    if (i == 0) {
      if (g_keySetupMode) {  // setup mode has its own screen and its own gesture
        clearKeyLatch(0);
        continue;
      }
      if (digitalRead(PIN_KEY0) == LOW) {
        // The finger is still down, so this is either a tap in progress — act
        // on it at the next checkpoint, once it is actually a tap — or the 5 s
        // provisioning hold. That hold belongs to the wake path and stays
        // there: once the press outlasts the threshold the latch is dropped
        // rather than turned into a recording nobody asked for. A user who
        // keeps holding gets what they want anyway, because ext1 is
        // level-triggered on LOW: entering deep sleep with the button down
        // wakes the device immediately, and readKey0GestureAtWake() then sees
        // the hold it is written to see.
        if (millis() - g_keyEdgeMs[0] >= KEY0_HOLD_ABANDON_MS) {
          clearKeyLatch(0);
          LOGF("[keys] KEY0 still held during %s — leaving the hold to the wake path\n", where);
        }
        continue;
      }
      clearKeyLatch(0);
      LOGF("[keys] KEY0 tap during %s — tap-to-talk\n", where);
      keyVoiceTap();
      continue;
    }

    // Both arrows inside KEY_BOTH_WINDOW_MS of each other is the help gesture.
    // Which means a LONE arrow latch is not yet decidable — its partner may
    // still be on its way down — so it waits out the window rather than
    // committing to a page-step the user did not ask for. Nothing is lost by
    // waiting: the latch stays pending for a later checkpoint, and the
    // pre-sleep one (lastChance, above) waits the window out rather than
    // sleeping on an undecided press.
    const int other = i == 1 ? 2 : 1;
    const uint32_t edgeGap = g_keyEdgeMs[i] > g_keyEdgeMs[other] ? g_keyEdgeMs[i] - g_keyEdgeMs[other]
                                                                : g_keyEdgeMs[other] - g_keyEdgeMs[i];
    const bool bothArrows = keyLatchPending(other) && edgeGap <= KEY_BOTH_WINDOW_MS;
    if (!bothArrows && millis() - g_keyEdgeMs[i] < KEY_BOTH_WINDOW_MS) continue;

    clearKeyLatch(i);
    if (bothArrows) clearKeyLatch(other);
    if (g_keySetupMode) {
      // Setup mode owns the panel: its URL and QR are the entire reason the
      // screen is up, and paging away from them — or covering them with a help
      // card about pages the user is still in the middle of choosing — would
      // strand them. Acknowledge so the button is never silent, change nothing.
      LOGF("[keys] %s%s during %s — acknowledged, setup screen kept\n", KEY_NAMES[i],
           bothArrows ? "+the other arrow" : "", where);
      beepNoKey();
      continue;
    }
    if (bothArrows) {
      // This cycle is already under way and may already have committed to a
      // pack, so the card cannot be drawn from here. Ask for it, then let
      // g_keyRerenderPending cut the sleep to a second so the next cycle —
      // which is a fresh boot — draws it. The request has to outlive that
      // sleep, hence NVS rather than a global.
      LOGF("[keys] both arrows during %s — help card on the next cycle\n", where);
      beepPageStep();  // acknowledge now: the press was now, the screen is 30 s away
      requestHelpNextCycle();
      g_keyRerenderPending = true;
      continue;
    }
    LOGF("[keys] %s pressed during %s\n", KEY_NAMES[i], where);
    keyStepPage(i == 1 ? +1 : -1);
  }
}
