// Generated by the main.cpp module split: the code below is a verbatim
// slice of the original single-translation-unit firmware/src/main.cpp.

#include "yat_config.h"

#include <string.h>

#include <Preferences.h>

#include "welcome_pack.h"

#include "yat_errors.h"
#include "yat_state.h"

// ---------------- LittleFS: config + packs (ARCHITECTURE §4) ----------------
//
// Layout: /config.json + /packs/<id>.yat-pack.json. First boot (files missing)
// seeds a config pointing at the static "welcome" pack, plus that pack file, so
// a freshly-provisioned device shows a "now choose your content on the setup
// site" screen rather than silently defaulting to a real pack (which read as a
// leftover). Once the user picks pages on the site, config.json is overwritten
// and the filesystem is the source of truth; the embedded copies are only
// fallbacks (welcome for the unconfigured id, and for a totally unmounted FS).

extern const char* const DEFAULT_CONFIG_JSON =
    "{\n"
    "  \"v\": 2,\n"
    "  \"pages\": [\n"
    "    { \"id\": \"welcome\", \"pack\": \"welcome\", \"params\": {} }\n"
    "  ],\n"
    "  \"quiet_hours\": [\"23:30\", \"06:30\"],\n"
    // Seeded explicitly at their default values so the knobs are discoverable in
    // the file a user actually reads back with YAT GET, rather than only in the
    // docs.
    "  \"beep\": true,\n"
    "  \"voice\": { \"seconds\": 4 }\n"
    "}\n";

bool littlefsReadFile(const char* path, std::string& out) {
  if (!LittleFS.exists(path)) return false;
  File f = LittleFS.open(path, "r");
  if (!f || f.isDirectory()) return false;
  size_t sz = f.size();
  out.resize(sz);
  size_t rd = sz ? f.read(reinterpret_cast<uint8_t*>(&out[0]), sz) : 0;
  f.close();
  return rd == sz;
}

// Every pack and config write on the device goes through here (serial PUT, the
// portal's pack/apply handlers, the v1->v2 migration, the state store), so the
// write-in-place it used to do was one power cut away from an empty
// /config.json: opening the target "w" truncates it immediately, LittleFS only
// commits at close(), and the return value ignored the close entirely — a
// volume that filled up reported success and left a half-written file behind.
//
// Now the bytes go to "<path>.tmp" and the target is only replaced once the
// temp file is closed AND re-opened at exactly the expected size (Arduino's
// File::close() returns void, so re-stating the file is the only way to learn
// whether the commit actually happened). LittleFS.rename() replaces the target
// atomically, so an interruption at any point leaves either the old file or
// the new one, never a partial one.
static bool littlefsWriteFileRaw(const char* path, const void* data, size_t len) {
  std::string tmp = std::string(path) + ".tmp";
  LittleFS.remove(tmp.c_str());  // leftover from a write that was cut short
  File f = LittleFS.open(tmp.c_str(), "w");
  if (!f) {
    LOGF("[fs] %s: cannot open temp file\n", path);
    return false;
  }
  size_t wr = f.write(reinterpret_cast<const uint8_t*>(data), len);
  f.close();
  if (wr != len) {
    LOGF("[fs] %s: wrote %u of %u bytes — target left untouched\n", path, (unsigned)wr,
         (unsigned)len);
    LittleFS.remove(tmp.c_str());
    return false;
  }
  File check = LittleFS.open(tmp.c_str(), "r");
  size_t committed = check ? check.size() : 0;
  if (check) check.close();
  if (committed != len) {
    LOGF("[fs] %s: commit is %u bytes, expected %u — target left untouched\n", path,
         (unsigned)committed, (unsigned)len);
    LittleFS.remove(tmp.c_str());
    return false;
  }
  if (!LittleFS.rename(tmp.c_str(), path)) {
    LOGF("[fs] %s: rename from temp FAILED — target left untouched\n", path);
    LittleFS.remove(tmp.c_str());
    return false;
  }
  return true;
}

// Every one of the four ways the write above can fail ends up here, which is
// the point of the split: a storage failure is invisible from the panel (the
// old file is still there and still renders) and the household's only clue is
// that a page they saved never appeared. The path is the context because it is
// the one thing that distinguishes "your page list would not save" from "one
// pack file would not save" — and no path this function is ever handed is a
// secret; keys live in NVS, not on the filesystem.
bool littlefsWriteFile(const char* path, const void* data, size_t len) {
  if (littlefsWriteFileRaw(path, data, len)) {
    // Storage answered, so the §11.4a banner about it (raised by the
    // recordError below, on some earlier write) has nothing left to warn
    // about. Cheap: conditionClear does nothing at all when nothing is wrong.
    conditionClear(COND_STORAGE);
    return true;
  }
  recordError(ERR_FS_WRITE, path);
  return false;
}

void ensureDefaults() {
  if (!LittleFS.exists("/config.json")) {
    if (littlefsWriteFile("/config.json", DEFAULT_CONFIG_JSON, strlen(DEFAULT_CONFIG_JSON)))
      LOGF("[fs] wrote default /config.json\n");
    else
      LOGF("[fs] FAILED to write default /config.json\n");
  }
  if (!LittleFS.exists("/packs")) LittleFS.mkdir("/packs");
  if (!LittleFS.exists("/packs/welcome.yat-pack.json")) {
    if (littlefsWriteFile("/packs/welcome.yat-pack.json", WELCOME_PACK, strlen(WELCOME_PACK)))
      LOGF("[fs] seeded /packs/welcome.yat-pack.json from embedded copy\n");
    else
      LOGF("[fs] FAILED to seed welcome pack file\n");
  }
}

// Mirror of whatever quiet hours the loaded config asked for. The success path
// plans its sleep from a DeviceConfig it holds; the failure paths end the cycle
// several frames away from one (deepSleepError, refuseSetupLowBattery) and have
// to respect the same window — a permanently broken source must not wake the
// household's device through the night any more than a working one may. Kept
// current by loadConfig(), the only way a DeviceConfig is ever obtained.
std::string g_quietStart, g_quietEnd;

// Mirror of config.json's "beep", for the same reason: the cues it silences fire
// from button latches and from the very top of setup(), frames away from any
// DeviceConfig. Also written through to NVS, because one of them — the cold-boot
// chirp — happens before LittleFS is mounted and so has no config to consult;
// see restoreBeepPrefFromNvs() and loadConfig().
bool g_beepEnabled = true;

// Mirror of config.json's "loop_min", kept by loadConfig() for the same reason
// the two above are: YAT STATUS and GET /api/status both answer from console
// windows and portal requests that hold no DeviceConfig, and the setup UI reads
// this field back to show the household which rotation they picked. Nothing
// schedules from the mirror — computeSleepPlan() and maybeAdvanceLoopPage()
// take the config they were handed.
int g_loopMin = 0;

// Mirror of config.json's "llm_model", for the same reason again: the voice
// router runs from a KEY0 tap, several frames away from any DeviceConfig. Safe
// to read there because loadConfig() runs early in setup(), well before the
// button latches are answered — see the call above buildPageAliasCache().
std::string g_llmModel;

void restoreBeepPrefFromNvs() {
  Preferences prefs;
  prefs.begin("yat", true);
  g_beepEnabled = prefs.getUChar("beep", 1) != 0;
  prefs.end();
}

static DeviceConfig defaultDeviceConfig() {
  DeviceConfig cfg;
  ConfigPage p;
  p.id = "welcome";
  p.pack = "welcome";
  cfg.pages.push_back(p);
  return cfg;
}

// Absent/malformed "voice" object leaves the default; an out-of-range
// "seconds" is clamped and logged rather than rejecting the whole config —
// this knob is not load-bearing enough to cost someone their pages.
static void parseVoice(JsonVariantConst v, DeviceConfig& cfg) {
  if (!v.is<JsonObjectConst>()) return;
  JsonVariantConst secs = v["seconds"];
  if (!secs.is<int>()) return;
  int s = secs.as<int>();
  if (s < VOICE_SECONDS_MIN || s > VOICE_SECONDS_MAX) {
    int clamped = s < VOICE_SECONDS_MIN ? VOICE_SECONDS_MIN : VOICE_SECONDS_MAX;
    LOGF("[config] voice.seconds %d out of range (%d..%d) — clamping to %d\n", s,
         VOICE_SECONDS_MIN, VOICE_SECONDS_MAX, clamped);
    s = clamped;
  }
  cfg.voiceSeconds = s;
}

// Absent, or anything that isn't a JSON boolean, leaves the beeps on: a
// household that never touched the setting must not lose its cues to a
// hand-edited "beep": "false". Same "a knob is not load-bearing enough to cost
// someone their pages" rule the two above follow — never rejects the config.
static void parseBeep(JsonVariantConst b, DeviceConfig& cfg) {
  if (b.is<bool>()) cfg.beep = b.as<bool>();
}

// Absent, non-integer, or <= 0 leaves auto-rotate off: 0 is what a UI's "off"
// option most naturally writes, and "rotate every zero minutes" has never meant
// anything else. Anything else lands on a rung of kLoopMinChoices — never
// rejected, the same "a knob is not load-bearing enough to cost someone their
// pages" rule parseVoice/parseBeep follow.
static void parseLoopMin(JsonVariantConst v, DeviceConfig& cfg) {
  if (!v.is<int>()) return;
  const int asked = v.as<int>();
  if (asked <= 0) return;
  constexpr size_t kRungs = sizeof kLoopMinChoices / sizeof kLoopMinChoices[0];
  int chosen = kLoopMinChoices[kRungs - 1];
  for (int rung : kLoopMinChoices) {
    if (asked <= rung) {
      chosen = rung;
      break;
    }
  }
  if (chosen != asked)
    LOGF("[config] loop_min %d is not one of %d/%d/%d — using %d\n", asked, kLoopMinChoices[0],
         kLoopMinChoices[1], kLoopMinChoices[2], chosen);
  cfg.loopMin = chosen;
}

// Absent, non-string, empty, or longer than any real model id leaves the
// provider default in place. Never rejects the config — the same "a knob is not
// load-bearing enough to cost someone their pages" rule the three above follow,
// and it matters more here than anywhere: a typo in a hand-edited model name
// must cost a household its smart voice routing at worst, never its pages. The
// value is not checked against a list of known models, because that list would
// be stale the week after it shipped; a name the provider does not recognise
// comes back as an HTTP error the router already degrades from.
static void parseLlmModel(JsonVariantConst v, DeviceConfig& cfg) {
  if (!v.is<const char*>()) return;
  const char* m = v.as<const char*>();
  const size_t len = strlen(m);
  if (len == 0) return;
  if (len > kLlmModelMax) {
    LOGF("[config] llm_model is %u chars, over the %u cap — using the provider default\n",
         (unsigned)len, (unsigned)kLlmModelMax);
    return;
  }
  cfg.llmModel = m;
}

static void parseQuietHours(JsonVariantConst qh, DeviceConfig& cfg) {
  if (qh.is<JsonArrayConst>() && qh.size() == 2 && qh[0].is<const char*>() && qh[1].is<const char*>()) {
    cfg.quietStart = qh[0].as<const char*>();
    cfg.quietEnd = qh[1].as<const char*>();
  }
}

// v2 "pages" array -> DeviceConfig::pages. 1..16 entries, each needing a
// non-empty id + pack; anything else and the whole config is rejected (the
// caller falls back to built-in defaults, same "bad config -> keep last
// good, file untouched" policy v1 always used).
bool parsePagesFromV2(JsonVariantConst pagesNode, DeviceConfig& cfg) {
  if (!pagesNode.is<JsonArrayConst>()) return false;
  JsonArrayConst arr = pagesNode.as<JsonArrayConst>();
  size_t n = arr.size();
  if (n < 1 || n > 16) return false;
  std::vector<ConfigPage> pages;
  pages.reserve(n);
  for (JsonVariantConst pv : arr) {
    const char* id = pv["id"] | "";
    const char* pack = pv["pack"] | "";
    if (id[0] == '\0' || pack[0] == '\0') return false;
    ConfigPage p;
    p.id = id;
    p.pack = pack;
    JsonVariantConst params = pv["params"];
    if (!params.isNull()) serializeJson(params, p.paramsJson);
    JsonVariantConst aliases = pv["aliases"];
    if (aliases.is<JsonArrayConst>()) {
      for (JsonVariantConst a : aliases.as<JsonArrayConst>()) {
        const char* as = a | "";
        if (as[0] != '\0') p.aliases.push_back(as);
      }
    }
    // Optional. Absent or non-integer leaves the page on the pack's schedule,
    // and so does <= 0: "no override" is the thing a UI's default option most
    // naturally encodes as 0, and nobody has ever meant "refresh every zero
    // minutes" — clamping that up to the 5 min floor would quietly turn the
    // default choice into the most expensive cadence the device can run. A
    // genuine 1..4 is a real request and does clamp to the floor. Out-of-range
    // clamps rather than failing the whole config, for the same reason
    // parseVoice() clamps: a cadence knob is not load-bearing enough to cost
    // someone their pages.
    JsonVariantConst every = pv["every_min"];
    if (every.is<int>() && every.as<int>() > 0) {
      int e = every.as<int>();
      if (e < PAGE_EVERY_MIN_MIN || e > PAGE_EVERY_MIN_MAX) {
        int clamped = e < PAGE_EVERY_MIN_MIN ? PAGE_EVERY_MIN_MIN : PAGE_EVERY_MIN_MAX;
        LOGF("[config] page \"%s\" every_min %d out of range (%d..%d) — clamping to %d\n", id, e,
             PAGE_EVERY_MIN_MIN, PAGE_EVERY_MIN_MAX, clamped);
        e = clamped;
      }
      p.everyMin = e;
    }
    pages.push_back(std::move(p));
  }
  cfg.pages = std::move(pages);
  return true;
}

// v1 -> v2 auto-migration: wrap the old single page as pages[0], id = the
// pack name (v1's only identifier), quiet_hours carried over verbatim.
// Returns a document with no "v" key if v1Doc isn't actually valid v1 —
// callers already validate page.pack before calling this, so that's just a
// defensive backstop, not the normal path.
static JsonDocument migrateV1ToV2(JsonVariantConst v1Doc) {
  JsonDocument v2;
  const char* pack = v1Doc["page"]["pack"] | "";
  if (pack[0] == '\0') return v2;
  v2["v"] = 2;
  JsonArray pages = v2["pages"].to<JsonArray>();
  JsonObject p0 = pages.add<JsonObject>();
  p0["id"] = pack;
  p0["pack"] = pack;
  JsonVariantConst params = v1Doc["page"]["params"];
  if (!params.isNull()) p0["params"] = params;
  JsonVariantConst qh = v1Doc["quiet_hours"];
  if (qh.is<JsonArrayConst>()) v2["quiet_hours"] = qh;
  // "voice" is a v2 addition, so a genuine v1 file never has one — carried
  // over anyway, for the same reason quiet_hours is: a hand-edited hybrid
  // file must not silently lose a key on the migration write.
  JsonVariantConst voice = v1Doc["voice"];
  if (voice.is<JsonObjectConst>()) v2["voice"] = voice;
  // Same story as "voice": a v2-only key that a genuine v1 file never carries,
  // copied anyway so a hand-edited hybrid does not lose it on the migration
  // write and come back beeping at a household that turned the beeps off.
  JsonVariantConst beep = v1Doc["beep"];
  if (beep.is<bool>()) v2["beep"] = beep;
  // And the same again for auto-rotate: a v2-only key, carried over so a
  // hand-edited hybrid file does not come back with the rotation switched off.
  JsonVariantConst loop = v1Doc["loop_min"];
  if (loop.is<int>()) v2["loop_min"] = loop;
  // And once more for the router's model override. A v1 file has no business
  // carrying one, but the whole point of this function is that a hand-edited
  // hybrid does not lose keys it happens to have — and this one is only ever
  // set by hand, so it is the likeliest of the five to be in a file like that.
  JsonVariantConst llmModel = v1Doc["llm_model"];
  if (llmModel.is<const char*>()) v2["llm_model"] = llmModel;
  return v2;
}

// Bad/missing config.json -> built-in defaults, file left untouched for
// diagnosis over the serial protocol (ARCHITECTURE §4 "bad config -> keep
// last good"). There is no other "last good" snapshot — the built-in
// defaults are it. A well-formed v1 file is the one exception that DOES
// write the file: it's auto-migrated to v2 in place (see migrateV1ToV2)
// so every later boot loads v2 directly.
static DeviceConfig loadConfigFromFs(bool fsReady) {
  DeviceConfig cfg = defaultDeviceConfig();
  if (!fsReady) {
    LOGF("[config] littlefs unavailable — using built-in defaults (pack=%s)\n",
         cfg.pages[0].pack.c_str());
    return cfg;
  }
  std::string raw;
  if (!littlefsReadFile("/config.json", raw)) {
    LOGF("[config] /config.json missing/unreadable — using built-in defaults\n");
    return cfg;
  }
  JsonDocument doc;
  DeserializationError derr = deserializeJson(doc, raw);
  if (derr) {
    LOGF("[config] invalid /config.json (%s) — keeping built-in defaults, file left untouched\n",
         derr.c_str());
    return cfg;
  }

  int v = doc["v"] | 0;
  JsonDocument migratedHolder;  // keeps the migrated doc alive for the pages/quiet_hours/voice/beep/loop_min/llm_model nodes below
  JsonVariantConst pagesNode, quietHoursNode, voiceNode, beepNode, loopNode, llmModelNode;

  if (v == 1) {
    const char* pack = doc["page"]["pack"] | "";
    if (pack[0] == '\0') {
      LOGF("[config] invalid v1 /config.json (missing page.pack) — keeping built-in defaults, "
           "file left untouched\n");
      return cfg;
    }
    migratedHolder = migrateV1ToV2(doc);
    std::string migratedJson;
    serializeJson(migratedHolder, migratedJson);
    if (littlefsWriteFile("/config.json", migratedJson.data(), migratedJson.size()))
      LOGF("[config] migrated v1 -> v2 /config.json (pack \"%s\" -> pages[0] id \"%s\")\n", pack,
           pack);
    else
      LOGF("[config] v1->v2 migration write FAILED — proceeding with in-memory v2 this cycle "
           "only\n");
    pagesNode = migratedHolder["pages"];
    quietHoursNode = migratedHolder["quiet_hours"];
    voiceNode = migratedHolder["voice"];
    beepNode = migratedHolder["beep"];
    loopNode = migratedHolder["loop_min"];
    llmModelNode = migratedHolder["llm_model"];
  } else if (v == 2) {
    pagesNode = doc["pages"];
    quietHoursNode = doc["quiet_hours"];
    voiceNode = doc["voice"];
    beepNode = doc["beep"];
    loopNode = doc["loop_min"];
    llmModelNode = doc["llm_model"];
  } else {
    LOGF("[config] invalid /config.json (unknown v=%d) — keeping built-in defaults, file left "
         "untouched\n",
         v);
    return cfg;
  }

  DeviceConfig parsed;
  if (!parsePagesFromV2(pagesNode, parsed)) {
    LOGF("[config] invalid /config.json (bad pages[], need 1..16 entries with id+pack) — keeping "
         "built-in defaults, file left untouched\n");
    return cfg;
  }
  parseQuietHours(quietHoursNode, parsed);
  parseVoice(voiceNode, parsed);
  parseBeep(beepNode, parsed);
  parseLoopMin(loopNode, parsed);
  parseLlmModel(llmModelNode, parsed);
  char loopDesc[24];
  if (parsed.loopMin > 0) snprintf(loopDesc, sizeof loopDesc, "every %d min", parsed.loopMin);
  else snprintf(loopDesc, sizeof loopDesc, "off");
  LOGF("[config] %u page(s), quiet_hours=%s, voice %d s, beep %s, auto-rotate %s\n",
       (unsigned)parsed.pages.size(),
       parsed.quietStart.empty() ? "none" : (parsed.quietStart + "-" + parsed.quietEnd).c_str(),
       parsed.voiceSeconds, parsed.beep ? "on" : "off", loopDesc);
  // Its own line, and only when set: the override is rare enough that folding
  // it into the line above would put "(default)" in every log this device ever
  // writes to say nothing.
  if (!parsed.llmModel.empty())
    LOGF("[config] llm_model \"%s\" — overrides the voice router's default model\n",
         parsed.llmModel.c_str());
  return parsed;
}

// Wrapper over the parse above so that every path that loads a config also
// refreshes the g_quietStart/g_quietEnd, g_beepEnabled and g_loopMin mirrors — including
// the several early returns that fall back to built-in defaults (no quiet
// hours, so the mirror must be cleared rather than left holding the last boot's
// values). The beep mirror also gets written through to NVS, where the
// pre-mount cold-boot chirp reads it; only on a change, because that chirp is
// the one reader and flash wear here would be paid every single wake.
DeviceConfig loadConfig(bool fsReady) {
  DeviceConfig cfg = loadConfigFromFs(fsReady);
  g_quietStart = cfg.quietStart;
  g_quietEnd = cfg.quietEnd;
  if (cfg.beep != g_beepEnabled) {
    Preferences prefs;
    prefs.begin("yat", false);
    prefs.putUChar("beep", cfg.beep ? 1 : 0);
    prefs.end();
    LOGF("[beep] acknowledgement beeps %s\n", cfg.beep ? "on" : "off");
  }
  g_beepEnabled = cfg.beep;
  g_loopMin = cfg.loopMin;
  g_llmModel = cfg.llmModel;
  return cfg;
}

// The device writing back a page's params is new with voice intents, and it is
// the one place config.json changes without anybody opening the portal. So it
// is deliberately a read-modify-write of the PARSED file rather than a
// regeneration from DeviceConfig: a DeviceConfig round trip only knows the keys
// this firmware parses, and would silently drop anything a newer portal — or a
// hand edit — put in the file. The page is found by id rather than by index for
// the same reason the portal validates before it writes: g_pages and the array
// on disk are built from the same bytes this boot, but if they ever disagree,
// writing the wrong page's params is not a failure anyone would notice until
// their list came back wrong.
bool savePageParams(int pageIdx, const std::string& paramsJson) {
  if (pageIdx < 0 || (size_t)pageIdx >= g_pages.size()) return false;
  if (!g_fsReady) {
    LOGF("[config] cannot save page params — filesystem not mounted\n");
    return false;
  }
  std::string raw;
  if (!littlefsReadFile("/config.json", raw)) {
    LOGF("[config] cannot save page params — /config.json unreadable\n");
    return false;
  }
  JsonDocument doc;
  if (deserializeJson(doc, raw, DeserializationOption::NestingLimit(24))) {
    LOGF("[config] cannot save page params — /config.json no longer parses\n");
    return false;
  }
  JsonVariant pagesNode = doc["pages"];
  if (!pagesNode.is<JsonArray>()) {
    // v1 is impossible here: loadConfig() migrates the file to v2 in place at
    // the top of every cycle, long before anything reaches this function.
    LOGF("[config] cannot save page params — /config.json has no v2 pages[]\n");
    return false;
  }
  JsonObject target;
  for (JsonVariant pv : pagesNode.as<JsonArray>()) {
    if (!pv.is<JsonObject>()) continue;
    if (g_pages[pageIdx].id == (pv["id"] | "")) {
      target = pv.as<JsonObject>();
      break;
    }
  }
  if (target.isNull()) {
    LOGF("[config] cannot save page params — page \"%s\" is not in /config.json\n",
         g_pages[pageIdx].id.c_str());
    return false;
  }
  JsonDocument params;
  if (deserializeJson(params, paramsJson, DeserializationOption::NestingLimit(24))) return false;
  if (!target["params"].set(params.as<JsonVariantConst>())) {
    LOGF("[config] cannot save page params — out of memory building the new config\n");
    return false;
  }
  std::string out;
  serializeJson(doc, out);
  // The same ceiling the portal's own apply path enforces on an uploaded
  // config. A full todo list is ~3.5 KB of this, so nothing the intent grammar
  // can do gets near it; the check is here because this is the one writer that
  // GROWS the file without a human watching, and a config too big to be
  // uploaded again would be a config nobody could fix from the portal.
  if (out.size() > CONTENT_PORTAL_MAX_BODY) {
    LOGF("[config] refusing to save page params — config would be %u bytes, over the %u cap\n",
         (unsigned)out.size(), (unsigned)CONTENT_PORTAL_MAX_BODY);
    return false;
  }
  if (!littlefsWriteFile("/config.json", out.data(), out.size())) return false;
  // Only after the bytes are committed: the in-memory mirror is what this
  // cycle's refresh renders from, and it must never claim a change the file
  // does not have.
  g_pages[pageIdx].paramsJson = paramsJson;
  return true;
}

// ---------------- active page index (NVS "page_idx") ----------------
//
// The active page survives across sleeps in Preferences namespace "yat"
// (same one wifi creds/hash/epoch already use), keyed "page_idx". Read fresh
// (not cached) everywhere it matters this cycle: g_activePageIdx below is the
// in-memory mirror, kept equal to NVS by calling savePageIdx() on every
// mutation (button press, YAT USE, or promoting a fallback page to active).

int loadClampedPageIdx(size_t numPages) {
  Preferences prefs;
  prefs.begin("yat", true);
  uint32_t idx = prefs.getUInt("page_idx", 0);
  prefs.end();
  if (numPages == 0) return 0;  // defensive; DeviceConfig always has >= 1 page
  if (idx >= numPages) {
    LOGF("[pages] stored page_idx %u out of range (0..%u) — clamping to 0\n", (unsigned)idx,
         (unsigned)(numPages - 1));
    idx = 0;
  }
  return (int)idx;
}

// NVS "loop_at": when the page now on the panel became the active one, which is
// where auto-rotate measures its interval from. A wall-clock epoch rather than a
// countdown, because the device is asleep for nearly all of it and nothing else
// survives that; 0 means "not known" — no real clock at the moment the page
// changed — which the advance below reads as "start the interval at the first
// wake that does have one".
time_t g_loopOriginEpoch = 0;

void saveLoopOrigin(time_t when) {
  g_loopOriginEpoch = when;
  Preferences prefs;
  prefs.begin("yat", false);
  prefs.putULong64("loop_at", (uint64_t)when);
  prefs.end();
}

time_t loadLoopOrigin() {
  Preferences prefs;
  prefs.begin("yat", true);
  uint64_t at = prefs.getULong64("loop_at", 0);
  prefs.end();
  return (time_t)at;
}

void savePageIdx(int idx) {
  Preferences prefs;
  prefs.begin("yat", false);
  prefs.putUInt("page_idx", (uint32_t)idx);
  prefs.end();
  // Every page change goes through this one function — a button press, YAT
  // USE, a voice match, a portal apply, the fallback promotion, and the
  // rotation's own advance — and all of them mean the same thing to
  // auto-rotate: the page that just landed starts its interval now. So the
  // page somebody deliberately chose is shown for a full interval rather than
  // being rotated away from seconds later, and the rotation itself gets its
  // origin stamped without a second call to remember.
  const time_t now = time(nullptr);
  saveLoopOrigin(now > CLOCK_SANE_EPOCH ? now : 0);
}

// In-memory mirror of the active page, set once per cycle in setup() and
// from then on kept in sync with NVS; g_pages is a snapshot of the loaded
// config's page list, both here so the serial protocol section (YAT
// PAGES/USE, below) doesn't need setup()'s locals threaded through.
std::vector<ConfigPage> g_pages;
int g_activePageIdx = 0;
// Mirror of the loaded config's voice.seconds, set once per cycle in setup()
// alongside g_pages — read by the voice capture section and YAT STATUS, both
// of which run without setup()'s DeviceConfig in scope.
int g_voiceSeconds = VOICE_SECONDS_DEFAULT;
