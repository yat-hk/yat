// Generated by the main.cpp module split: the code below is a verbatim
// slice of the original single-translation-unit firmware/src/main.cpp.

#include "yat_provision.h"

#include <stdio.h>

#include <Preferences.h>
#include <WiFi.h>
#include <driver/rtc_io.h>
#include <esp_sleep.h>

#include "yat_beep.h"
#include "yat_buttons.h"
#include "yat_console.h"
#include "yat_hw.h"
#include "yat_net.h"
#include "yat_portal.h"
#include "yat_sched.h"
#include "yat_screens.h"
#include "yat_state.h"

// ---------------- provisioning (ARCHITECTURE §8, PRD §4.1/§4.3) ----------------
//
// Three triggers land here (checked in setup(), before any WiFi connect
// attempt): no credentials yet (first boot), KEY0 held >= 5 s at this wake, or
// 3 consecutive connect failures. Once here, two independent paths can supply
// credentials — whichever completes first wins:
//
//   - WiFiManager captive portal: AP "YAT-<last4 of MAC>", QR-joinable: the
//     panel shows a QR for the AP itself (WIFI: payload) and a QR for the
//     portal URL, plus the same credentials as bilingual text. Its HTTP/DNS
//     pump (WiFiManager::process()) runs on a FreeRTOS task pinned to core 0
//     — ported from the e1002-test prototype (private)'s src/wifidemo/main.cpp,
//     whose header comment nails the reason: a ~30 s blocking e-paper
//     refresh on the loop task is exactly the window in which a freshly
//     joined phone requests the captive portal page, and a single-task
//     design would leave it hanging.
//   - Improv-serial: identify / get-device-info / set-credentials over
//     Serial, for the future WebSerial flasher site (no AP dance at all).
//     Active here and during every normal cycle's console windows alike
//     (pumpConsoleByte(), serial file protocol section above).
//
// Either path calls saveWifiCreds() and this function reboots into the normal
// cycle, which then finds valid NVS credentials and connects immediately.

// SSID/password derived from the efuse MAC: stable across reboots and
// re-provisioning, so a printed sticker of the QR stays valid. Called once,
// unconditionally, early in setup() — cheap (no radio join), and needed
// either way as the Improv "device name" even on a boot that doesn't end up
// provisioning.
void buildApCreds() {
  uint64_t efuse = ESP.getEfuseMac();
  // Derive the AP suffix from the eFuse MAC, NOT WiFi.macAddress(): the latter
  // returns 00:00:00:00:00:00 until the radio has been started, so every device
  // advertised the same "YAT-0000". getEfuseMac() is valid with the radio off.
  // Bytes 4-5 are the last two of the printed STA MAC, so "YAT-EEFF" would match
  // a MAC sticker; stable across reboots/re-provisioning, unique per device.
  snprintf(g_apSsid, sizeof(g_apSsid), "YAT-%02X%02X", (uint8_t)(efuse >> 32),
           (uint8_t)(efuse >> 40));

  uint64_t h = efuse;
  h ^= h >> 21;
  h ^= h << 7;
  h ^= h >> 33;
  static const char kAlnum[] = "23456789ABCDEFGHJKLMNPQRSTUVWXYZ";  // no 0/O/1/I ambiguity
  const int base = sizeof(kAlnum) - 1;
  for (int i = 0; i < 8; i++) {
    g_apPass[i] = kAlnum[h % base];
    h /= base;
  }
  g_apPass[8] = '\0';

  snprintf(g_qrWifiPayload, sizeof(g_qrWifiPayload), "WIFI:T:WPA;S:%s;P:%s;;", g_apSsid, g_apPass);
}

// Injected into the portal's <head> via setCustomHeadElement(), which the
// library appends after its own <style> block — so this wins over anything in
// yat_wm_strings.h's HTTP_STYLE. Self-contained (no external assets) since the
// portal is served offline from the device's own AP.
//
// A ::after footnote rather than the banner this used to be: the same rule now
// leads the network-name label on the scan page (HTTP_FORM_WIFI), which is
// where the choice actually gets made, so up here it only has to stay visible
// — not shout. Keeping the literal in one place is what the G4 sync note
// above is about; the label wording is deliberately different prose.
static const char WIFI_BAND_NOTICE_HEAD[] PROGMEM =
    "<style>body::after{content:'只支援 2.4GHz WiFi · 2.4 GHz networks only';"
    "display:block;text-align:center;font-size:.8rem;color:#6f685c;"
    "padding:18px 16px 28px}</style>";


Key0Gesture readKey0GestureAtWake() {
  if (esp_sleep_get_wakeup_cause() != ESP_SLEEP_WAKEUP_EXT1) return Key0Gesture::None;
  uint64_t status = esp_sleep_get_ext1_wakeup_status();
  if (!(status & (1ULL << PIN_KEY0))) return Key0Gesture::None;

  // lowLevelSleep() arms the buttons through the RTC IO mux (rtc_gpio_init +
  // a pull-up held across sleep, with the RTC peripheral domain kept powered),
  // so hand the pad back to the digital GPIO matrix before reading it — a pin
  // still routed to RTC can read as a constant low, which would turn every
  // tap into a phantom 5 s hold and drop the device into provisioning.
  rtc_gpio_deinit((gpio_num_t)PIN_KEY0);
  pinMode(PIN_KEY0, INPUT_PULLUP);
  delay(2);  // let the pull-up settle after the mux switch

  LOGF("[boot] KEY0 wake — sampling: release = voice, held 5 s = re-provision\n");
  // The press itself caused this wake, so the finger has already been down for
  // the whole boot before sampling starts here. The 5 s threshold is measured
  // from power-on (millis() ≈ time since the press), not from this line —
  // otherwise "hold five seconds" really means "hold seven or eight". If boot
  // somehow took longer than the threshold (first-boot filesystem format), we
  // can't credit what we didn't watch: require a short confirm window instead
  // so a tap is never misread as a hold.
  uint32_t t0 = millis();
  uint32_t deadline = t0 < 5000 ? 5000 : t0 + 1500;
  while (millis() < deadline) {
    if (digitalRead(PIN_KEY0) == HIGH) {
      LOGF("[boot] KEY0 released after %lu ms — tap (voice capture)\n",
           (unsigned long)(millis() - t0));
      return Key0Gesture::Tap;
    }
    delay(20);
  }
  LOGF("[boot] KEY0 held >= 5 s — re-entering provisioning\n");
  beepHoldConfirmed();  // audible "held long enough, let go" — button is still down here
  return Key0Gesture::Hold;
}

static void portalPumpTask(void*) {
  for (;;) {
    if (g_wm.process()) {  // true once portal-entered creds connect
      g_portalSuccess = true;
      g_portalTaskHandle = nullptr;
      vTaskDelete(nullptr);
    }
    vTaskDelay(pdMS_TO_TICKS(2));
  }
}

// Frees port 80 — and WiFiManager's captive-portal DNS socket — before our own
// server wants them. The pump task deletes itself on the portal-success path
// but is still running when Improv is what finished, so it has to go first:
// WiFiManager's internals are not safe to tear down underneath process().
static void stopProvisioningPortal() {
  if (g_portalTaskHandle) {
    vTaskDelete(g_portalTaskHandle);
    g_portalTaskHandle = nullptr;
    delay(20);
  }
  g_wm.stopConfigPortal();
  // stopConfigPortal() restores the WiFi mode it found on the way in, which is
  // the AP_STA we set below — undo that explicitly. STA stays connected; only
  // the AP goes away, which is what the next e-paper refresh needs.
  WiFi.softAPdisconnect(false);
  WiFi.mode(WIFI_STA);
  delay(100);
}

// Consecutive UNATTENDED entries into provisioning (NVS "prov_n"), and the
// whole reason audit #10 exists. A device that cannot reach its network — a
// router that never came back, a household away for a fortnight — re-enters
// this mode on every retry, and each entry used to replay the three rising
// setup tones and spend a full ~30 s refresh redrawing a screen identical to
// the one already on the panel. Nobody is there to hear it or read it: it is a
// beeping, refreshing device in an empty flat, on battery.
//
// So a streak's FIRST entry behaves exactly as it always did — beep, draw, open
// the portal — and every entry after it stays silent and leaves the panel
// alone, with the retry sleep stepping 30 -> 60 -> 180 min (quiet hours
// honored, like every other backoff here). Anything that means a person is
// present resets the streak to zero: holding the green button, or credentials
// actually landing. So does an ordinary cycle that never came in here at all
// (see setup()).
static constexpr uint32_t PROV_RETRY_SLEEP_MID_MIN = 60;
static constexpr uint32_t PROV_RETRY_SLEEP_MAX_MIN = 180;

static uint32_t bumpProvisionStreak() {
  Preferences prefs;
  prefs.begin("yat", false);
  uint32_t n = prefs.getUInt("prov_n", 0) + 1;
  prefs.putUInt("prov_n", n);
  prefs.end();
  return n;
}

// Takes no handle, unlike clearErrorStreak: its callers are nowhere near an
// open Preferences. Writes only when there is something to clear — the common
// case is a device that has never failed to reach its network.
void clearProvisionStreak() {
  Preferences prefs;
  prefs.begin("yat", false);
  uint32_t n = prefs.getUInt("prov_n", 0);
  if (n) {
    prefs.putUInt("prov_n", 0);
    LOGF("[provision] clearing the %u-entry unattended setup streak\n", (unsigned)n);
  }
  prefs.end();
}

static uint32_t provisionRetryMinutes(uint32_t streak) {
  return streak <= 1 ? PORTAL_RETRY_SLEEP_MIN
                     : (streak == 2 ? PROV_RETRY_SLEEP_MID_MIN : PROV_RETRY_SLEEP_MAX_MIN);
}

// Where both ways out of an unattended provisioning entry end: the portal timed
// out with nobody there, or it was never opened at all (see the quiet-retry
// branch in runProvisioningMode). Same discipline as deepSleepError's ladder — a
// repair nobody is home for must not wake the household's device through the
// night either. The clock on this path usually comes from restoreClockFromNvs(),
// since a device that cannot reach WiFi never got as far as SNTP.
[[noreturn]] static void deepSleepProvisionRetry(uint32_t streak, const char* whatHappened) {
  const uint32_t minutes = provisionRetryMinutes(streak);
  char why[256];
  const time_t now = time(nullptr);
  uint64_t quietSecs = 0;
  std::string what;
  if (now > CLOCK_SANE_EPOCH &&
      applyQuietHours(g_quietStart, g_quietEnd, now, (uint64_t)minutes * 60ULL, quietSecs, what) !=
          QuietFit::NotApplicable) {
    snprintf(why, sizeof why, "%s (entry %u, retry %u min) — %s", whatHappened, (unsigned)streak,
             (unsigned)minutes, what.c_str());
    g_plannedSleepSeconds = quietSecs;
    lowLevelSleep(quietSecs * 1000000ULL, why);
  }
  snprintf(why, sizeof why, "%s (entry %u, retry %u min)", whatHappened, (unsigned)streak,
           (unsigned)minutes);
  deepSleepMinutes(minutes, why);
}

// Credentials are in. Either hand straight over to the content portal — the
// out-of-box path, where WiFi and content are one continuous errand from the
// user's side and a reboot in the middle only ever showed them a screen
// telling them to go elsewhere — or reboot into the normal cycle, which is
// right for the unattended repair trigger where nobody is standing there.
[[noreturn]] static void finishProvisioning(bool thenPortal) {
  stopProvisioningPortal();
  clearProvisionStreak();  // a network was reached: whatever the streak was, it is over
  if (thenPortal) {
    LOGF("[provision] WiFi done — handing straight over to the content portal\n");
    runContentPortal(PortalEntry::Provisioned);
  }
  LOGF("[provision] rebooting into normal cycle\n");
  Serial.flush();
  delay(300);
  ESP.restart();
  // ESP.restart() is the Arduino wrapper, which is not declared [[noreturn]]
  // even though it never comes back; spin so this function's own contract
  // still holds for the compiler.
  for (;;) delay(1000);
}

// Does not return: either credentials arrive (portal or Improv) and the device
// continues into setup or the normal cycle (finishProvisioning), or it waits
// out its timeout pumping both.
//
// `userInitiated` is the green button: somebody is standing in front of the
// device, so the beep and the screen are for them and the streak above resets.
// Everything else here is an unattended repair.
[[noreturn]] void runProvisioningMode(const char* reasonZh, const char* reasonEn,
                                             bool thenPortal, bool userInitiated) {
  LOGF("[provision] entering WiFi provisioning (%s)\n", reasonEn);
  LOGF("[provision] AP \"%s\" / \"%s\"\n", g_apSsid, g_apPass);

  uint32_t streak = 0;
  if (userInitiated) {
    clearProvisionStreak();
  } else {
    streak = bumpProvisionStreak();
  }

  // Staying quiet is only allowed while the panel is still holding one of the
  // two screens this mode draws. If something else got in front of them — a
  // low-battery card, a reboot that rendered a page — then the household has
  // nothing on screen about setup at all, and skipping the refresh would leave
  // them with no instructions rather than sparing them a duplicate.
  ScreenCard panelNow = loadScreenCard();
  const bool panelAlreadySaysSetup =
      panelNow == ScreenCard::Provisioning || panelNow == ScreenCard::SetupClosed;
  const bool quietRetry = streak >= 2 && panelAlreadySaysSetup;
  if (quietRetry)
    LOGF("[provision] unattended retry %u — panel already says setup, staying silent and leaving "
         "it alone\n",
         (unsigned)streak);

  // ...and when the screen it is leaving alone is the CLOSED one, don't open the
  // portal either. That combination — 「設定閂咗 · 撳住綠色掣…就可以再開」 on the
  // panel while an AP called YAT-XXXX beacons for ten minutes behind it — was
  // simply false: setup was not closed, it was wide open, and the one instruction
  // on screen was the one thing nobody needed to do. It also cost the most
  // expensive ten minutes this firmware has, on every retry, in an empty flat,
  // for a portal statistically nobody is there to open.
  //
  // Suppressing it makes the panel exactly true and the retry nearly free. The
  // recovery this mode exists for is untouched: it never came from the AP, it
  // comes from wifiConnect() at the top of the next cycle trying the saved
  // credentials again, which is what actually rescues a router that came back.
  // And the way back in is the one the card already names — a green button held
  // 5 s is userInitiated, which zeroes the streak and always gets the full
  // portal, beep and screen included.
  const bool apSuppressed = quietRetry && panelNow == ScreenCard::SetupClosed;
  if (apSuppressed) {
    LOGF("[provision] 「設定閂咗」 is on the panel — not raising the AP for this retry, sleeping "
         "instead (green button reopens setup)\n");
    deepSleepProvisionRetry(streak, "unattended retry, setup closed on panel, AP not raised");
  }

  // Past the last exit: from here this call really is setup mode and really
  // never returns, so the page buttons only acknowledge.
  g_keySetupMode = true;

  if (!quietRetry)
    beepEnterSetup();  // audible "I'm alive, in setup mode" before the ~30 s blocking refresh

  // Draw the setup screen FIRST, with the radio still OFF. The ~30 s e-paper
  // refresh is a heavy current draw; doing it while the AP radio is already up
  // spikes total current enough to brown the board out and reset it mid-setup
  // (observed on hardware: rst:0x1 POWERON right at the refresh's end, which
  // dropped the device out of provisioning before any content command landed).
  // The QR codes and AP credentials are all MAC-derived (buildApCreds), so
  // nothing on this screen needs the radio — draw it, refresh, THEN power up
  // the AP. Keeps the two current spikes from ever overlapping.
  if (!quietRetry) {
    LOGF("[epd] init...\n");
    epaper.begin();
    g_panelReady = true;
    drawProvisioningScreen(reasonZh, reasonEn);
    // Two QR codes on one screen — the deepest the firmware's OWN drawing gets
    // (prov::drawQR carries both qrcodegen scratch buffers in one frame).
    logStackHeadroom("the provisioning screen (2 QR codes)");
    panelRefresh("");
    saveScreenCard(ScreenCard::Provisioning);
    panelNow = ScreenCard::Provisioning;
  }

  // Radio on only now that the big refresh is done.
  WiFi.mode(WIFI_AP_STA);
  g_wm.setConfigPortalBlocking(false);
  g_wm.setConnectTimeout(15);
  // Ends up in every page's <title>, which yat_wm_strings.h suffixes with
  // "· YAT 日" — so the phone's tab reads as the product, not as a dev board.
  g_wm.setTitle("設定 Wi-Fi Set up Wi-Fi");
  // Gives HTTP_HEAD_END's {c} token something real to land on; without it the
  // library emits the literal class='{c}' (it only substitutes when a class is
  // set). Nothing depends on the name — the theme styles bare elements.
  g_wm.setClass("yat");
  // G4: same 2.4 GHz notice as the e-paper screen, as a page footnote.
  g_wm.setCustomHeadElement(WIFI_BAND_NOTICE_HEAD);
  // The portal a customer sees is the scan/connect flow and nothing else. The
  // stock menu is {wifi, info, exit, sep, update}: Info is a wall of chip
  // internals, Exit closes the portal with no way back short of another 5 s
  // button hold, and Update offers to take a firmware .bin over a captive
  // portal that cannot even open a file picker. Erase is not in the default
  // menu but the /info page grows a button for it, hence the two flags — the
  // pages still answer if a developer types the URL, they are just not offered.
  static const char* kPortalMenu[] = {"wifi"};
  g_wm.setMenu(kPortalMenu, 1);
  g_wm.setShowInfoErase(false);
  g_wm.setShowInfoUpdate(false);
  // G9: bound the portal — see PORTAL_TIMEOUT_S's declaration. The loop
  // below notices when WiFiManager gives up on its own and sleeps instead of
  // spinning forever at full AP power.
  g_wm.setConfigPortalTimeout(PORTAL_TIMEOUT_S);
  g_wm.startConfigPortal(g_apSsid, g_apPass);
  LOGF("[provision] captive portal starting, AP live at 192.168.4.1\n");

  // Pinned to core 0 so the portal's DNS+HTTP pump (and the YAT console for
  // content setup) stay responsive for the whole provisioning window.
  xTaskCreatePinnedToCore(portalPumpTask, "portal", 12288, nullptr, 1, &g_portalTaskHandle, 0);

  uint32_t lastBlink = millis();
  bool ledOn = false;
  for (;;) {
    pumpConsoleByte();
    processKeyLatches("wifi setup");

    if (g_portalSuccess) {
      saveWifiCreds(WiFi.SSID().c_str(), WiFi.psk().c_str());
      LOGF("[provision] portal connected (%s)\n", WiFi.SSID().c_str());
      finishProvisioning(thenPortal);  // [[noreturn]]
    }
    if (g_improvSaved) {
      LOGF("[provision] improv connected\n");
      finishProvisioning(thenPortal);  // [[noreturn]]
    }
    // G9: WiFiManager gave up on its own (PORTAL_TIMEOUT_S elapsed, nobody
    // completed it) — stop burning battery in AP mode. The saved credentials
    // are untouched in NVS; they get one more try on the next scheduled
    // wake, and if the network is back by then the device recovers with no
    // one home to press a button.
    if (!g_wm.getConfigPortalActive()) {
      LOGF("[provision] portal timed out after %u s with no credentials (entry %u of this "
           "streak) — sleeping %u min, will retry saved credentials on next wake\n",
           (unsigned)PORTAL_TIMEOUT_S, (unsigned)streak,
           (unsigned)provisionRetryMinutes(streak));

      // audit #15: never leave the live-looking QR standing. The transmitter
      // comes down first — the power rule is absolute — and only then does the
      // panel get the calm card that replaces the QR screen. Keyed off what is
      // actually on the panel rather than off quietRetry: a QR drawn this entry
      // must always be taken away, and a closed-card already up must never be
      // redrawn, which between them cost a silent retry no refresh at all.
      //
      // Deliberately NOT stopProvisioningPortal(): WiFiManager has already run
      // its own shutdownConfigPortal() from inside process() — that is exactly
      // what made getConfigPortalActive() false — and it frees its WebServer
      // there, so a second stopConfigPortal() would dereference a null one. It
      // also already dropped the AP and restored WIFI_STA; this repeats the
      // radio half explicitly because the library's own comment there admits
      // softAPdisconnect sometimes fails, and a 30 s refresh is not the place
      // to find out. The pump task is all that is left to take down.
      if (g_portalTaskHandle) {
        vTaskDelete(g_portalTaskHandle);
        g_portalTaskHandle = nullptr;
        delay(20);
      }
      WiFi.softAPdisconnect(false);
      WiFi.mode(WIFI_STA);
      delay(100);
      if (panelNow != ScreenCard::SetupClosed) {
        drawSetupClosedCard();
        saveScreenCard(ScreenCard::SetupClosed);
      }
      deepSleepProvisionRetry(streak, "provisioning portal timeout");
    }

    if (millis() - lastBlink > 500) {  // slow heartbeat while waiting for either path
      lastBlink = millis();
      ledOn = !ledOn;
      digitalWrite(PIN_LED, ledOn ? LOW : HIGH);
    }
    delay(10);
  }
}
