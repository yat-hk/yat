// Generated by the main.cpp module split: the code below is a verbatim
// slice of the original single-translation-unit firmware/src/main.cpp.

#include "yat_voice.h"

#include <cctype>
#include <stdio.h>
#include <string.h>

#include <ESP_I2S.h>
#include <HTTPClient.h>
#include <LittleFS.h>
#include <Preferences.h>
#include <WiFi.h>
#include <WiFiClientSecure.h>

#include "certs.h"
#include "s2t_table.h"

#include "yat_beep.h"
#include "yat_errors.h"
#include "yat_hw.h"
#include "yat_llm.h"
#include "yat_sched.h"
#include "yat_state.h"

// ---------------- voice keyword matcher (PACK-SPEC §2 "aliases") ----------------
//
// `YAT SAY <text>` (serial protocol section below) matches a free-form
// transcript against every configured page's alias list and, on a hit,
// switches the active page — the same NVS-persist + force-render path `YAT
// USE` already takes. Task C wires KEY0's mic capture + STT transcript into
// this same command; this section only implements the text side.
namespace voice {

// UTF-8 decode, one codepoint at a time — same three-byte-capped convention
// as engine/src/text.cpp's own utf8Next (a leading byte needing a 4th
// continuation byte decodes as U+FFFD; no pack alias or STT transcript needs
// a codepoint outside the BMP).
size_t utf8Next(const std::string& s, size_t i, uint16_t& code) {
  if (i >= s.size()) { code = 0xFFFD; return i; }
  unsigned char c = (unsigned char)s[i];
  if (c < 0x80) { code = c; return i + 1; }
  if ((c & 0xE0) == 0xC0 && i + 1 < s.size()) {
    code = ((c & 0x1F) << 6) | (s[i + 1] & 0x3F);
    return i + 2;
  }
  if ((c & 0xF0) == 0xE0 && i + 2 < s.size()) {
    code = ((c & 0x0F) << 12) | ((s[i + 1] & 0x3F) << 6) | (s[i + 2] & 0x3F);
    return i + 3;
  }
  if ((c & 0xF8) == 0xF0 && i + 3 < s.size()) { code = 0xFFFD; return i + 4; }
  code = 0xFFFD;
  return i + 1;
}

std::string utf16ToUtf8(uint16_t code) {
  std::string out;
  if (code < 0x80) {
    out += (char)code;
  } else if (code < 0x800) {
    out += (char)(0xC0 | (code >> 6));
    out += (char)(0x80 | (code & 0x3F));
  } else {
    out += (char)(0xE0 | (code >> 12));
    out += (char)(0x80 | ((code >> 6) & 0x3F));
    out += (char)(0x80 | (code & 0x3F));
  }
  return out;
}

// Same binary search as engine/src/text.cpp's file-local s2tLookup, against
// the one shared S2T_FROM/S2T_TO table (s2t_table.h, included above).
uint16_t s2tLookup(uint16_t simplified) {
  int lo = 0, hi = (int)S2T_N - 1;
  while (lo <= hi) {
    int mid = (lo + hi) / 2;
    if (S2T_FROM[mid] == simplified) return S2T_TO[mid];
    if (S2T_FROM[mid] < simplified) lo = mid + 1;
    else hi = mid - 1;
  }
  return simplified;  // not found, pass through unchanged
}

// Fullwidth/CJK punctuation stripped alongside ASCII punctuation (PACK-SPEC
// §2's normalization note); halfwidth ASCII punctuation is caught separately
// by ispunct() in normalizeUtf8 below.
bool isCjkPunct(uint16_t code) {
  switch (code) {
    case 0xFF0C:  // ，
    case 0x3002:  // 。
    case 0xFF01:  // ！
    case 0xFF1F:  // ？
    case 0x3001:  // 、
    case 0xFF1A:  // ：
    case 0xFF1B:  // ；
    case 0x300C:  // 「
    case 0x300D:  // 」
    case 0x300E:  // 『
    case 0x300F:  // 』
    case 0xFF08:  // （
    case 0xFF09:  // ）
      return true;
    default:
      return false;
  }
}

// PACK-SPEC §2: "matched on-device against normalized STT transcripts
// (lowercased, punctuation-stripped, simplified->traditional applied)".
// Applied identically to both alias text (once, at cache-build time below)
// and the live transcript (once per YAT SAY), so a simplified-Chinese
// transcript still substring-matches a pack's zh-Hant (traditional) alias.
// ASCII is lowercased; ASCII + common fullwidth/CJK punctuation and all
// spaces are dropped; every other codepoint passes through s2tLookup
// unchanged if it has no simplified->traditional mapping. UTF-8 in, UTF-8 out.
// The normalizer proper. `srcOf`, when non-null, is filled with one entry per
// byte APPENDED — the offset in `s` of the codepoint that byte came from —
// plus a final entry equal to s.size(). That map is what lets the intent
// grammar (voice intents section, below) find a verb at the front of the
// normalized string and then cut the payload out of the ORIGINAL transcript:
// normalization drops spaces, so slicing the normalized form would turn
// "add buy milk" into the item "buymilk".
static void normalizeInto(const std::string& s, std::string& out, std::vector<size_t>* srcOf) {
  for (size_t i = 0; i < s.size();) {
    const size_t from = i;
    uint16_t code;
    i = utf8Next(s, i, code);
    std::string piece;
    if (code < 0x80) {
      if (isspace((int)code) || ispunct((int)code)) continue;
      piece += (char)tolower((int)code);
    } else {
      if (isCjkPunct(code)) continue;
      piece = utf16ToUtf8(s2tLookup(code));
    }
    out += piece;
    if (srcOf) srcOf->insert(srcOf->end(), piece.size(), from);
  }
  if (srcOf) srcOf->push_back(s.size());
}

std::string normalizeUtf8(const std::string& s) {
  std::string out;
  out.reserve(s.size());
  normalizeInto(s, out, nullptr);
  return out;
}

// normalizeUtf8() plus the byte map described above. Separate entry point, not
// the default, because the alias cache normalizes every alias of every page on
// every boot and has no use for the map.
std::string normalizeWithSourceMap(const std::string& s, std::vector<size_t>& srcOf) {
  std::string out;
  out.reserve(s.size());
  srcOf.clear();
  srcOf.reserve(s.size() + 1);
  normalizeInto(s, out, &srcOf);
  return out;
}

// Codepoint count of an already-normalized string, for the matcher's
// "longest alias wins" rule below — counted in characters, not bytes, so a
// two-character CJK alias ("天氣", 6 UTF-8 bytes) is correctly judged shorter
// than a seven-character English one ("weather", 7 bytes) when both match.
size_t codepointLen(const std::string& s) {
  size_t n = 0;
  for (size_t i = 0; i < s.size();) {
    uint16_t code;
    i = utf8Next(s, i, code);
    n++;
  }
  return n;
}

// First `maxCp` codepoints of `s`, cut on a character boundary. The todo pack's
// text bound is 48 CHARACTERS, so this counts what the schema counts — 48
// Chinese characters are 144 bytes, and a byte-wise clip would both refuse
// legal items and be able to end mid-codepoint. No ellipsis, unlike utf8Clip():
// this produces a stored list entry somebody has to read and act on, not a
// label for a prompt.
std::string clipCodepoints(const std::string& s, size_t maxCp) {
  size_t n = 0, i = 0;
  while (i < s.size() && n < maxCp) {
    uint16_t code;
    i = utf8Next(s, i, code);
    n++;
  }
  return s.substr(0, i);
}

// Leading/trailing ASCII whitespace only. The payload of an intent is raw
// transcript — it keeps its spaces and its capitalization, because it becomes
// a line somebody reads off a panel — so this is the one tidy-up it gets.
std::string trimAscii(const std::string& s) {
  size_t b = 0, e = s.size();
  while (b < e && isspace((unsigned char)s[b])) b++;
  while (e > b && isspace((unsigned char)s[e - 1])) e--;
  return s.substr(b, e - b);
}

}  // namespace voice


std::vector<PageAliasSet> g_pageAliases;

// How much of each pack string the LLM router quotes per page. PACK-SPEC §2
// allows 200 chars of description; the router only needs enough to tell two
// pages apart, and every byte here is a token on a metered API — as well as a
// bound on what a pack file can add to this cache.
static constexpr size_t kLlmNameBytes = 40;
static constexpr size_t kLlmDescBytes = 80;

static constexpr size_t kAliasCapPerPage = 24;  // small-vector cache cap; PACK-SPEC allows <=8+8+8 per pack anyway

// Flattens one page's alias source into up to kAliasCapPerPage normalized
// entries: config.json's per-page "aliases" override if the page declares a
// non-empty one, else — lazily — the page's own pack file's aliases.en +
// aliases["zh-Hant"] + aliases.jyutping (PACK-SPEC §2), merged into one list.
// A pack file that's missing/unreadable/invalid JSON just means that page has
// no aliases this boot (logged once here, not once per YAT SAY call, since
// this whole function runs exactly once per boot).
// Copies at most `maxBytes` of `s`, backing off to the nearest UTF-8 character
// boundary so a truncated Chinese description can never end in half a
// codepoint, and marking the cut with an ellipsis when one happened.
std::string utf8Clip(const char* s, size_t maxBytes) {
  std::string out(s ? s : "");
  if (out.size() <= maxBytes) return out;
  size_t cut = maxBytes;
  while (cut > 0 && ((unsigned char)out[cut] & 0xC0) == 0x80) cut--;
  out.resize(cut);
  return out + "…";
}

// Pulls the pack's display name and English description into the cache entry
// from an already-parsed pack document. PACK-SPEC §2: name/description are
// bilingual objects, both optional.
void cachePackMeta(PageAliasSet& set, JsonVariantConst doc) {
  set.nameZh = utf8Clip(doc["name"]["zh-Hant"] | "", kLlmNameBytes);
  set.nameEn = utf8Clip(doc["name"]["en"] | "", kLlmNameBytes);
  set.descEn = utf8Clip(doc["description"]["en"] | "", kLlmDescBytes);
  set.metaLoaded = true;
}

void buildPageAliasCache() {
  g_pageAliases.assign(g_pages.size(), PageAliasSet{});
  for (size_t i = 0; i < g_pages.size(); i++) {
    const ConfigPage& page = g_pages[i];
    std::vector<std::pair<std::string, uint8_t>> raw;  // word + which list it came from
    if (!page.aliases.empty()) {
      for (const std::string& a : page.aliases) raw.emplace_back(a, kAliasUser);
    } else if (g_fsReady) {
      std::string packJson;
      std::string path = "/packs/" + page.pack + ".yat-pack.json";
      if (littlefsReadFile(path.c_str(), packJson)) {
        JsonDocument doc;
        // NestingLimit(24) as everywhere else a pack is parsed — the default 10
        // would fail on deep (12-14 level) packs and silently drop their voice
        // aliases even after they installed fine.
        if (!deserializeJson(doc, packJson, DeserializationOption::NestingLimit(24))) {
          // Free: this document is already parsed and about to be thrown away,
          // and the LLM router would otherwise have to read the same file again.
          cachePackMeta(g_pageAliases[i], doc);
          JsonVariantConst al = doc["aliases"];
          static const char* const kGroups[3] = {"en", "zh-Hant", "jyutping"};
          static const uint8_t kGroupTags[3] = {kAliasEn, kAliasZh, kAliasJyut};
          for (int g = 0; g < 3; g++) {
            JsonVariantConst arr = al[kGroups[g]];
            if (!arr.is<JsonArrayConst>()) continue;
            for (JsonVariantConst a : arr.as<JsonArrayConst>()) {
              const char* as = a | "";
              if (as[0] != '\0') raw.emplace_back(as, kGroupTags[g]);
            }
          }
        } else {
          LOGF("[voice] page %u (\"%s\") pack \"%s\" has invalid JSON — no aliases this boot\n",
               (unsigned)i, page.id.c_str(), page.pack.c_str());
        }
      } else {
        LOGF("[voice] page %u (\"%s\") pack \"%s\" not found/unreadable — no aliases this boot\n",
             (unsigned)i, page.id.c_str(), page.pack.c_str());
      }
    }
    for (const auto& a : raw) {
      if (g_pageAliases[i].aliases.size() >= kAliasCapPerPage) break;
      std::string norm = voice::normalizeUtf8(a.first);
      if (norm.empty()) continue;
      g_pageAliases[i].aliases.push_back({norm, voice::codepointLen(norm), a.first, a.second});
    }
  }
  LOGF("[voice] alias cache built for %u page(s)\n", (unsigned)g_pageAliases.size());
}

// Normalizes `text`, then finds the page whose alias is (a) a substring of
// the normalized text and (b) the longest such alias (ties -> lowest page
// index, i.e. declaration order). Only this direction: the alias must be
// found INSIDE the utterance ("切去天氣嗰頁" containing alias "天氣" hits;
// the reverse never applies since utterances aren't stored as aliases).
// Empty normalized text or no candidate at all -> -1.
int matchPageByText(const std::string& text) {
  std::string norm = voice::normalizeUtf8(text);
  if (norm.empty()) return -1;
  int best = -1;
  size_t bestLen = 0;
  for (size_t i = 0; i < g_pageAliases.size(); i++) {
    for (const NormalizedAlias& alias : g_pageAliases[i].aliases) {
      if (alias.text.empty()) continue;
      if (norm.find(alias.text) == std::string::npos) continue;
      if (alias.codepoints > bestLen) {
        bestLen = alias.codepoints;
        best = (int)i;
      }
    }
  }
  return best;
}

// ---------------- voice intents: the household todo list (PRD §4.4) ----------------
//
// Everything above answers one question — WHICH PAGE. This section adds the
// only three things voice can DO, and only to one pack: the household todo
// list. It is dormant on every device that has not installed that pack (see
// todoPageIndex), and page switching is untouched either way.
//
// The three verbs, matched against the same s2t-normalized transcript the alias
// matcher sees, so a simplified-Chinese transcript works on a traditional list:
//
//   加 / 記住 / add     <text>    put <text> on the list
//   搞掂 / 完成 / done  <phrase>  mark the one open item <phrase> names
//   清理 / 清咗 / clear           remove the items already marked done
//
// Three rules decide everything else, and they all come from the same place:
// the failure that matters here is not a missed command, it is the WRONG item
// marked done. A household that has to check the panel after every 「搞掂」 has
// lost the feature even if it works nine times in ten.
//
//   1. DONE never guesses. The phrase is matched against the OPEN items only,
//      in both directions (the phrase inside an item, or an item inside the
//      phrase). Exactly one candidate marks it. Zero or two get the same
//      "didn't catch that" tone as an unrecognized page — never a coin flip.
//   2. Voice never deletes an open item. CLEAR removes done items and nothing
//      else; there is no verb for anything stronger.
//   3. The panel is the receipt. Every success renders the todo page THIS
//      cycle, so the change is visible on the thing the household is standing
//      in front of, not just audible.
//
// The portal undoes any of it in one tap, which is the reason a refusal is
// cheap and a wrong done is not: an undo costs a walk to a phone, but trust in
// 「搞掂」 costs nothing to lose and does not come back.

// Pre-normalized on purpose: these are compared against the OUTPUT of
// normalizeUtf8(), which lowercases ASCII, drops spaces and punctuation, and
// maps simplified to traditional — so a transcript of 「记住」 arrives here as
// 「記住」 and matches the row below without a second table.
struct TodoVerb {
  const char* norm;
  VoiceActionKind kind;
};
static const TodoVerb kTodoVerbs[] = {
    {"記住", VoiceActionKind::TodoAdd},   {"加", VoiceActionKind::TodoAdd},
    {"add", VoiceActionKind::TodoAdd},    {"搞掂", VoiceActionKind::TodoDone},
    {"完成", VoiceActionKind::TodoDone},  {"done", VoiceActionKind::TodoDone},
    {"清理", VoiceActionKind::TodoClear}, {"清咗", VoiceActionKind::TodoClear},
    {"clear", VoiceActionKind::TodoClear},
};

int todoPageIndex() {
  static int8_t warnedMulti = 0;
  int found = -1;
  for (size_t i = 0; i < g_pages.size(); i++) {
    if (g_pages[i].pack != TODO_PACK_ID) continue;
    if (found < 0) {
      found = (int)i;
      continue;
    }
    if (!warnedMulti) {
      warnedMulti = 1;
      LOGF("[voice] %u pages use the todo pack — intents act on page %d (\"%s\"), the first one\n",
           (unsigned)g_pages.size(), found, g_pages[found].id.c_str());
    }
    break;
  }
  return found;
}

// Reads the todo page's params into `doc`, leaving it holding an object with an
// "items" array — created empty if the page has none yet, which is what a
// freshly installed list looks like. Every other key in params is left in the
// document untouched, because this document is what gets written back: the
// pack ships "title" and "lang" beside the items today, and a later version of
// it can ship anything else without this needing to know. Only "items" is ever
// read, and only "items" is ever written.
//
// False means the params were hand-edited into a shape this cannot safely
// mutate: not an object, an "items" that is not an array, or an entry that is
// not an object with a string "text". Intents then switch themselves off rather
// than guessing at what was meant — logged once per boot, never fatal, and the
// page still RENDERS exactly as the engine decides it should. The rest of voice
// (page switching, the LLM router) is unaffected.
static bool todoLoadParams(int pageIdx, JsonDocument& doc) {
  static bool warned = false;
  auto reject = [&](const char* why) {
    if (!warned) {
      warned = true;
      LOGF("[voice] todo page \"%s\" params %s — voice intents off for this boot\n",
           g_pages[pageIdx].id.c_str(), why);
    }
    return false;
  };
  const std::string& raw = g_pages[pageIdx].paramsJson;
  if (raw.empty()) {
    doc.to<JsonObject>();
  } else if (deserializeJson(doc, raw, DeserializationOption::NestingLimit(24))) {
    return reject("do not parse");
  }
  if (!doc.is<JsonObject>()) return reject("are not an object");
  JsonVariant items = doc["items"];
  if (items.isNull()) {
    if (doc["items"].to<JsonArray>().isNull()) return reject("could not be given an items array");
    return true;
  }
  if (!items.is<JsonArray>()) return reject("have an \"items\" that is not an array");
  for (JsonVariantConst it : items.as<JsonArrayConst>()) {
    if (!it.is<JsonObjectConst>()) return reject("contain an item that is not an object");
    if (!it["text"].is<const char*>()) return reject("contain an item with no text");
  }
  return true;
}

bool todoOpenItems(std::vector<TodoOpenItem>& out) {
  out.clear();
  const int idx = todoPageIndex();
  if (idx < 0) return false;
  JsonDocument doc;
  if (!todoLoadParams(idx, doc)) return false;
  int i = 0;
  for (JsonVariantConst it : doc["items"].as<JsonArrayConst>()) {
    if (!(it["done"] | false)) out.push_back({i, std::string(it["text"] | "")});
    i++;
  }
  return true;
}

// Serializes `doc` back into the todo page's params and persists it, then makes
// the panel show the result: the todo page becomes active (saved to NVS like
// any other page change) and the render is forced, so a household that was
// already looking at the list still sees it redraw with the change.
static bool todoCommit(int pageIdx, JsonDocument& doc, VoiceOutcome& out) {
  std::string params;
  serializeJson(doc, params);
  if (!savePageParams(pageIdx, params)) {
    LOGF("[voice] todo change could NOT be saved — list unchanged\n");
    return false;
  }
  int items = 0, open = 0;
  for (JsonVariantConst it : doc["items"].as<JsonArrayConst>()) {
    items++;
    if (!(it["done"] | false)) open++;
  }
  out.pageIdx = pageIdx;
  out.items = items;
  out.openItems = open;
  g_activePageIdx = pageIdx;
  savePageIdx(g_activePageIdx);
  g_serialForceRender = true;
  return true;
}

// The one place the list is mutated, for both tiers.
//
//   kind     what to do
//   text     TodoAdd: the item, raw off the transcript. TodoDone: the phrase to
//            match, ignored when itemIdx >= 0.
//   itemIdx  TodoDone only: an already-resolved position in the list, which is
//            how the LLM tier answers (by number, never by re-typing the text).
//            -1 means "fuzzy-match `text` against the open items".
//
// False is every refusal — a full list, a duplicate, an unrecognized phrase,
// two equally good candidates, nothing to clear, a filesystem that would not
// take the write — and the caller gives all of them the same "didn't catch
// that" tone, because from where the household is standing they are the same
// event: it did not happen, say it again.
static bool todoApply(VoiceActionKind kind, const std::string& text, int itemIdx,
                      VoiceOutcome& out) {
  const int pageIdx = todoPageIndex();
  if (pageIdx < 0) return false;
  JsonDocument doc;
  if (!todoLoadParams(pageIdx, doc)) return false;
  JsonArray items = doc["items"].as<JsonArray>();

  if (kind == VoiceActionKind::TodoAdd) {
    const std::string item = voice::clipCodepoints(voice::trimAscii(text), TODO_MAX_TEXT_CP);
    if (item.empty()) {
      LOGF("[voice] todo ADD refused: nothing after the verb\n");
      return false;
    }
    if (items.size() >= TODO_MAX_ITEMS) {
      LOGF("[voice] todo ADD refused: the list already holds its %u-item maximum\n",
           (unsigned)TODO_MAX_ITEMS);
      return false;
    }
    // Exact text, against done items as well as open ones: two identical lines
    // on the panel are worse than a repeated request doing nothing, and the
    // portal is where a finished item gets put back.
    for (JsonVariantConst it : items)
      if (item == (it["text"] | "")) {
        LOGF("[voice] todo ADD refused: that item is already on the list\n");
        return false;
      }
    JsonObject added = items.add<JsonObject>();
    if (added.isNull()) return false;
    added["text"] = item;
    added["done"] = false;
    out.kind = VoiceActionKind::TodoAdd;
    return todoCommit(pageIdx, doc, out);
  }

  if (kind == VoiceActionKind::TodoDone) {
    int target = itemIdx;
    if (target < 0) {
      // Rule 1 above, and the whole reason this feature is worth having: match
      // the phrase against the OPEN items, both directions, and take it only
      // when exactly one survives.
      const std::string needle = voice::normalizeUtf8(text);
      if (needle.empty()) {
        LOGF("[voice] todo DONE refused: nothing after the verb\n");
        return false;
      }
      int hits = 0, i = 0;
      for (JsonVariantConst it : items) {
        const bool done = it["done"] | false;
        if (!done) {
          const std::string hay = voice::normalizeUtf8(std::string(it["text"] | ""));
          if (!hay.empty() &&
              (hay.find(needle) != std::string::npos || needle.find(hay) != std::string::npos)) {
            target = i;
            hits++;
          }
        }
        i++;
      }
      if (hits != 1) {
        LOGF("[voice] todo DONE refused: %d open item(s) could be the one meant — never guessing\n",
             hits);
        return false;
      }
    }
    if (target < 0 || (size_t)target >= items.size()) return false;
    JsonObject it = items[target].as<JsonObject>();
    if (it.isNull()) return false;
    if (it["done"] | false) {
      LOGF("[voice] todo DONE refused: item %d is already done\n", target);
      return false;
    }
    it["done"] = true;
    out.kind = VoiceActionKind::TodoDone;
    out.itemIdx = target;
    return todoCommit(pageIdx, doc, out);
  }

  if (kind == VoiceActionKind::TodoClear) {
    // Rule 2: done items and nothing else. Walked backwards so removing one
    // cannot shift the index of a later candidate.
    int removed = 0;
    for (int i = (int)items.size() - 1; i >= 0; i--) {
      if (items[i]["done"] | false) {
        items.remove(i);
        removed++;
      }
    }
    if (removed == 0) {
      LOGF("[voice] todo CLEAR refused: nothing on the list is marked done\n");
      return false;
    }
    out.kind = VoiceActionKind::TodoClear;
    out.removed = removed;
    return todoCommit(pageIdx, doc, out);
  }
  return false;
}

bool todoMarkDoneByIndex(int itemIdx, VoiceOutcome& out) {
  return todoApply(VoiceActionKind::TodoDone, std::string(), itemIdx, out);
}

// Tier 1 of the grammar: a verb at the very FRONT of the normalized transcript,
// and everything after it as the payload — taken out of the original text, via
// the source map, so it keeps the spaces and the capitalization normalization
// strips. `kind` comes back None when nothing matched, which is every transcript
// on a device with no todo page and most transcripts on a device with one.
static VoiceActionKind todoParseTier1(const std::string& transcript, std::string& payload) {
  payload.clear();
  std::vector<size_t> srcOf;
  const std::string norm = voice::normalizeWithSourceMap(transcript, srcOf);
  if (norm.empty()) return VoiceActionKind::None;
  for (const TodoVerb& v : kTodoVerbs) {
    const size_t len = strlen(v.norm);
    if (norm.size() < len || norm.compare(0, len, v.norm) != 0) continue;
    payload = transcript.substr(srcOf[len]);
    return v.kind;
  }
  return VoiceActionKind::None;
}

// The whole routing decision. Order is what makes the dormancy claim provable:
// the alias match runs first and unconditionally, exactly as it always has, so
// a transcript that named a page before this section existed still names the
// same page — and on a device with no todo page nothing below the first two
// lines can even fire.
VoiceOutcome voiceDispatch(const std::string& text, bool allowLlm) {
  VoiceOutcome out;
  const int pageIdx = matchPageByText(text);
  const bool todoOn = todoPageIndex() >= 0;

  std::string payload;
  VoiceActionKind verb = todoOn ? todoParseTier1(text, payload) : VoiceActionKind::None;
  // 加 is one character and it is the first character of plenty of ordinary
  // words — 加拿大 is a page some household will have installed. So when an ADD
  // utterance ALSO names a page, the page wins: a wrongly-added item is noise
  // on the list, but a page that stopped responding to its own name is the
  // feature everyone already relies on, broken. DONE and CLEAR get no such
  // second-guessing; 搞掂 at the front of a sentence is not the start of a
  // weather station's name, and marking things done is what this is for.
  if (verb == VoiceActionKind::TodoAdd && pageIdx >= 0) verb = VoiceActionKind::None;

  if (verb != VoiceActionKind::None) {
    if (todoApply(verb, payload, -1, out)) return out;
    // A verb was heard and could not be carried out. It is deliberately NOT
    // retried as a page switch: the household asked for something to happen to
    // their list, and quietly changing the page instead would be a different
    // action wearing the same beep.
    return VoiceOutcome{};
  }

  if (pageIdx >= 0) {
    out.kind = VoiceActionKind::Page;
    out.pageIdx = pageIdx;
    g_activePageIdx = pageIdx;
    savePageIdx(g_activePageIdx);
    g_serialForceRender = true;
    return out;
  }
  if (!allowLlm) return out;

  // Tier 2. One call, and with a todo page installed it is the SAME one call
  // that used to only pick a page — the model is shown the pages and the open
  // items together and answers with one of the five shapes voiceRouteByLlm()
  // validates. Anything it cannot validate is -1/None here, which lands in the
  // caller's no-match branch, which is exactly where a device with no key has
  // always landed.
  const LlmVoiceAnswer ans = voiceRouteByLlm(text, todoOn);
  switch (ans.kind) {
    case LlmVoiceAnswer::Page:
      out.kind = VoiceActionKind::Page;
      out.pageIdx = ans.pageIdx;
      out.viaLlm = true;
      g_activePageIdx = ans.pageIdx;
      savePageIdx(g_activePageIdx);
      g_serialForceRender = true;
      return out;
    case LlmVoiceAnswer::TodoAdd:
      if (todoApply(VoiceActionKind::TodoAdd, ans.text, -1, out)) out.viaLlm = true;
      else out = VoiceOutcome{};
      return out;
    case LlmVoiceAnswer::TodoDone:
      if (todoMarkDoneByIndex(ans.itemIdx, out)) out.viaLlm = true;
      else out = VoiceOutcome{};
      return out;
    case LlmVoiceAnswer::TodoClear:
      if (todoApply(VoiceActionKind::TodoClear, std::string(), -1, out)) out.viaLlm = true;
      else out = VoiceOutcome{};
      return out;
    case LlmVoiceAnswer::None:
      break;
  }
  return out;
}

// ---------------- tap-to-talk voice capture (PRD §4.4) ----------------
//
// A KEY0 tap — released before the 5 s provisioning hold, see
// readKey0GestureAtWake() below — records a few seconds of speech, sends it to
// ElevenLabs Scribe, and routes the transcript to a page: first through
// matchPageByText() (voice keyword matcher section, above), then, only if that
// found nothing and a router key is on file, through voiceRouteByLlm() (voice
// routing tier 2, below). It runs BEFORE the engine cycle picks a
// pack, so a matched page is what this cycle's single ~30 s panel refresh
// draws, rather than waiting for the next wake: "ask, put it down, it'll be
// there" (PRD §4.4).
//
// Ported from the proven e1002-test prototype (private)'s src/voicedemo/main.cpp
// — same PDM RX pins and format, the same 100 ms DC-settle discard, the same
// WAV framing, the same multipart shape against the same endpoint. Three
// things differ deliberately:
//
//   - TLS is pinned to YAT_CA_BUNDLE (certs.h anchor 7 is exactly the GTS WR3
//     intermediate api.elevenlabs.io chains through) instead of the demo's
//     setInsecure(): there is no setInsecure() anywhere in this firmware.
//   - the audio is recorded straight INTO the multipart body buffer instead of
//     into its own WAV buffer that then gets copied into a body — one
//     ps_malloc/free pair instead of two, and half the peak PSRAM (see
//     voiceCaptureBody()).
//   - the STT key is read before the mic is ever powered, so a device with no
//     key configured never records at all (see runVoiceCapture()).
//
// The demo's simplified->traditional pass on the transcript has no equivalent
// here and needs none: matchPageByText() -> voice::normalizeUtf8() already
// s2t-converts every codepoint of both the transcript and the aliases before
// comparing them.

static constexpr uint32_t VOICE_SAMPLE_RATE = 16000;  // mono 16-bit -> 32 KB of PCM per second
static constexpr size_t VOICE_DISCARD_BYTES = 3200;   // 100 ms of PDM settling, thrown away
static constexpr uint32_t STT_RESPONSE_TIMEOUT_MS = 20000;

extern const char* const STT_URL = "https://api.elevenlabs.io/v1/speech-to-text";
static const char* const STT_BOUNDARY = "yatvoiceboundary";

static I2SClass g_i2s;

// Canonical 44-byte PCM WAV header for `dataBytes` of 16 kHz mono 16-bit.
static void wavHeader(uint8_t* h, uint32_t dataBytes) {
  uint32_t sampleRate = VOICE_SAMPLE_RATE;
  uint32_t byteRate = VOICE_SAMPLE_RATE * 2;
  uint32_t riffLen = 36 + dataBytes;
  uint32_t fmtLen = 16;
  uint16_t pcm = 1, channels = 1, blockAlign = 2, bits = 16;
  memcpy(h, "RIFF", 4);
  memcpy(h + 4, &riffLen, 4);
  memcpy(h + 8, "WAVEfmt ", 8);
  memcpy(h + 16, &fmtLen, 4);
  memcpy(h + 20, &pcm, 2);
  memcpy(h + 22, &channels, 2);
  memcpy(h + 24, &sampleRate, 4);
  memcpy(h + 28, &byteRate, 4);
  memcpy(h + 32, &blockAlign, 2);
  memcpy(h + 34, &bits, 2);
  memcpy(h + 36, "data", 4);
  memcpy(h + 40, &dataBytes, 4);
}

// Fills `dest` with exactly dataBytes of PCM from the PDM mic. Mic power
// (GPIO38) goes HIGH on entry and LOW on every exit — PRD §4.4's "mic powered
// only while recording" is enforced here, not by a caller remembering to.
// False = I2S init failure or a short read; either way the mic is off and the
// caller's buffer is the only thing left to free.
static bool voiceRecordInto(uint8_t* dest, size_t dataBytes, int seconds) {
  pinMode(PIN_MIC_EN, OUTPUT);
  digitalWrite(PIN_MIC_EN, HIGH);
  delay(50);  // mic power-on settle
  g_i2s.setPinsPdmRx(PIN_MIC_CLK, PIN_MIC_DATA);
  if (!g_i2s.begin(I2S_MODE_PDM_RX, VOICE_SAMPLE_RATE, I2S_DATA_BIT_WIDTH_16BIT,
                   I2S_SLOT_MODE_MONO)) {
    LOGF("[voice] I2S PDM RX init failed\n");
    digitalWrite(PIN_MIC_EN, LOW);
    return false;
  }

  // The first 100 ms is the PDM front end settling towards its DC bias, which
  // reads as a loud thump. Drop it — in 320-byte bites off the stack rather
  // than the demo's one 3.2 KB static, which would sit in DRAM on every cycle
  // including the ones that never record. Bounded by wall clock so a mic that
  // never produces samples can't wedge the boot here.
  uint8_t discard[320];
  size_t dropped = 0;
  uint32_t td = millis();
  while (dropped < VOICE_DISCARD_BYTES && millis() - td < 1000)
    dropped += g_i2s.readBytes((char*)discard, sizeof(discard));

  // Cue after the discard, never before: anything the user says in response
  // to the beep then lands in bytes we keep. The buzzer's own chirp does end
  // up in the DMA ring and so at the head of the clip — that is exactly what
  // the demo does, and Scribe's Cantonese accuracy there is what proved this
  // pipeline, so it is a known-harmless artifact rather than an oversight.
  LOGF("[voice] recording %d s...\n", seconds);
  beepRecordStart();
  digitalWrite(PIN_LED, LOW);  // LOW = on; "still listening"

  size_t got = 0;
  uint32_t t0 = millis();
  while (got < dataBytes && millis() - t0 < (uint32_t)seconds * 1000 + 3000)
    got += g_i2s.readBytes((char*)(dest + got), dataBytes - got);

  digitalWrite(PIN_LED, HIGH);
  beepRecordStop();
  g_i2s.end();
  digitalWrite(PIN_MIC_EN, LOW);

  LOGF("[voice] captured %u/%u bytes in %lu ms\n", (unsigned)got, (unsigned)dataBytes,
       (unsigned long)(millis() - t0));
  if (got < dataBytes) return false;

  // Peak-to-peak across every 16th sample: a flat line means the mic never
  // produced audio even though the reads "succeeded" — the one cheap check
  // that distinguishes a dead mic from a user who said nothing useful.
  // Samples are reassembled from byte pairs rather than read through an
  // int16_t*: `dest` lands wherever the multipart head happens to end (+44),
  // so 2-byte alignment is not something this can assume. Little-endian, as
  // both the WAV format and the chip are.
  int16_t mn = 32767, mx = -32768;
  for (size_t i = 0; i + 1 < dataBytes; i += 32) {  // 32 bytes = every 16th sample
    int16_t v = (int16_t)((uint16_t)dest[i] | ((uint16_t)dest[i + 1] << 8));
    mn = min(mn, v);
    mx = max(mx, v);
  }
  LOGF("[voice] p-p level %d\n", (int)(mx - mn));
  return true;
}

// One PSRAM buffer, laid out exactly as it goes on the wire:
//
//   [multipart head: model_id part + file part headers][44 B WAV header][PCM][tail]
//
// voiceRecordInto() writes straight into the PCM region, so the audio is
// allocated once and copied never. That makes this buffer the whole voice
// flow's peak allocation: head+tail are ~230 B, so ~128.3 KB at the 4 s
// default and ~256.3 KB at the 8 s maximum, out of ~8 MB of PSRAM.
//
// Returns the buffer — the caller frees it on EVERY path — and its total
// length. nullptr means nothing was allocated and there is nothing to free.
static uint8_t* voiceCaptureBody(int seconds, size_t& bodyLen) {
  std::string head;
  head += "--";
  head += STT_BOUNDARY;
  head += "\r\n";
  head += "Content-Disposition: form-data; name=\"model_id\"\r\n\r\nscribe_v2\r\n";
  head += "--";
  head += STT_BOUNDARY;
  head += "\r\n";
  head += "Content-Disposition: form-data; name=\"file\"; filename=\"rec.wav\"\r\n";
  head += "Content-Type: audio/wav\r\n\r\n";
  const std::string tail = std::string("\r\n--") + STT_BOUNDARY + "--\r\n";

  const size_t dataBytes = (size_t)VOICE_SAMPLE_RATE * 2 * (size_t)seconds;
  bodyLen = head.size() + 44 + dataBytes + tail.size();
  uint8_t* body = (uint8_t*)ps_malloc(bodyLen);
  if (!body) {
    LOGF("[voice] ps_malloc %u bytes failed (psram %u free)\n", (unsigned)bodyLen,
         (unsigned)ESP.getFreePsram());
    bodyLen = 0;
    return nullptr;
  }
  memcpy(body, head.data(), head.size());
  uint8_t* wav = body + head.size();
  wavHeader(wav, (uint32_t)dataBytes);
  memcpy(wav + 44 + dataBytes, tail.data(), tail.size());

  if (!voiceRecordInto(wav + 44, dataBytes, seconds)) {
    free(body);
    bodyLen = 0;
    return nullptr;
  }
  return body;
}

// POSTs the already-assembled multipart body and pulls "text" out of the
// response with a filtered parse — a Scribe response carries per-word timings
// and confidences we have no use for, and filtering keeps the JsonDocument
// down to the transcript itself.
static bool voiceTranscribe(uint8_t* body, size_t bodyLen, const String& apiKey,
                            std::string& text, std::string& lang, int& httpCode) {
  WiFiClientSecure client;
  client.setCACert(YAT_CA_BUNDLE);
  client.setTimeout(STT_RESPONSE_TIMEOUT_MS / 1000);  // seconds

  HTTPClient http;
  if (!http.begin(client, STT_URL)) {
    LOGF("[voice] http.begin failed\n");
    return false;
  }
  http.setFollowRedirects(HTTPC_DISABLE_FOLLOW_REDIRECTS);
  http.setConnectTimeout(WIFI_TIMEOUT_MS);
  http.setTimeout(STT_RESPONSE_TIMEOUT_MS);
  http.setUserAgent("yat/0.3");
  http.addHeader("xi-api-key", apiKey);
  http.addHeader("Content-Type", String("multipart/form-data; boundary=") + STT_BOUNDARY);

  LOGF("[voice] uploading %u bytes to Scribe...\n", (unsigned)bodyLen);
  uint32_t t0 = millis();
  httpCode = http.POST(body, bodyLen);
  LOGF("[voice] HTTP %d in %lu ms\n", httpCode, (unsigned long)(millis() - t0));

  if (httpCode != HTTP_CODE_OK) {
    String err = http.getString();
    err.replace("\n", " ");
    LOGF("[voice] error body: %.200s\n", err.c_str());
    http.end();
    return false;
  }
  String payload = http.getString();
  http.end();

  JsonDocument filter;
  filter["text"] = true;
  filter["language_code"] = true;
  JsonDocument doc;
  DeserializationError derr =
      deserializeJson(doc, payload, DeserializationOption::Filter(filter));
  if (derr) {
    LOGF("[voice] JSON parse failed: %s\n", derr.c_str());
    return false;
  }
  text = doc["text"] | "";
  lang = doc["language_code"] | "?";
  return !text.empty();
}

static String loadSttKey() {
  Preferences prefs;
  prefs.begin("yat", true);
  String v = prefs.getString("stt_key", "");
  prefs.end();
  return v;
}

// The whole flow, and never fatal: every failure path is one audible error
// tone plus a log line, then a plain return so setup() falls through into the
// normal engine cycle. That cycle still renders whatever page is active — a
// KEY0 wake already sets g_buttonWake, so the hash-skip cannot swallow it —
// which is why "no key", "mic dead", "STT down" and "didn't catch that" all
// end with the screen showing something rather than nothing.
//
// `wifiUp` is setup()'s own flag: set true here once the radio is associated,
// so the normal path below doesn't connect a second time.
void runVoiceCapture(const WifiCreds& creds, bool& wifiUp) {
  LOGF("[voice] KEY0 tap — tap-to-talk, %d s capture\n", g_voiceSeconds);

  // Before the mic is ever powered: with no key there is nothing to send, so
  // recording would cost the user four seconds of talking to a device that
  // cannot hear them *and* capture audio for no reason.
  String apiKey = loadSttKey();
  if (apiKey.isEmpty()) {
    LOGF("[voice] no STT key (YAT SECRET stt <key>)\n");
    beepNoKey();
    return;
  }

  // Association overlaps the capture: WiFi.begin() is non-blocking (scan/
  // auth/DHCP run on the WiFi task) and the seconds this task then spends
  // blocked on I2S reads are seconds association gets for free.
  uint32_t wifiT0 = millis();
  const bool alreadyUp = WiFi.status() == WL_CONNECTED;
  if (!alreadyUp) {
    LOGF("[voice] starting WiFi association (overlaps the capture)\n");
    WiFi.mode(WIFI_STA);
    WiFi.setSleep(true);
    WiFi.begin(creds.ssid.c_str(), creds.pass.c_str());
  }

  size_t bodyLen = 0;
  uint8_t* body = voiceCaptureBody(g_voiceSeconds, bodyLen);
  if (!body) {
    LOGF("[voice] capture failed — page unchanged\n");
    beepError();
    return;
  }

  // Whatever the capture did not consume of the connect budget is what is
  // left to wait for here, so the total stays bounded by the same
  // WIFI_TIMEOUT_MS the normal path uses, measured from begin().
  if (!alreadyUp) {
    while (WiFi.status() != WL_CONNECTED && millis() - wifiT0 < WIFI_TIMEOUT_MS) delay(50);
    if (WiFi.status() != WL_CONNECTED) {
      LOGF("[voice] WiFi not up after %lu ms — dropping the clip, normal cycle will retry\n",
           (unsigned long)(millis() - wifiT0));
      free(body);
      beepError();
      return;
    }
    LOGF("[voice] wifi up in %lu ms — %s, %d dBm\n", (unsigned long)(millis() - wifiT0),
         WiFi.localIP().toString().c_str(), WiFi.RSSI());
  }
  // No wifiRecordFailure() on the timeout path above, deliberately: the
  // normal cycle's wifiConnect() runs right after this returns and records
  // exactly one failure for this cycle. Counting it here too would trip the
  // 3-strikes provisioning trigger twice as fast on a KEY0 tap.
  wifiUp = true;
  wifiRecordSuccess();

  std::string text, lang;
  int httpCode = 0;
  bool ok = voiceTranscribe(body, bodyLen, apiKey, text, lang, httpCode);
  free(body);
  body = nullptr;

  if (!ok) {
    LOGF("[voice] STT failed (HTTP %d) — page unchanged\n", httpCode);
    // The buzz says "that didn't work" and nothing more; this is where the
    // household later finds out it was the transcription service and not the
    // microphone. No context string: the failure is not page-scoped, and the
    // status code stays in the log rather than the ring, which never carries
    // anything derived from a request that had a key in it.
    recordError(ERR_STT_HTTP, nullptr, httpCode);
    beepError();
    return;
  }
  // A transcript came back, so whatever the panel may have been saying about
  // the key, it is wrong now (§11.4a): the success path is the only honest
  // place to take an Action banner down, because it is the only place that
  // proves the thing works.
  conditionClear(COND_VOICE_KEY);

  // The whole decision, in one call: the alias matcher, then the todo intent
  // grammar if that pack is installed, then — only if both came up empty — the
  // LLM router. Every way it can come up empty (no key, TLS, a non-200, an
  // unparseable answer, NONE, an id nobody configured, a done nobody could
  // identify) leaves kind == None and falls into the same NOMATCH branch below,
  // which is exactly what a device without a key has always done. voiceDispatch
  // has already persisted whatever it decided; nothing below this line changes
  // state.
  const VoiceOutcome act = voiceDispatch(text, /*allowLlm=*/true);
  if (act.kind == VoiceActionKind::None) {
    // The transcript came back fine, it just doesn't name a page anyone
    // configured — or it named a list item the device could not pin down to
    // exactly one. Nothing is broken and saying it again may well work, so this
    // gets the gentle "try again" cue rather than the fault buzz.
    LOGF("[voice] heard \"%s\" (%s) -> NOMATCH — nothing changed\n", text.c_str(), lang.c_str());
    beepNoMatch();
    return;
  }
  // "via the smart router" rather than a provider name: which of the services
  // answered is already on the line voiceRouteByLlm() wrote a moment ago, and
  // naming it again here would mean carrying the provider down a call path that
  // has no other use for it. Counts only for the list — an item's text is
  // never written here; the transcript on this same line is as far as that
  // goes.
  const char* how = act.viaLlm ? " via the smart router" : " by keyword";
  switch (act.kind) {
    case VoiceActionKind::Page:
      LOGF("[voice] heard \"%s\" (%s) -> MATCH %s (page %d)%s\n", text.c_str(), lang.c_str(),
           g_pages[act.pageIdx].id.c_str(), act.pageIdx, how);
      break;
    case VoiceActionKind::TodoAdd:
      LOGF("[voice] heard \"%s\" (%s) -> TODO ADD%s — %d item(s), %d open\n", text.c_str(),
           lang.c_str(), how, act.items, act.openItems);
      break;
    case VoiceActionKind::TodoDone:
      LOGF("[voice] heard \"%s\" (%s) -> TODO DONE item %d%s — %d open left\n", text.c_str(),
           lang.c_str(), act.itemIdx, how, act.openItems);
      break;
    case VoiceActionKind::TodoClear:
      LOGF("[voice] heard \"%s\" (%s) -> TODO CLEAR%s — %d removed, %d left\n", text.c_str(),
           lang.c_str(), how, act.removed, act.items);
      break;
    case VoiceActionKind::None:
      break;
  }
  // The change is saved either way — the page index in NVS, and for an intent
  // the list itself in config.json. What differs is whether the panel is about
  // to show it. Under a warning takeover the playlist is preempted for as long
  // as the signal stands (setup() does not even attempt the active page's
  // pack), so promising a visible change here would be a lie the screen then
  // tells for hours. The "held for later" cue is the honest version, and it
  // matters more for a todo than for a page switch: the item IS marked done,
  // and the household needs to hear that it took even though the list they are
  // looking at still shows it open.
  if (takeoverLikelyThisCycle()) {
    LOGF("[voice] warning takeover holds the panel — the change is saved for when it clears\n");
    beepHeldForLater();
    return;
  }
  beepMatch();
}
