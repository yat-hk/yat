// Generated by the main.cpp module split: the code below is a verbatim
// slice of the original single-translation-unit firmware/src/main.cpp.

#include "yat_net.h"

#include <stdio.h>
#include <string.h>

#include <ArduinoJson.h>
#include <HTTPClient.h>
#include <Preferences.h>
#include <WiFi.h>
#include <WiFiClientSecure.h>

#include "certs.h"
#include "secrets.h"

#include "yat_errors.h"
#include "yat_state.h"

// ---------------- WiFi credentials (Preferences NVS) ----------------
//
// ARCHITECTURE §8: the last compile-time secret goes away in v0.3. Credentials
// live in Preferences namespace "yat" (the same namespace §5.1's hash-skip
// and the epoch fallback already use) as keys wifi_ssid/wifi_pass, written by
// the provisioning portal, Improv-serial, or — once, as a dev convenience —
// seeded from include/secrets.h if it was actually filled in. wifi_fails
// counts consecutive connect failures (reset to 0 on any successful connect
// or any newly-saved credentials) and is one of the three provisioning
// triggers (PRD §4.3): 3 failures in a row means the saved network is no
// longer good, so stop retrying it blind and re-provision instead.



WifiCreds loadWifiCreds() {
  Preferences prefs;
  prefs.begin("yat", true);
  String ssid = prefs.getString("wifi_ssid", "");
  String pass = prefs.getString("wifi_pass", "");
  prefs.end();
  WifiCreds c;
  c.ssid = ssid.c_str();
  c.pass = pass.c_str();
  c.valid = ssid.length() > 0;
  return c;
}

void saveWifiCreds(const char* ssid, const char* pass) {
  Preferences prefs;
  prefs.begin("yat", false);
  prefs.putString("wifi_ssid", ssid);
  prefs.putString("wifi_pass", pass);
  prefs.putUInt("wifi_fails", 0);
  // G7: the "hash" key belongs to whoever's data last rendered — on a
  // gifted/re-provisioned device that's a previous owner's snapshot, which
  // can easily hash-equal the new owner's first fetch (same district,
  // rounded temp/humidity). Clearing it here guarantees the first post-setup
  // cycle always renders instead of silently hash-skipping and leaving
  // "設定 WiFi / Set up WiFi" on screen for up to a schedule interval.
  prefs.putUInt("hash", 0);
  prefs.end();
  LOGF("[wifi] credentials saved to NVS (\"%s\")\n", ssid);
}

uint32_t wifiFailCount() {
  Preferences prefs;
  prefs.begin("yat", true);
  uint32_t n = prefs.getUInt("wifi_fails", 0);
  prefs.end();
  return n;
}

void wifiRecordFailure() {
  Preferences prefs;
  prefs.begin("yat", false);
  uint32_t n = prefs.getUInt("wifi_fails", 0) + 1;
  prefs.putUInt("wifi_fails", n);
  prefs.end();
  LOGF("[wifi] recorded connect failure #%u\n", (unsigned)n);
}

void wifiRecordSuccess() {
  Preferences prefs;
  prefs.begin("yat", false);
  prefs.putUInt("wifi_fails", 0);
  prefs.end();
}

static bool isPlaceholderWifiValue(const char* s) {
  return !s || s[0] == '\0' || strcmp(s, "your-wifi-ssid") == 0 ||
         strcmp(s, "your-wifi-password") == 0;
}

// Dev convenience only (secrets.h.example's header comment): if NVS has no
// credentials yet and secrets.h was actually filled in, copy it into NVS once
// so the pre-v0.3 `cp secrets.h.example secrets.h` workflow still "just
// works" without a provisioning round trip. A no-op forever after that first
// successful seed, since loadWifiCreds() will report valid==true.
// Dev backdoor, OFF by default: a build that silently knows the developer's
// WiFi defeats the out-of-box provisioning flow this product lives or dies by
// (it has burned a "blank device" end-to-end test twice now). Re-enable for a
// bench unit with -DYAT_SEED_WIFI_FROM_SECRETS in platformio.ini.
void maybeSeedWifiFromSecrets() {
#ifdef YAT_SEED_WIFI_FROM_SECRETS
  if (loadWifiCreds().valid) return;
  if (isPlaceholderWifiValue(WIFI_SSID) || isPlaceholderWifiValue(WIFI_PASS)) return;
  LOGF("[wifi] seeding NVS from secrets.h dev default (one-time)\n");
  saveWifiCreds(WIFI_SSID, WIFI_PASS);
#endif
}

// ---------------- network ----------------

bool wifiConnect(const char* ssid, const char* pass) {
  LOGF("[wifi] connecting to \"%s\"...\n", ssid);
  uint32_t t0 = millis();
  WiFi.mode(WIFI_STA);
  WiFi.setSleep(true);
  WiFi.begin(ssid, pass);
  while (WiFi.status() != WL_CONNECTED && millis() - t0 < WIFI_TIMEOUT_MS) delay(100);
  if (WiFi.status() != WL_CONNECTED) {
    LOGF("[wifi] FAILED after %lu ms (status %d)\n", (unsigned long)(millis() - t0),
         (int)WiFi.status());
    return false;
  }
  LOGF("[wifi] up in %lu ms — %s, %d dBm\n", (unsigned long)(millis() - t0),
       WiFi.localIP().toString().c_str(), WiFi.RSSI());
  return true;
}

// True once restoreClockFromNvs() has put an approximate time on the clock
// that SNTP has not yet corrected. syncTime() needs to know: with a plausible
// time already on the clock, "time(nullptr) looks sane" stops meaning "SNTP
// answered", and a wait that tests only for sanity would return instantly and
// leave the device running on a stale clock for the rest of its life.
static bool g_clockApprox = false;

// The last-known epoch, written to NVS on every sleep (lowLevelSleep) and
// restored HERE — at the top of the cycle — rather than inside syncTime(),
// where it used to sit behind an SNTP attempt that only runs after WiFi is up.
// On a cold boot everything before that ran against a 1970 clock, including the
// warnsum TLS fetch, whose certificate validity dates are then checked against
// a date 54 years before the certificate was issued. An approximate clock (out
// by however long the device was off) is wrong in a way TLS does not care
// about; epoch 0 is wrong in a way it does.
//
// Only restores when the clock is unset: a deep-sleep wake keeps system time
// through the RTC, so the live clock is already better than anything stored.
void restoreClockFromNvs() {
  if (time(nullptr) > CLOCK_SANE_EPOCH) return;
  Preferences prefs;
  prefs.begin("yat", true);
  time_t stored = (time_t)prefs.getULong64("epoch", 0);
  prefs.end();
  if (stored <= CLOCK_SANE_EPOCH) {
    LOGF("[time] cold boot, no stored epoch — clock stays unset until SNTP\n");
    return;
  }
  struct timeval tv = {.tv_sec = stored, .tv_usec = 0};
  settimeofday(&tv, nullptr);
  g_clockApprox = true;
  struct tm lt;
  localtime_r(&stored, &lt);
  LOGF("[time] cold boot — restored stored epoch %04d-%02d-%02d %02d:%02d HKT (approx, until "
       "SNTP)\n",
       lt.tm_year + 1900, lt.tm_mon + 1, lt.tm_mday, lt.tm_hour, lt.tm_min);
}

bool syncTime() {
  const uint32_t t0 = millis();
  const time_t entryEpoch = time(nullptr);
  // Whether the sane-looking clock we are starting from is the restored
  // approximation rather than a real time, which decides how "SNTP landed" has
  // to be detected below.
  const bool startedApprox = g_clockApprox && entryEpoch > CLOCK_SANE_EPOCH;

  configTzTime(TZ_HK, "pool.ntp.org", "time.google.com", "hk.pool.ntp.org");

  bool synced = false;
  while (millis() - t0 < SNTP_TIMEOUT_MS) {
    const time_t now = time(nullptr);
    if (!startedApprox) {
      if (now > CLOCK_SANE_EPOCH) {  // was the un-synced 1970 epoch, now is not
        synced = true;
        break;
      }
    } else {
      // SNTP replaces the whole clock at once, while an approximate one only
      // ever advances with millis(). A reading that has left that line is a
      // real sync — and a stored epoch is stale by at least the sleep that
      // wrote it, so a sync always moves it by more than this margin.
      const long drift = (long)(now - entryEpoch) - (long)((millis() - t0) / 1000);
      if (drift > 3 || drift < -3) {
        synced = true;
        break;
      }
    }
    delay(100);
  }

  time_t now = time(nullptr);
  if (synced) {
    g_clockApprox = false;
    struct tm lt;
    localtime_r(&now, &lt);
    LOGF("[time] synced in %lu ms — %04d-%02d-%02d %02d:%02d:%02d HKT\n",
         (unsigned long)(millis() - t0), lt.tm_year + 1900, lt.tm_mon + 1, lt.tm_mday, lt.tm_hour,
         lt.tm_min, lt.tm_sec);
    return true;
  }
  if (now > CLOCK_SANE_EPOCH) {
    // Either the restored epoch from the top of the cycle, or the clock the RTC
    // carried through deep sleep. Good enough to schedule against, which is why
    // this still counts as having the time.
    LOGF("[time] SNTP timeout after %lu ms — keeping the %s clock (approx, may lag one slot)\n",
         (unsigned long)(millis() - t0), g_clockApprox ? "stored" : "RTC");
    return true;
  }
  LOGF("[time] SNTP timeout after %lu ms — clock not set\n", (unsigned long)(millis() - t0));
  return false;
}

// audit #19. Every source a pack declares is a URL somebody else's server
// answers, and until now the answer was read whole with no ceiling on it: a
// feed that grows, a misconfigured endpoint that returns a video, or an
// upstream error page in the megabytes would all be pulled into RAM until the
// allocator gave out. On a device whose recovery from that is a panic reboot
// into the same fetch, on battery, with nothing on the panel to say why.
//
// 256 KB is far above anything a pack legitimately reads — the biggest real
// source in packs/examples is a few tens of KB, and the pack FILES themselves
// are capped at 64 KB (PACK-SPEC §12.1) — and far below what this board can be
// pushed into. Over the cap is simply a failed fetch: the engine's stale-serve
// machinery already knows how to keep yesterday's snapshot on the panel and the
// footer already knows how to mark it, which is a better answer than a reboot.
static constexpr size_t FETCH_MAX_BODY = 256 * 1024;

// Bounded sink for HTTPClient::writeToStream(). Reading through the library's
// own copy loop rather than off getStreamPtr() by hand is what keeps chunked
// transfer-encoding working — the raw socket still has the chunk framing in it,
// and writeToStream is where that gets stripped.
//
// The cap is enforced by returning a SHORT write, which is HTTPClient's
// documented abort signal (writeToStreamDataBlock compares the return against
// what it handed us and bails with HTTPC_ERROR_STREAM_WRITE): the connection is
// dropped mid-body rather than politely drained, so an oversized response costs
// only the bytes already in flight.
class BoundedBodySink : public Stream {
 public:
  BoundedBodySink(std::string& out, size_t cap) : out_(out), cap_(cap) {}
  size_t write(uint8_t c) override { return write(&c, 1); }
  size_t write(const uint8_t* data, size_t len) override {
    const size_t room = out_.size() < cap_ ? cap_ - out_.size() : 0;
    const size_t take = len < room ? len : room;
    if (take) out_.append((const char*)data, take);
    if (take < len) over_ = true;
    return take;
  }
  // Write-only: nothing ever reads back out of this.
  int available() override { return 0; }
  int read() override { return -1; }
  int peek() override { return -1; }
  bool over() const { return over_; }

 private:
  std::string& out_;
  size_t cap_;
  bool over_ = false;
};

// yat::FetchFn — one HTTPS GET per declared source. Wrapped just below, so
// every failure exit lands on one error-ring hook rather than five.
//
// `pinnedIp`/`pinnedHost` are set only by fetchPackSource(), which has
// already resolved and range-checked the host before this runs (below). When
// set, the TCP connect targets `*pinnedIp` directly — the same address just
// checked — while SNI and certificate hostname verification still run
// against `pinnedHost`, via WiFiClientSecure's connect(ip, port, host, ...)
// overload; HTTPClient::connect() sees the socket already open and skips its
// own (re-resolving) connect. Everything else (firmware's own fetches, via
// httpsFetch() with no pinning args) resolves exactly where it always did:
// inside HTTPClient/WiFiClientSecure when begin()+GET() runs.
static bool httpsFetchOnce(const std::string& sourceId, const std::string& url,
                           std::string& bodyOut, std::string& errOut,
                           const IPAddress* pinnedIp = nullptr,
                           const std::string& pinnedHost = std::string()) {
  LOGF("[fetch] %s <- %s\n", sourceId.c_str(), url.c_str());
  uint32_t t0 = millis();

  WiFiClientSecure client;
  client.setCACert(YAT_CA_BUNDLE);
  client.setTimeout(15);  // seconds

  if (pinnedIp) {
    if (client.connect(*pinnedIp, 443, pinnedHost.c_str(), YAT_CA_BUNDLE, nullptr, nullptr) != 1) {
      errOut = "TLS connect failed (pinned IP)";
      return false;
    }
  }

  HTTPClient http;
  http.setFollowRedirects(HTTPC_DISABLE_FOLLOW_REDIRECTS);
  http.setConnectTimeout(15000);
  http.setTimeout(15000);
  http.setUserAgent("yat/0.2");

  char msg[96];
  if (!http.begin(client, String(url.c_str()))) {
    errOut = "http.begin failed";
    return false;
  }
  int code = http.GET();
  if (code != HTTP_CODE_OK) {
    snprintf(msg, sizeof(msg), "HTTP %d (%s)", code,
             http.errorToString(code).c_str());
    errOut = msg;
    http.end();
    return false;
  }
  // Content-Length first, so a server that announces something absurd costs one
  // header round trip instead of 256 KB of radio time and battery. -1 means the
  // response is chunked or close-delimited and there is nothing to check yet —
  // the sink below is the backstop either way, and is the only guard that
  // matters against a server that lies about its own length.
  const int contentLen = http.getSize();
  if (contentLen > 0 && (size_t)contentLen > FETCH_MAX_BODY) {
    snprintf(msg, sizeof msg, "response too big (%d bytes, cap %u)", contentLen,
             (unsigned)FETCH_MAX_BODY);
    errOut = msg;
    http.end();
    return false;
  }
  bodyOut.clear();
  if (contentLen > 0) bodyOut.reserve((size_t)contentLen);
  BoundedBodySink sink(bodyOut, FETCH_MAX_BODY);
  const int written = http.writeToStream(&sink);
  http.end();
  if (sink.over()) {
    snprintf(msg, sizeof msg, "response over the %u byte cap", (unsigned)FETCH_MAX_BODY);
    errOut = msg;
    bodyOut.clear();  // a truncated body is not a small body: never hand it on
    return false;
  }
  if (written < 0) {
    snprintf(msg, sizeof msg, "read failed (%s)", HTTPClient::errorToString(written).c_str());
    errOut = msg;
    bodyOut.clear();
    return false;
  }

  LOGF("[fetch] %u bytes in %lu ms\n", (unsigned)bodyOut.size(),
       (unsigned long)(millis() - t0));
  return true;
}

// The recording half. `errOut` is deliberately NOT carried into the ring: it
// holds an HTTP status and, on some paths, a slice of a server's own words,
// which is a debugging detail and not something a household can act on. What
// they can act on is which of their pages went quiet, and the ring's
// duplicate-collapse means a pack whose six sources all fail leaves one row
// naming that page rather than six naming nothing.
bool httpsFetch(const std::string& sourceId, const std::string& url,
                       std::string& bodyOut, std::string& errOut) {
  if (httpsFetchOnce(sourceId, url, bodyOut, errOut)) return true;
  if (g_fetchErrRecord) recordError(ERR_SRC_FETCH, g_fetchErrPage);
  return false;
}

// ---------------- pack-source SSRF guard (PACK-SPEC §12.3 rule 2) ----------------
//
// fetchPackSource() is the FetchFn eng.fetchAndExtract() is actually handed
// (main.cpp, yat_portal.cpp) — the one and only path a pack's own declared
// `data.sources[].url` reaches the network by. It is deliberately NOT folded
// into httpsFetch()/httpsFetchOnce() above: those two are also how firmware
// fetches its OWN hardcoded URLs (fetchWarnsumDecision's HKO endpoint,
// below), and a guard meant to stop a pack from reaching the household's LAN
// has no business also gating a URL firmware itself compiled in. OTA
// (yat_ota.cpp) never calls into this file at all — it opens its own pinned
// WiFiClientSecure/HTTPClient pair straight to GitHub — and the settings
// portal only ever answers requests, it never issues them, so neither needed
// consideration here.
//
// Pulls the authority's host out of a source URL — the same shape
// yat_ota.cpp's splitRedirect() already parses GitHub's redirect target with,
// and for the same reason: the part before an '@' is attacker-supplied
// userinfo, not host, so "https://api.example.com@169.254.169.254/x" must be
// checked as 169.254.169.254, not api.example.com. IPv6 literals arrive
// bracketed ("[::1]:443"); everything else uses ':' only for a port.
static bool parseUrlHost(const std::string& url, std::string& hostOut) {
  const size_t schemeEnd = url.find("://");
  if (schemeEnd == std::string::npos) return false;
  const size_t authStart = schemeEnd + 3;
  size_t authEnd = url.size();
  for (size_t i = authStart; i < url.size(); i++) {
    const char c = url[i];
    if (c == '/' || c == '?' || c == '#') {
      authEnd = i;
      break;
    }
  }
  if (authEnd <= authStart) return false;
  const std::string authority = url.substr(authStart, authEnd - authStart);
  const size_t at = authority.rfind('@');
  const std::string hostport = (at == std::string::npos) ? authority : authority.substr(at + 1);
  if (hostport.empty()) return false;
  if (hostport[0] == '[') {
    const size_t close = hostport.find(']');
    if (close == std::string::npos) return false;
    hostOut = hostport.substr(1, close - 1);
    return !hostOut.empty();
  }
  const size_t colon = hostport.find(':');
  hostOut = (colon == std::string::npos) ? hostport : hostport.substr(0, colon);
  return !hostOut.empty();
}

// The PACK-SPEC §12.3 rule 2 range list, IPv4 half: 0.0.0.0/8 ("this host"),
// 10/8, 100.64/10 (shared address space / CGNAT), 127/8 (loopback),
// 169.254/16 (link-local — includes the cloud-metadata address every SSRF
// writeup leads with), 172.16/12, 192.168/16.
static bool ipv4InBlockedRange(const IPAddress& ip) {
  const uint8_t a = ip[0], b = ip[1];
  if (a == 0) return true;
  if (a == 10) return true;
  if (a == 100 && (b & 0xC0) == 0x40) return true;  // 100.64.0.0-100.127.255.255
  if (a == 127) return true;
  if (a == 169 && b == 254) return true;
  if (a == 172 && (b & 0xF0) == 0x10) return true;  // 172.16.0.0-172.31.255.255
  if (a == 192 && b == 168) return true;
  return false;
}

// IPv6 half of the same list — ::1, fc00::/7 (unique-local), fe80::/10
// (link-local). Checked defensively rather than because it is exercised:
// this device is WIFI_STA only and has never been seen to hold a global IPv6
// address, and WiFi.hostByName() (below) only tries an AAAA lookup ahead of
// an A lookup when it has one (esp32-arduino's NetworkManager::hostByName) —
// so in practice every resolution here comes back IPv4. If that ever
// changes, the range check is already in place rather than a gap to
// rediscover.
static bool ipv6InBlockedRange(const IPAddress& ip) {
  bool allZeroButLast = true;
  for (int i = 0; i < 15; i++) {
    if (ip[i] != 0) {
      allZeroButLast = false;
      break;
    }
  }
  if (allZeroButLast && ip[15] == 1) return true;             // ::1
  if ((ip[0] & 0xFE) == 0xFC) return true;                    // fc00::/7
  if (ip[0] == 0xFE && (ip[1] & 0xC0) == 0x80) return true;    // fe80::/10
  return false;
}

static bool destinationBlocked(const IPAddress& ip) {
  return ip.type() == IPv6 ? ipv6InBlockedRange(ip) : ipv4InBlockedRange(ip);
}

// WiFi.hostByName() resolves a literal IP host (IPv4 or IPv6) via
// IPAddress::fromString() before it ever touches DNS (esp32-arduino's
// NetworkManager::hostByName) — so this one call covers both "the pack wrote
// a real hostname" and "the pack wrote 169.254.169.254 directly" with no
// separate literal-IP parse needed here.
//
// Residual risk, stated rather than hidden: this resolves the host to decide
// whether to block it, and — when it is not blocked — hands the checked
// IPAddress straight into httpsFetchOnce()'s pinned connect below, so the
// request that actually goes out targets the address just inspected, not a
// second, independent resolution. SNI and certificate hostname verification
// still run against the real hostname (WiFiClientSecure::connect(ip, port,
// host, ...) below), so this is not a setInsecure()-style downgrade. What
// this does NOT close: a *later* fetch of the same source (the next wake,
// a retry) re-resolves and re-checks from scratch, and a DNS answer with a
// very short TTL could legitimately differ between wakes — that's a new
// request being pinned to whatever it resolves to *then*, not this one
// answering to two addresses at once. Closing that residual fully would need
// either a DNS-pinning proxy this device does not have, or refusing every
// host but a fixed allowlist, which does not fit a spec built around
// arbitrary public APIs. Accepted, not pretended away.
bool fetchPackSource(const std::string& sourceId, const std::string& url,
                      std::string& bodyOut, std::string& errOut) {
  std::string host;
  if (!parseUrlHost(url, host)) {
    // No host to check at all (malformed URL) — let the normal path fail on
    // its own, already-tested terms rather than invent a second message for
    // the same event.
    return httpsFetch(sourceId, url, bodyOut, errOut);
  }

  IPAddress ip;
  if (WiFi.hostByName(host.c_str(), ip) != 1) {
    // Resolution failing is an ordinary network failure, not evidence of
    // anything hostile — fall through to the normal fetch, which will hit
    // the same DNS failure and report it the usual way.
    return httpsFetch(sourceId, url, bodyOut, errOut);
  }

  if (destinationBlocked(ip)) {
    char msg[160];
    snprintf(msg, sizeof msg,
             "E_FETCH_BLOCKED: %s resolves to %s, a private/loopback address (PACK-SPEC "
             "§12.3 rule 2)",
             host.c_str(), ip.toString().c_str());
    errOut = msg;
    LOGF("[fetch] %s <- %s BLOCKED (%s -> %s)\n", sourceId.c_str(), url.c_str(), host.c_str(),
         ip.toString().c_str());
    if (g_fetchErrRecord) recordError(ERR_SRC_FETCH, g_fetchErrPage);
    return false;
  }

  if (httpsFetchOnce(sourceId, url, bodyOut, errOut, &ip, host)) return true;
  if (g_fetchErrRecord) recordError(ERR_SRC_FETCH, g_fetchErrPage);
  return false;
}

// ---------------- warning takeover (PRD §4.2/§5.1, docs/UX-FLOWS.md G15) ----------------
//
// Every wake, right after WiFi is up (and before any page pack loads), fetch
// HKO's warnsum endpoint directly via httpsFetch (above) — the same small
// (~1-2 KB in practice, capped at 8 KB) JSON the embedded warning-takeover
// pack itself separately fetches via its own declared source when and only
// when this decides to load it. This call exists purely to decide WHETHER to
// preempt the playlist; it never touches yat::Engine.
//
// Policy: active iff a typhoon signal >= T3 (T3, T8 any direction, T9, T10 —
// NOT T1) OR a red/black rainstorm warning (NOT amber) is in force, per the
// real API shape (dataType=warnsum): a "WTCSGNL"/"WRAIN" object with a "code"
// field, one of TC1/TC3/TC8NE/TC8SE/TC8SW/TC8NW/TC9/TC10/CANCEL or
// WRAINA/WRAINR/WRAINB respectively (HKO Open Data API doc §"Weather Warning
// Summary"). The embedded pack (packs/internal/warning-takeover.yat-pack.json)
// renders every one of those codes correctly, including T1 and amber — it is
// firmware's ACTIVATION threshold that is more conservative than what the
// pack can display, not a limitation of the pack.
static const char* const WARNSUM_URL =
    "https://data.weather.gov.hk/weatherAPI/opendata/weather.php?dataType=warnsum&lang=tc";

static bool tcSignalActivates(const std::string& code) {
  return code == "TC3" || code == "TC8NE" || code == "TC8SE" || code == "TC8SW" ||
         code == "TC8NW" || code == "TC9" || code == "TC10";
}
static bool rainSignalActivates(const std::string& code) { return code == "WRAINR" || code == "WRAINB"; }



// Fetch/parse failure returns ok=false and leaves active/signal at their
// defaults — the caller (setup()) falls back to the PERSISTED state rather
// than guess, so one bad fetch mid-typhoon cannot silently drop the takeover
// page back to the normal playlist (PRD: "never block the cycle").
WarnsumResult fetchWarnsumDecision() {
  WarnsumResult r;
  std::string body, err;
  if (!httpsFetch("warnsum", WARNSUM_URL, body, err)) {
    LOGF("[takeover] warnsum fetch failed (%s) — keeping last known state\n", err.c_str());
    return r;
  }
  JsonDocument doc;
  if (deserializeJson(doc, body)) {
    LOGF("[takeover] warnsum parse failed — keeping last known state\n");
    return r;
  }
  r.ok = true;
  const char* tc = doc["WTCSGNL"]["code"] | "";
  const char* rain = doc["WRAIN"]["code"] | "";
  if (tc[0] && tcSignalActivates(tc)) {
    r.active = true;
    r.signal = tc;
  } else if (rain[0] && rainSignalActivates(rain)) {
    r.active = true;
    r.signal = rain;
  }
  return r;
}

// Sleep-cadence clamp (PRD §4.2/§5.1): while takeover is active, never sleep
// longer than 15 minutes regardless of what the loaded pack's own schedule or
// config.json's quiet_hours already decided — reaction time is safety-
// critical and overrides both. Applied on top of computeSleepPlan()'s output
// so the quiet-hours/window arithmetic itself stays in one place. TAKEOVER_MAX
// _SLEEP_S itself lives with the other cadence constants at the top of the
// file because deepSleepError() applies the same ceiling to failed cycles.
void clampForTakeover(SleepPlan& plan) {
  if (g_takeoverActive && plan.seconds > TAKEOVER_MAX_SLEEP_S) {
    char buf[256];
    snprintf(buf, sizeof buf, "%s; warning takeover active — clamped to %llu s", plan.reason.c_str(),
             (unsigned long long)TAKEOVER_MAX_SLEEP_S);
    plan.reason = buf;
    plan.seconds = TAKEOVER_MAX_SLEEP_S;
  }
}
