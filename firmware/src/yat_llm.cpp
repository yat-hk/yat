// Generated by the main.cpp module split: the code below is a verbatim
// slice of the original single-translation-unit firmware/src/main.cpp.

#include "yat_llm.h"

#include <cctype>
#include <stdio.h>
#include <string.h>

#include <ArduinoJson.h>
#include <HTTPClient.h>
#include <Preferences.h>
#include <WiFi.h>
#include <WiFiClientSecure.h>

#include "certs.h"

#include "yat_config.h"
#include "yat_errors.h"
#include "yat_voice.h"
#include "yat_state.h"

// ---------------- the voice router's three doors ----------------
//
// The key itself says which service issued it. OpenRouter stamps every key it
// issues "sk-or-" and NVIDIA stamps theirs "nvapi-"; DeepSeek's carry no such
// marker, so they are the fallback. One paste field therefore serves all three
// and nobody is ever asked "which service is this from?" — a question with a
// wrong answer, put to someone holding fifty opaque characters they copied out
// of an email. A key that matches no prefix reads as DeepSeek, which leaves
// every device already in the field on exactly the route it had.
//
// Three doors rather than one because signup and payment, not capability, are
// what stop people: DeepSeek's billing is not reachable from everywhere,
// OpenRouter takes ordinary cards, and NVIDIA hands out free credits to anyone
// with an account. The defaults are chosen so that which door a household ends
// up at is not a decision about quality they have to make — see the model notes
// on each row. config.json "llm_model" overrides the model for whichever
// provider is active (parseLlmModel).
//
// Adding a fourth means adding a row: everything that varies per provider is in
// this table, and every reader below goes through llmProviderFor(), so the
// stored key and the URL it is sent to cannot drift apart.
struct LlmProviderInfo {
  const char* name;      // reported by STATUS/api/status; never any part of a key
  const char* prefix;    // "" marks the fallback row, which must be last
  const char* chatUrl;   // POST, OpenAI-compatible chat completions
  const char* model;     // default; config.json "llm_model" overrides it
  const char* verifyUrl; // cheapest endpoint that actually authenticates
  bool verifyByChat;     // true => POST a 1-token completion; see verifySecretKey
};

static const LlmProviderInfo kLlmProviders[] = {
    {"openrouter", "sk-or-", "https://openrouter.ai/api/v1/chat/completions",
     // DeepSeek V4 Flash (switched from deepseek-chat/V3 2026-08-06): ~3x
     // cheaper per token on OpenRouter ($0.088/M vs $0.257/M prompt, checked
     // live) and an efficiency-tuned 13B-active MoE — exactly the shape an
     // 8-token page-id answer wants. It is a HYBRID-THINKING model, so the
     // request below must keep reasoning disabled or the token budget is spent
     // thinking and the answer never arrives (the gemma lesson, again).
     "deepseek/deepseek-v4-flash", "https://openrouter.ai/api/v1/key", false},
    {"nvidia", "nvapi-", "https://integrate.api.nvidia.com/v1/chat/completions",
     // NOT a DeepSeek model, and deliberately so. NVIDIA's catalog carries no
     // Qwen at all (checked live against GET /v1/models, 2026-08-03), and its
     // DeepSeek entry is "deepseek-v4-flash", which ships a thinking mode —
     // fatal here, because this router caps the answer at 8 tokens and a model
     // that spends them reasoning returns nothing a page id can be read out of.
     // Gemma 3 12B IT is the catalog's best fit for what this actually asks:
     // plainly instruction-tuned with no reasoning phase, multilingual as its
     // headline capability (which is the whole job — Cantonese and English
     // utterances), and small enough to answer inside the 8 s timeout.
     "google/gemma-3-12b-it", "https://integrate.api.nvidia.com/v1/chat/completions", true},
    // The fallback, and it must stay last: an empty prefix matches nothing, so
    // llmProviderFor() falls through to it.
    {"deepseek", "", "https://api.deepseek.com/chat/completions", "deepseek-chat",
     "https://api.deepseek.com/models", false},
};

static constexpr size_t kLlmProviderCount = sizeof kLlmProviders / sizeof kLlmProviders[0];

static const LlmProviderInfo& llmProviderFor(const char* key) {
  if (key)
    for (const LlmProviderInfo& p : kLlmProviders)
      if (p.prefix[0] && strncmp(key, p.prefix, strlen(p.prefix)) == 0) return p;
  return kLlmProviders[kLlmProviderCount - 1];
}

// llm_key (NVS "yat"/"llm_key") is the voice router's second-tier credential —
// a DeepSeek, OpenRouter or NVIDIA API key, set/cleared by YAT SECRET llm. Same
// discipline as stt_key: STATUS reports presence only, and nothing ever reads
// the value back out. Optional in a way stt_key is not: with no key the voice
// path simply keeps the keyword-only behaviour it has always had (see
// voiceRouteByLlm).
//
// Returns the provider name rather than a bool because both status routes want
// both facts and this way they cost one NVS read between them: a name from the
// table above, or "" for no key on file, which is also the "llm_ready is false"
// answer. The returned string is always one of those literals — no part of the
// key is ever in it, which is what makes it safe to put in a status response
// and read aloud to support.
const char* llmProvider() {
  Preferences prefs;
  prefs.begin("yat", true);
  String v = prefs.getString("llm_key", "");
  prefs.end();
  if (v.isEmpty()) return "";
  return llmProviderFor(v.c_str()).name;
}

// ---------------- voice routing, tier 2: the LLM fallback ----------------
//
// Tier 1 is matchPageByText() above: a keyword the household or the pack
// declared, found inside the transcript. It costs nothing, needs no network
// beyond the STT call that already happened, and is what answers "天氣" ->
// weather page. It is also literal — "而家出面凍唔凍" names no alias, and the
// device has always answered that with the "try again" tone.
//
// Tier 2 runs only there: alias miss, and a router key on file — DeepSeek,
// OpenRouter or NVIDIA, told apart by prefix and otherwise treated identically
// (see kLlmProviders). One chat completion is shown the page list and the
// transcript and asked to name one page. Three properties make this safe to
// bolt onto the voice path:
//
//   - It is optional in both directions. No key -> the function returns -1
//     before touching the radio, and the cycle behaves exactly as it did
//     before this existed.
//   - It cannot invent a page. The reply is looked up in g_pages by id
//     (llmPageIdToIndex); anything else — a hallucinated id, an apology, an
//     empty string, the literal NONE — is -1, which is the same -1 the alias
//     matcher returns and lands in the same NOMATCH branch.
//   - It cannot fail loudly. Every error path returns -1 and the caller plays
//     the ordinary "didn't catch that" cue, so a dead API or an expired key
//     degrades to keyword-only routing rather than to a fault buzz.
//
// The page list is built from the alias cache, which is already in RAM — the
// LLM path never re-reads a pack file that buildPageAliasCache() has read.

static constexpr uint32_t LLM_RESPONSE_TIMEOUT_MS = 8000;
// Which URL and which model come from kLlmProviders (the provider table, near
// llmProvider() above) — all three speak the OpenAI chat-completions shape, so
// the request built below is byte-identical between them apart from the model
// name.
static const char* const LLM_SYSTEM_PROMPT =
    "You route voice commands for an e-ink display. Given the page list and what the user said, "
    "reply with EXACTLY one page id from the list, or NONE. No other text.";
// The same one call, with the household todo list added — sent instead of the
// prompt above, and only on a device that has the todo pack installed. Two
// choices in here are load-bearing rather than stylistic:
//
//   - DONE is answered by NUMBER. The model is never asked to write an item's
//     text back, so the entire class of "it marked the wrong one because the
//     text nearly matched" cannot occur on this tier: the answer is an index
//     into a list this firmware built, and an index outside it is refused
//     below. Free-writing the text would put the fuzzy matcher back in the
//     loop with a less predictable input than the human gave it.
//   - "If more than one item could be meant, answer NONE" is the same rule the
//     on-device matcher enforces by counting candidates, said in words to the
//     tier that cannot be made to count. Both tiers would rather ask again than
//     be wrong once.
static const char* const LLM_SYSTEM_PROMPT_TODO =
    "You route voice commands for an e-ink display that also holds one household todo list. "
    "Given the page list, the open todo items and what the user said, reply with EXACTLY one line "
    "and nothing else:\n"
    "PAGE:<id> - show that page, using an id copied exactly from the list\n"
    "TODO:ADD:<text> - put <text> on the todo list\n"
    "TODO:DONE:<n> - mark open todo item number <n> done\n"
    "TODO:CLEAR - remove the todo items that are already done\n"
    "NONE - none of the above\n"
    "Always identify an item to finish by its NUMBER, never by its text. If more than one item "
    "could be the one meant, answer NONE.";
// Enough alias per page to characterize it; a household that typed twenty
// words for one page does not need all twenty in the prompt.
static constexpr size_t kLlmAliasesPerPage = 6;
// Reserve hint only — id + two names + aliases + a clipped description.
static constexpr size_t kLlmBytesPerPage = 200;

static String loadLlmKey() {
  Preferences prefs;
  prefs.begin("yat", true);
  String v = prefs.getString("llm_key", "");
  prefs.end();
  return v;
}

// Fills in the pack display metadata buildPageAliasCache() could not get for
// free — the pages whose aliases came from config.json, whose pack file it
// therefore never opened. Deliberately here and not in the cache build, for
// the same reason collectHelpRows() gives: the cache build runs on every
// single wake, and reading every pack for a name would be battery spent on
// every wake to serve a path taken only when someone taps KEY0, says something
// no keyword covers, and has a key on file. Here it costs one read per
// still-unknown page, once per boot, on a path that is about to wait seconds
// for a network round trip anyway.
static void ensurePageLlmMeta() {
  if (!g_fsReady) return;
  for (size_t i = 0; i < g_pageAliases.size() && i < g_pages.size(); i++) {
    if (g_pageAliases[i].metaLoaded) continue;
    g_pageAliases[i].metaLoaded = true;  // one attempt per boot, hit or miss
    std::string packJson;
    std::string path = "/packs/" + g_pages[i].pack + ".yat-pack.json";
    if (!littlefsReadFile(path.c_str(), packJson)) {
      LOGF("[voice] page %u (\"%s\") pack \"%s\" unreadable — listed to the router by id only\n",
           (unsigned)i, g_pages[i].id.c_str(), g_pages[i].pack.c_str());
      continue;
    }
    JsonDocument doc;  // scoped: freed before the next page's read
    if (deserializeJson(doc, packJson, DeserializationOption::NestingLimit(24))) continue;
    cachePackMeta(g_pageAliases[i], doc);
  }
}

// Appends one untrusted string to the prompt with every control character
// flattened to a space. PACK-SPEC §12.3 makes name/description/aliases data,
// never instructions, and the message below is line-structured: a newline
// smuggled into a pack's name would otherwise let that pack write extra page
// lines — or a second "User said:" — into the prompt. It could not conjure a
// page either way (llmPageIdToIndex only accepts ids that were listed), but it
// could steer the choice between real pages, and this closes that off at the
// cheap end. The transcript goes through the same filter: it is whatever the
// STT service returned, not something this firmware vouches for.
static void llmAppendField(std::string& out, const std::string& s) {
  for (char c : s) {
    unsigned char u = (unsigned char)c;
    out += (u < 0x20 || u == 0x7F) ? ' ' : c;
  }
}

// One line per page:
//
//   <id> | <zh-Hant name> | <en name> | aliases: a, b, c | <en description>
//
// then a final "User said: <transcript>". Fields a pack didn't declare come
// out empty rather than being omitted, so the column meaning never shifts.
static void llmBuildUserContent(const std::string& transcript, std::string& out,
                                const std::vector<TodoOpenItem>* openItems) {
  out.clear();
  out.reserve(g_pages.size() * kLlmBytesPerPage + transcript.size() + 16);
  if (openItems) out += "Pages:\n";
  for (size_t i = 0; i < g_pages.size(); i++) {
    const PageAliasSet* set = i < g_pageAliases.size() ? &g_pageAliases[i] : nullptr;
    llmAppendField(out, g_pages[i].id);
    out += " | ";
    if (set) llmAppendField(out, set->nameZh);
    out += " | ";
    if (set) llmAppendField(out, set->nameEn);
    out += " | aliases: ";
    if (set) {
      size_t shown = 0;
      for (const NormalizedAlias& alias : set->aliases) {
        // Jyutping is a spelling for the substring matcher that has already run
        // and missed. To a model reading Chinese it is noise on a metered API.
        if (alias.group == kAliasJyut || alias.display.empty()) continue;
        if (shown) out += ", ";
        llmAppendField(out, alias.display);
        if (++shown >= kLlmAliasesPerPage) break;
      }
    }
    out += " | ";
    if (set) llmAppendField(out, set->descEn);
    out += "\n";
  }
  // The numbers here are what a TODO:DONE answer refers to, so they are
  // generated in one place and resolved in one place (llmParseAnswer) against
  // the very same vector — there is no second enumeration that could drift.
  // Done items are not listed at all: they are not markable, and leaving them
  // out is what keeps a number meaning the same thing in both directions.
  if (openItems) {
    out += "Open todo items:\n";
    if (openItems->empty()) out += "(none)\n";
    for (size_t i = 0; i < openItems->size(); i++) {
      char num[8];
      snprintf(num, sizeof num, "%u. ", (unsigned)(i + 1));
      out += num;
      llmAppendField(out, (*openItems)[i].text);
      out += "\n";
    }
  }
  out += "User said: ";
  llmAppendField(out, transcript);
}

// Trims whitespace and the punctuation a chat model tends to wrap an answer
// in, then looks the result up in the page list. This is the whole
// hallucination defence: an id nobody configured — invented, misspelled, or a
// full sentence of apology — finds nothing here and reads as NONE.
static int llmPageIdToIndex(const std::string& raw) {
  auto trimmable = [](char c) {
    return c == ' ' || c == '\t' || c == '\r' || c == '\n' || c == '"' || c == '\'' || c == '`' ||
           c == '.' || c == ',';
  };
  size_t b = 0, e = raw.size();
  while (b < e && trimmable(raw[b])) b++;
  while (e > b && trimmable(raw[e - 1])) e--;
  const std::string id = raw.substr(b, e - b);
  // Checked before the lookup, not after: a household that named a page "NONE"
  // must not be switched to it by the sentinel that means "I found nothing".
  if (id.empty() || id == "NONE") return -1;
  for (size_t i = 0; i < g_pages.size(); i++)
    if (id == g_pages[i].id) return (int)i;
  // Second pass, ASCII-case-insensitive: a model that answers "Weather" for
  // page "weather" has still named a real page, and folding case cannot
  // produce one that is not on this list.
  for (size_t i = 0; i < g_pages.size(); i++) {
    const std::string& pid = g_pages[i].id;
    if (pid.size() != id.size()) continue;
    bool same = true;
    for (size_t k = 0; k < pid.size() && same; k++)
      same = tolower((unsigned char)pid[k]) == tolower((unsigned char)id[k]);
    if (same) return (int)i;
  }
  return -1;
}

// Trims the same wrapping the page-id reader trims, then reads the answer as
// one of the five shapes the todo prompt allows. Every one of them is checked
// against something that exists: a page id must be in g_pages, an item number
// must be within the list that was actually sent, an add must have text left
// after the prefix. Anything else — a shape that is not on the list, a number
// out of range, an apology, a page id nobody configured — comes back None,
// which is where a device with no key has always ended up.
static LlmVoiceAnswer llmParseAnswer(const std::string& raw,
                                     const std::vector<TodoOpenItem>& openItems, bool todoInstalled,
                                     const char* provider) {
  LlmVoiceAnswer ans;
  auto trimmable = [](char c) {
    return c == ' ' || c == '\t' || c == '\r' || c == '\n' || c == '"' || c == '\'' || c == '`' ||
           c == '.' || c == ',';
  };
  size_t b = 0, e = raw.size();
  while (b < e && trimmable(raw[b])) b++;
  while (e > b && trimmable(raw[e - 1])) e--;
  const std::string line = raw.substr(b, e - b);

  auto startsWithCI = [&line](const char* p) {
    const size_t n = strlen(p);
    if (line.size() < n) return false;
    for (size_t i = 0; i < n; i++)
      if (tolower((unsigned char)line[i]) != tolower((unsigned char)p[i])) return false;
    return true;
  };

  // Page-only devices keep the old contract exactly: a bare page id, no
  // prefix. A PAGE: prefix is accepted there too rather than rejected — it
  // costs one branch and means a household that later installs the todo pack
  // cannot be bitten by a model that learned the prefixed form.
  if (!todoInstalled || !startsWithCI("TODO:")) {
    const std::string id = startsWithCI("PAGE:") ? line.substr(5) : line;
    const int idx = llmPageIdToIndex(id);
    if (idx < 0) {
      LOGF("[voice] %s answered \"%.60s\" — no page with that id, treating as NONE\n", provider,
           line.c_str());
      return ans;
    }
    ans.kind = LlmVoiceAnswer::Page;
    ans.pageIdx = idx;
    return ans;
  }

  if (startsWithCI("TODO:CLEAR")) {
    ans.kind = LlmVoiceAnswer::TodoClear;
    return ans;
  }
  if (startsWithCI("TODO:ADD:")) {
    std::string text = line.substr(9);
    while (!text.empty() && isspace((unsigned char)text.front())) text.erase(text.begin());
    while (!text.empty() && isspace((unsigned char)text.back())) text.pop_back();
    if (text.empty()) {
      LOGF("[voice] %s answered an add with no text — treating as NONE\n", provider);
      return ans;
    }
    ans.kind = LlmVoiceAnswer::TodoAdd;
    ans.text = text;  // clipped to the schema's 48 characters by todoApply()
    return ans;
  }
  if (startsWithCI("TODO:DONE:")) {
    const std::string num = line.substr(10);
    size_t k = 0;
    while (k < num.size() && isspace((unsigned char)num[k])) k++;
    long n = 0;
    bool digits = false;
    for (; k < num.size() && isdigit((unsigned char)num[k]); k++) {
      digits = true;
      n = n * 10 + (num[k] - '0');
      if (n > 9999) break;  // no list is this long; stop before overflowing
    }
    // The number is only ever an index into the list this call sent. Out of
    // range is refused rather than clamped: "the nearest item to the one it
    // named" is exactly the guess this whole design refuses to make.
    if (!digits || n < 1 || (size_t)n > openItems.size()) {
      LOGF("[voice] %s answered done for item %ld of %u — out of range, treating as NONE\n",
           provider, digits ? n : -1L, (unsigned)openItems.size());
      return ans;
    }
    ans.kind = LlmVoiceAnswer::TodoDone;
    ans.itemIdx = openItems[(size_t)n - 1].idx;
    return ans;
  }
  LOGF("[voice] %s answered a shape that is not on the list — treating as NONE\n", provider);
  return ans;
}

// Returns what the router decided, or a None answer meaning "route it the way a
// device with no key would have". Never throws, never beeps, never blocks
// longer than the two 8 s timeouts below (connect, then response) allow.
LlmVoiceAnswer voiceRouteByLlm(const std::string& transcript, bool todoInstalled) {
  LlmVoiceAnswer none;
  if (g_pages.empty()) return none;
  String apiKey = loadLlmKey();
  if (apiKey.isEmpty()) {
    LOGF("[voice] no keyword matched and no LLM key set — keyword-only routing\n");
    return none;
  }

  // Which service, decided by the key's own prefix and nothing else — no
  // setting to get wrong, and no way for the stored key and the URL it is sent
  // to to disagree. `provider` is a literal out of the table and is the only
  // thing about the credential that reaches a log line.
  const LlmProviderInfo& prov = llmProviderFor(apiKey.c_str());
  const char* const provider = prov.name;
  const char* const url = prov.chatUrl;
  const char* const model = !g_llmModel.empty() ? g_llmModel.c_str() : prov.model;

  ensurePageLlmMeta();
  // Read once, before the request, and kept for the whole call: the numbering
  // in the prompt and the number the answer is resolved against must come from
  // the same snapshot, or "item 3" could mean two different things either side
  // of an 8 second round trip.
  std::vector<TodoOpenItem> openItems;
  const bool withTodo = todoInstalled && todoOpenItems(openItems);
  std::string userContent;
  llmBuildUserContent(transcript, userContent, withTodo ? &openItems : nullptr);

  std::string reqBody;
  {
    // Built through ArduinoJson rather than by hand: the user content carries
    // pack text and a transcript, i.e. quotes and backslashes this must not
    // have to escape correctly by eye.
    JsonDocument req;
    req["model"] = model;
    req["temperature"] = 0;
    // 8 tokens is the page-only budget and stays exactly that: a page id and
    // nothing else fits in it, which is half of why this tier cannot ramble.
    //
    // The todo prompt cannot live inside 8, and the arithmetic is worth writing
    // down because the obvious small number is wrong. TODO:ADD: costs ~5 tokens
    // of prefix, and the item text after it can be the schema's full 48
    // CHARACTERS. Chinese does not tokenize like English: common words merge to
    // roughly one token per one or two characters, but a byte-level BPE charges
    // up to three tokens for a character it has no merge for — one per UTF-8
    // byte — so 48 characters is ~30-50 tokens typically and 144 at the ceiling.
    // A 24-token cap would silently truncate any add past about fifteen Chinese
    // characters, and a truncated answer here becomes a truncated line on
    // somebody's shopping list. 160 covers the worst case with room for the
    // prefix; nothing is billed for headroom that is not generated, and the
    // finish_reason check below refuses an answer that hit the cap anyway.
    req["max_tokens"] = withTodo ? 160 : 8;
    // Hybrid-thinking models (the OpenRouter default V4 Flash, and whatever a
    // hand-set llm_model might be) MUST NOT think here: the whole budget is for
    // the answer, and reasoning would spend it before a page id appears. OpenRouter
    // normalizes {"reasoning":{"enabled":false}} across providers and ignores
    // it where a model has no such mode; DeepSeek direct and NVIDIA get their
    // non-thinking behaviour from the model id itself (deepseek-chat is the
    // non-thinking endpoint by definition), so only the OpenRouter door needs
    // the explicit flag — and sending it only there means the other providers'
    // stricter request parsers never see an unknown field.
    if (strcmp(prov.name, "openrouter") == 0) {
      req["reasoning"]["enabled"] = false;
    }
    JsonArray msgs = req["messages"].to<JsonArray>();
    JsonObject sys = msgs.add<JsonObject>();
    sys["role"] = "system";
    sys["content"] = withTodo ? LLM_SYSTEM_PROMPT_TODO : LLM_SYSTEM_PROMPT;
    JsonObject usr = msgs.add<JsonObject>();
    usr["role"] = "user";
    usr["content"] = userContent;
    serializeJson(req, reqBody);
  }
  // Sizes and counts, never the prompt itself: with a todo page installed this
  // request body carries the household's list, and a debug log is read aloud to
  // support and pasted into issues.
  LOGF("[voice] asking %s (%s) to route %u page(s)%s (%u byte prompt, %u byte request)\n", provider,
       model, (unsigned)g_pages.size(),
       withTodo ? (openItems.empty() ? " + an empty todo list" : " + the open todo items") : "",
       (unsigned)userContent.size(), (unsigned)reqBody.size());

  // Same transport as voiceTranscribe(): the pinned bundle, no setInsecure(),
  // no redirects. All three hosts already terminate in the bundle —
  // api.deepseek.com and integrate.api.nvidia.com both on anchor 8 (Amazon Root
  // CA 1, via Amazon RSA 2048 M01), openrouter.ai on anchor 6 (GTS Root R4, via
  // the GTS WE1 intermediate the server presents) — so neither added provider
  // brought any certificate surface with it.
  WiFiClientSecure client;
  client.setCACert(YAT_CA_BUNDLE);
  client.setTimeout(LLM_RESPONSE_TIMEOUT_MS / 1000);  // seconds

  HTTPClient http;
  if (!http.begin(client, url)) {
    LOGF("[voice] LLM http.begin failed — keyword-only routing\n");
    recordError(ERR_LLM_HTTP, nullptr);
    return none;
  }
  http.setFollowRedirects(HTTPC_DISABLE_FOLLOW_REDIRECTS);
  http.setConnectTimeout(LLM_RESPONSE_TIMEOUT_MS);
  http.setTimeout(LLM_RESPONSE_TIMEOUT_MS);
  http.setUserAgent("yat/0.3");
  http.addHeader("Authorization", String("Bearer ") + apiKey);
  http.addHeader("Content-Type", "application/json");

  uint32_t t0 = millis();
  int httpCode = http.POST((uint8_t*)reqBody.data(), reqBody.size());
  LOGF("[voice] %s HTTP %d in %lu ms\n", provider, httpCode, (unsigned long)(millis() - t0));
  if (httpCode != HTTP_CODE_OK) {
    String err = http.getString();
    err.replace("\n", " ");
    LOGF("[voice] %s error body: %.200s\n", provider, err.c_str());
    http.end();
    // Recorded even though this tier is optional and degrades silently to
    // keyword-only routing: from the household's side "it stopped
    // understanding me" is the same symptom either way, and this row is the
    // only thing that distinguishes a dead router key from a page whose
    // keywords they never set. The provider's own error text is not carried —
    // see the STT hook above.
    recordError(ERR_LLM_HTTP, nullptr, httpCode);
    return none;
  }
  // The router answered, so the key is good — see voiceTranscribe's caller for
  // why the clear lives on the success path (§11.4a).
  conditionClear(COND_VOICE_KEY);
  String payload = http.getString();
  http.end();

  // Filtered like the Scribe parse: a completion carries usage counts, ids and
  // timestamps this has no use for, and filtering keeps the document down to
  // the two strings that matter.
  JsonDocument filter;
  filter["choices"][0]["message"]["content"] = true;
  filter["choices"][0]["finish_reason"] = true;
  JsonDocument doc;
  DeserializationError derr =
      deserializeJson(doc, payload, DeserializationOption::Filter(filter));
  if (derr) {
    LOGF("[voice] %s JSON parse failed: %s — keyword-only routing\n", provider, derr.c_str());
    return none;
  }
  // An answer that ran into the token cap is not a short answer, it is half an
  // answer — and half of "TODO:ADD:買一打雞蛋同兩支牛奶" is an item somebody would
  // have to fix by hand. Refused outright rather than stored truncated.
  //
  // Checked only on the todo path, deliberately. On the page-only path a
  // truncated answer was already harmless — an id cut short matches no page and
  // reads as NONE, and one that survives the cut names a page the household
  // installed — so adding the check there would tighten a behaviour nobody
  // asked for and cost the property that matters more: a device without the
  // todo pack sends the same request it always sent and reads the reply the
  // same way.
  if (withTodo && std::string("length") == (doc["choices"][0]["finish_reason"] | "")) {
    LOGF("[voice] %s answer hit the token cap — treating as NONE\n", provider);
    return none;
  }
  const std::string answer = doc["choices"][0]["message"]["content"] | "";
  LlmVoiceAnswer ans = llmParseAnswer(answer, openItems, withTodo, provider);
  switch (ans.kind) {
    case LlmVoiceAnswer::Page:
      LOGF("[voice] %s routed to \"%s\" (page %d)\n", provider, g_pages[ans.pageIdx].id.c_str(),
           ans.pageIdx);
      break;
    case LlmVoiceAnswer::TodoAdd:
      // The item's own text is not logged here. The transcript it came out of
      // already is, one line up in runVoiceCapture(), and that is as far as
      // this path is willing to put someone's list into a debug stream.
      LOGF("[voice] %s routed to a todo add\n", provider);
      break;
    case LlmVoiceAnswer::TodoDone:
      LOGF("[voice] %s routed to todo done, item %d\n", provider, ans.itemIdx);
      break;
    case LlmVoiceAnswer::TodoClear:
      LOGF("[voice] %s routed to todo clear\n", provider);
      break;
    case LlmVoiceAnswer::None:
      break;
  }
  return ans;
}

// ---------------- key verification (POST /api/secret "verify":true) ----------------
//
// Pasting an API key into a phone is the single most error-prone thing this
// product asks anyone to do: the keys are ~50 opaque characters, they arrive by
// email or clipboard, and a truncated paste is indistinguishable from a good
// one until days later, when someone holds down the green button, talks to the
// device and gets a buzz. Before this, the device stored whatever it was given
// and said 「儲咗」 either way.
//
// So the portal can ask for the key to be tried before it is kept. One request
// against the provider, with the key as the only credential — /models at
// DeepSeek, /api/v1/key at OpenRouter, and for ElevenLabs a deliberately
// fileless POST to /v1/speech-to-text itself (why not /v1/user: below) — is
// enough to separate the three answers that matter:
//
//   Valid         2xx. The key works. Persist it and say so.
//   Rejected      401/403. The provider looked at this exact key and refused
//                 it. Do NOT persist: keeping a key the provider has already
//                 rejected would replace a working key with a broken one and
//                 leave the household no way back.
//   Unreachable   TLS or transport failure, or no STA link at all. Nothing was
//                 learned about the key. Persist anyway — an offline device
//                 must not refuse key entry, or setup on a network with no
//                 route out becomes impossible — and tell the portal it is
//                 unverified so it can say so rather than imply a ✓.
//   Inconclusive  Any other status (429, 5xx, a captive portal answering 200
//                 with a login page). Same handling as Unreachable, different
//                 word: the device is plainly online, so blaming the network
//                 would send someone to reboot a router that is fine.
//
// Every host is already trust-anchored in certs.h (anchor 7 GTS WR3 for
// api.elevenlabs.io, anchor 8 Amazon Root CA 1 for api.deepseek.com AND
// integrate.api.nvidia.com, anchor 6 GTS Root R4 for openrouter.ai) because the
// voice path talks to exactly these origins — this route adds no new
// certificate surface, and reuses voiceTranscribe()'s transport settings
// verbatim: the pinned bundle, no setInsecure(), no redirects.
//
// The response body is never read. These endpoints answer with account details,
// model lists and credit balances that this device has no use for, and not
// reading them keeps the whole check to a handshake plus headers.
//
// NVIDIA is the exception, and it is the reason verifyByChat exists in the
// provider table. Their obvious candidate, GET /v1/models on
// integrate.api.nvidia.com, does NOT authenticate: checked live 2026-08-03, it
// answers 200 to a request carrying a garbage key, and 200 again to one
// carrying no Authorization header at all. Using it would hand back a ✓ for
// every typo — which is worse than not checking, because the entire reason this
// route exists is that a truncated paste is invisible until someone talks to
// the device days later and gets a buzz. A check that cannot fail is a lie with
// a tick next to it.
//
// So an NVIDIA key is verified the honest way: the smallest real call there is,
// one chat completion capped at a single token against the model the router
// would actually use. A key the service does not know answers 403
// "Authorization failed" (also checked live), which is already Rejected below.
// It costs a rounding error of the free allowance, and it is the only one of
// the four checks that also catches a genuine key which simply has no access to
// the model in question — something no GET could ever see.
//
// ElevenLabs gets the same treatment for the mirror-image reason. The obvious
// candidate there, GET /v1/user, DOES authenticate — but against the wrong
// scope: ElevenLabs keys can be created with restricted permissions, and a key
// scoped to nothing but speech-to-text (a perfectly sensible choice for a
// device that does nothing else) answers 401 missing_permissions on /v1/user.
// Checked in the field 2026-08-03: a working key was refused and never saved.
// So an ElevenLabs key is verified at the door the voice path actually uses:
// POST /v1/speech-to-text carrying only model_id and no audio. A key the
// service does not know answers 401 invalid_api_key (checked live); a key it
// knows passes auth and then fails app-level validation on the missing audio,
// 400/422 — which for this one probe body means Valid, and is mapped so below.
// (An empty POST is no good: schema validation runs before auth there, so it
// 422s for garbage and genuine keys alike — the same auth-blind trap as
// NVIDIA's /v1/models, checked live the same day.) The probe spells the same
// scribe_v2 the voice path uploads with, so a key restricted to some other
// corner of ElevenLabs is honestly Rejected here too.
static constexpr uint32_t SECRET_VERIFY_TIMEOUT_MS = 8000;
// OpenRouter's GET answers with the key's own label and remaining credit, which
// is the "is this key real?" question and nothing else. 401 on a key the
// service does not know, per its API reference — and 402 on a real key whose
// account is in arrears, which lands in Inconclusive below rather than
// Rejected, deliberately: the paste was correct and the account is the problem,
// so refusing to store it would send someone back to re-copy a key that is
// fine. They will hear about the balance from the router's first real call.
// DeepSeek's /models is an ordinary authenticated list. Both are in the table.

KeyVerdict verifySecretKey(bool stt, const char* value) {
  // Which door to knock on, from the key itself — the same table the voice
  // router reads, so a key can never be verified against one service and then
  // spent at another. `provider` is a literal, never a slice of the key.
  const LlmProviderInfo& prov = llmProviderFor(value);
  const char* const provider = stt ? "elevenlabs" : prov.name;
  const char* const url = stt ? STT_URL : prov.verifyUrl;
  const bool byChat = !stt && prov.verifyByChat;
  const char* const label = stt ? "voice" : "smart-voice";

  // Checked first because it is free and because it is the common case for a
  // household setting up over the device's own AP with no working home WiFi
  // behind it: an 8 s timeout would be 8 s spent learning what WiFi.status()
  // already knows.
  if (WiFi.status() != WL_CONNECTED) {
    LOGF("[portal] %s key not verified: no network on this device\n", label);
    return KeyVerdict::Unreachable;
  }

  WiFiClientSecure client;
  client.setCACert(YAT_CA_BUNDLE);
  client.setTimeout(SECRET_VERIFY_TIMEOUT_MS / 1000);  // seconds

  HTTPClient http;
  if (!http.begin(client, url)) {
    LOGF("[portal] key check: http.begin failed\n");
    return KeyVerdict::Unreachable;
  }
  http.setFollowRedirects(HTTPC_DISABLE_FOLLOW_REDIRECTS);
  http.setConnectTimeout(SECRET_VERIFY_TIMEOUT_MS);
  http.setTimeout(SECRET_VERIFY_TIMEOUT_MS);
  http.setUserAgent("yat/0.4");
  if (stt)
    http.addHeader("xi-api-key", value);
  else
    http.addHeader("Authorization", String("Bearer ") + value);

  // The one-token completion described above, built the same way the router
  // builds its real request: through ArduinoJson, because the model id comes
  // from config.json when "llm_model" is set and this must not depend on
  // escaping someone's hand-typed string correctly by eye. "hi" is deliberately
  // the whole prompt — nothing about the household, the pages or the transcript
  // belongs in a key check.
  std::string probe;
  if (byChat) {
    JsonDocument req;
    req["model"] = !g_llmModel.empty() ? g_llmModel.c_str() : prov.model;
    req["max_tokens"] = 1;
    JsonArray msgs = req["messages"].to<JsonArray>();
    JsonObject usr = msgs.add<JsonObject>();
    usr["role"] = "user";
    usr["content"] = "hi";
    serializeJson(req, probe);
    http.addHeader("Content-Type", "application/json");
  }
  // The ElevenLabs probe documented above: the field is what lets auth run
  // (schema-valid body), the missing audio is what keeps a valid key from
  // costing anything.
  if (stt) {
    probe = "model_id=scribe_v2";
    http.addHeader("Content-Type", "application/x-www-form-urlencoded");
  }

  const uint32_t t0 = millis();
  const bool byPost = byChat || stt;
  const int code = byPost ? http.POST((uint8_t*)probe.data(), probe.size()) : http.GET();
  http.end();
  // The status and which service answered it, never the body and never any part
  // of the key — this line is written while a credential is in scope, and it is
  // the only thing here that reaches a log at all.
  LOGF("[portal] %s key check against %s: HTTP %d in %lu ms\n", label, provider, code,
       (unsigned long)(millis() - t0));
  // The TLS handshake is one of the two deep paths this firmware has, and this
  // one runs from a request handler rather than from the cycle that was
  // measured — worth a number.
  logStackHeadroom("key check");

  if (code >= 200 && code < 300) return KeyVerdict::Valid;
  // The fileless STT probe only: auth passed and validation then refused the
  // deliberately-missing audio, which is this probe's success shape.
  if (stt && (code == 400 || code == 422)) return KeyVerdict::Valid;
  if (code == 401 || code == 403) return KeyVerdict::Rejected;
  if (code < 0) return KeyVerdict::Unreachable;  // HTTPClient's own transport errors
  return KeyVerdict::Inconclusive;
}
