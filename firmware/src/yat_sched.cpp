// Generated by the main.cpp module split: the code below is a verbatim
// slice of the original single-translation-unit firmware/src/main.cpp.

#include "yat_sched.h"

#include <stdio.h>
#include <string.h>

#include <WiFi.h>
#include <driver/rtc_io.h>
#include <esp_sleep.h>
#include <esp_system.h>

#include "yat_beep.h"
#include "yat_buttons.h"
#include "yat_console.h"
#include "yat_errors.h"
#include "yat_hw.h"
#include "yat_ota.h"
#include "yat_state.h"

// ---------------- scheduler (ARCHITECTURE §3, PACK-SPEC §10) ----------------
//
// Effective cadence = the minimum every_min among the pack's schedule.windows
// whose day-of-week and [from, to) interval contain the current local time;
// default.every_min if none match. The active page's own every_min
// (config.json) beats all of that when set — the pack's schedule is the
// author's default, the page's is the user's explicit choice. Device-level
// quiet_hours (config.json) always overrides whichever cadence won: inside
// quiet hours, sleep straight through to the end; if the cadence would
// otherwise wake the device *during* quiet hours, extend through to the end
// instead of taking that wake.

static const char* const kWeekdayAbbrev[7] = {"sun", "mon", "tue", "wed", "thu", "fri", "sat"};

// "HH:MM" -> minutes since midnight, or -1 if not parseable/out of range.
static int parseHHMM(const char* s) {
  if (!s || !s[0]) return -1;
  int hh = -1, mm = -1;
  if (sscanf(s, "%d:%d", &hh, &mm) != 2) return -1;
  if (hh < 0 || hh > 23 || mm < 0 || mm > 59) return -1;
  return hh * 60 + mm;
}

// Epoch of local HH:MM (as minutesOfDay) on the same calendar day as `base`.
// Hong Kong has no DST, so plain epoch arithmetic (+86400 for "next day") is
// safe here — it would not be across a DST boundary.
static time_t todayAt(time_t base, const struct tm& baseLt, int minutesOfDay) {
  time_t midnight = base - (baseLt.tm_hour * 3600 + baseLt.tm_min * 60 + baseLt.tm_sec);
  return midnight + (time_t)minutesOfDay * 60;
}

// [start, end) possibly wrapping midnight (start > end, e.g. quiet hours
// 23:30 -> 06:30). start == end is treated as "never inside" (disabled/malformed).
static bool insideRange(int minutesOfDay, int start, int end) {
  if (start == end) return false;
  return (start < end) ? (minutesOfDay >= start && minutesOfDay < end)
                        : (minutesOfDay >= start || minutesOfDay < end);
}

QuietFit applyQuietHours(const std::string& quietStart, const std::string& quietEnd,
                                time_t nowSched, uint64_t proposedSecs, uint64_t& outSecs,
                                std::string& what) {
  if (quietStart.empty() || quietEnd.empty()) return QuietFit::NotApplicable;
  const int qStart = parseHHMM(quietStart.c_str());
  const int qEnd = parseHHMM(quietEnd.c_str());
  if (qStart < 0 || qEnd < 0) return QuietFit::NotApplicable;

  struct tm lt;
  localtime_r(&nowSched, &lt);
  const int nowMin = lt.tm_hour * 60 + lt.tm_min;
  char buf[224];

  if (insideRange(nowMin, qStart, qEnd)) {
    time_t endEpoch = todayAt(nowSched, lt, qEnd);
    if (endEpoch <= nowSched) endEpoch += 86400;
    outSecs = (uint64_t)(endEpoch - nowSched);
    snprintf(buf, sizeof buf, "quiet hours %s-%s active, sleeping straight through to %s (%llu s)",
             quietStart.c_str(), quietEnd.c_str(), quietEnd.c_str(), (unsigned long long)outSecs);
    what = buf;
    return QuietFit::InsideNow;
  }

  time_t candidate = nowSched + (time_t)proposedSecs;
  struct tm ct;
  localtime_r(&candidate, &ct);
  const int candMin = ct.tm_hour * 60 + ct.tm_min;
  if (!insideRange(candMin, qStart, qEnd)) return QuietFit::NotApplicable;
  time_t endEpoch = todayAt(candidate, ct, qEnd);
  if (endEpoch <= candidate) endEpoch += 86400;
  outSecs = (uint64_t)(endEpoch - nowSched);
  snprintf(buf, sizeof buf,
           "would wake inside quiet hours %s-%s — extending through to %s (%llu s)",
           quietStart.c_str(), quietEnd.c_str(), quietEnd.c_str(), (unsigned long long)outSecs);
  what = buf;
  return QuietFit::WouldLandInside;
}

// The page whose cadence this cycle's sleep is being planned against — the
// one on the panel. Reads the same g_activePageIdx mirror the render path and
// YAT USE keep in sync with NVS; every computeSleepPlan() caller runs after
// setup() (or portalRenderContent()) has set it for this cycle. nullptr only
// if the two ever disagree about how many pages there are.
static const ConfigPage* activePage(const DeviceConfig& cfg) {
  if (g_activePageIdx < 0 || (size_t)g_activePageIdx >= cfg.pages.size()) return nullptr;
  return &cfg.pages[g_activePageIdx];
}

// Auto-rotate's claim on the sleep plan: minutes until the page on the panel has
// had the interval the household asked for, or 0 when nothing is rotating.
//
// It only ever pulls the next wake EARLIER — a page that refreshes every 5
// minutes keeps refreshing every 5 minutes underneath a 30-minute rotation, and
// a page that refreshes once a day is interrupted by it. Without this cap the
// two would fight: the advance can only happen at a wake, so a page whose
// cadence is longer than the rotation would simply never rotate on time.
static int loopWakeCapMinutes(const DeviceConfig& cfg, time_t nowSched) {
  if (cfg.loopMin <= 0 || cfg.pages.size() < 2) return 0;
  // Rotation is suspended under a warning takeover (see maybeAdvanceLoopPage),
  // and a suspended rotation has no business shortening anything — least of all
  // during a typhoon, where clampForTakeover is already waking the device often.
  if (g_takeoverActive) return 0;
  if (g_loopOriginEpoch <= 0) return cfg.loopMin;  // interval starts this cycle
  const time_t due = g_loopOriginEpoch + (time_t)cfg.loopMin * 60;
  // Already due and the page is still here: something suppressed the advance
  // (quiet hours, most likely, which owns the sleep length anyway). Asking for
  // a wake "now" would spend a cycle to be refused again.
  if (due <= nowSched) return 0;
  // Rounded UP, so the wake lands on or past the boundary rather than seconds
  // short of it — a wake that arrives early does not advance, and would cost a
  // second one to do the work.
  long mins = (long)((due - nowSched) + 59) / 60;
  if (mins > cfg.loopMin) mins = cfg.loopMin;  // a clock that moved under us
  return (int)mins;
}

SleepPlan computeSleepPlan(JsonVariantConst schedule, const DeviceConfig& cfg,
                                   time_t nowSched, bool haveTime) {
  int defaultEvery = schedule["default"]["every_min"] | (int)SCHEDULE_MIN;
  if (defaultEvery < 5) defaultEvery = 5;  // platform cadence floor, PACK-SPEC §12.1

  const ConfigPage* page = activePage(cfg);
  int pageEvery = page ? page->everyMin : 0;  // 0 => no override, follow the pack

  if (!haveTime) {
    // No synced clock: window/quiet-hours math needs real local time, so fall
    // back to a flat cadence rather than guess. A page override is still a
    // flat cadence, so it survives this branch; the pack's default is the
    // fallback when there isn't one.
    int every = pageEvery > 0 ? pageEvery : defaultEvery;
    char buf[96];
    snprintf(buf, sizeof buf, "no clock sync — %s cadence %d min",
             pageEvery > 0 ? "page override" : "default", every);
    return {(uint64_t)every * 60ULL, buf};
  }

  struct tm lt;
  localtime_r(&nowSched, &lt);
  int nowMin = lt.tm_hour * 60 + lt.tm_min;
  const char* wd = kWeekdayAbbrev[lt.tm_wday];

  int cadence = defaultEvery;
  int activeIdx = -1;
  JsonArrayConst windows = schedule["windows"].as<JsonArrayConst>();
  if (!windows.isNull()) {
    int idx = 0;
    for (JsonVariantConst w : windows) {
      int fromMin = parseHHMM(w["from"] | "");
      int toMin = parseHHMM(w["to"] | "");
      bool dayMatch = false;
      for (JsonVariantConst d : w["days"].as<JsonArrayConst>()) {
        if (strcmp(d | "", wd) == 0) {
          dayMatch = true;
          break;
        }
      }
      if (dayMatch && fromMin >= 0 && toMin >= 0 && fromMin < toMin &&
          nowMin >= fromMin && nowMin < toMin) {
        int every = w["every_min"] | defaultEvery;
        if (every < 5) every = 5;
        if (every < cadence) {
          cadence = every;
          activeIdx = idx;
        }
      }
      idx++;
    }
  }

  std::string cadenceDesc;
  if (pageEvery > 0) {
    // Applied after the window scan, not instead of it, so the log line can
    // say what the pack would have done — the override is otherwise silent
    // and this is the only place it's visible.
    char buf[192];
    snprintf(buf, sizeof buf, "page \"%s\" every_min override, cadence %d min (pack asked for %d)",
             page->id.c_str(), pageEvery, cadence);
    cadence = pageEvery;
    cadenceDesc = buf;
  } else if (activeIdx >= 0) {
    JsonVariantConst w = windows[activeIdx];
    std::string days;
    for (JsonVariantConst d : w["days"].as<JsonArrayConst>()) {
      if (!days.empty()) days += ",";
      days += (const char*)(d | "");
    }
    char buf[192];
    snprintf(buf, sizeof buf, "window %s %s-%s active, cadence %d min", days.c_str(),
             (const char*)(w["from"] | ""), (const char*)(w["to"] | ""), cadence);
    cadenceDesc = buf;
  } else {
    char buf[64];
    snprintf(buf, sizeof buf, "default cadence %d min", cadence);
    cadenceDesc = buf;
  }

  // Auto-rotate on top of whichever cadence won: the device has to be awake by
  // the time this page's turn is up, or it would sit there past the interval
  // the household chose. Applied after the window/override scan rather than
  // instead of it, for the same reason the page override is — this is the only
  // line that shows a sleep being cut short, and it should say what it cut.
  {
    const int cap = loopWakeCapMinutes(cfg, nowSched);
    if (cap > 0 && cap < cadence) {
      cadenceDesc += ", auto-rotate wants the next page in " + std::to_string(cap) + " min";
      cadence = cap;
    }
  }

  // Quiet hours override whichever cadence won above: inside them, sleep
  // through; about to wake inside them, extend through instead.
  {
    uint64_t quietSecs = 0;
    std::string what;
    switch (applyQuietHours(cfg.quietStart, cfg.quietEnd, nowSched, (uint64_t)cadence * 60ULL,
                            quietSecs, what)) {
      case QuietFit::InsideNow:
        return {quietSecs, what};
      case QuietFit::WouldLandInside:
        return {quietSecs, cadenceDesc + " " + what};
      case QuietFit::NotApplicable:
        break;
    }
  }

  // 320, not the 224 this started at: the auto-rotate clause above appends to a
  // description that could already be a full window or override line.
  char buf[320];
  snprintf(buf, sizeof buf, "%s, sleeping %d s", cadenceDesc.c_str(), cadence * 60);
  return {(uint64_t)cadence * 60ULL, buf};
}

// Auto-rotate's one move: on a timer wake whose interval is up, step to the next
// page. Called from setup() before the pack-load ladder, so the page this cycle
// loads, fetches, renders and then schedules against is the new one — the
// rotation costs no extra wake and no second refresh.
//
// Only a TIMER wake rotates:
//   - a button wake is a person choosing a page, and savePageIdx() restarts the
//     interval from that choice, so what they picked gets a full turn;
//   - a cold boot shows the page the device went to sleep on, which is what
//     somebody watching it come back expects to see.
//
// Two things suspend it rather than skip a turn. Quiet hours: a household that
// asked for no updates overnight has not asked for a silent rotation either, and
// the panel holds its last image at zero power, so there is nothing to gain by
// moving it at 3 a.m. A warning takeover: the playlist is preempted for as long
// as the signal stands, and rotating a page nobody can see would land the
// household on an arbitrary one the moment the warning clears. Both resume at
// the first wake past them, which finds the interval long overdue and advances
// immediately.
void maybeAdvanceLoopPage(const DeviceConfig& cfg, time_t nowSched, bool haveTime) {
  if (cfg.loopMin <= 0) return;
  if (g_pages.size() < 2) {
    LOGF("[loop] auto-rotate is on (every %d min) but there is only %u page — nothing to rotate "
         "to\n",
         cfg.loopMin, (unsigned)g_pages.size());
    return;
  }
  if (esp_sleep_get_wakeup_cause() != ESP_SLEEP_WAKEUP_TIMER) return;
  if (!haveTime || nowSched <= CLOCK_SANE_EPOCH) {
    // The interval is wall-clock, and guessing at it would either rotate on
    // every wake or never. A cycle without a clock has bigger problems anyway.
    LOGF("[loop] no clock this cycle — leaving the page where it is\n");
    return;
  }
  if (g_takeoverActive) {
    LOGF("[loop] warning takeover holds the panel — rotation suspended until it clears\n");
    return;
  }
  const int qStart = parseHHMM(cfg.quietStart.c_str());
  const int qEnd = parseHHMM(cfg.quietEnd.c_str());
  if (qStart >= 0 && qEnd >= 0) {
    struct tm lt;
    localtime_r(&nowSched, &lt);
    if (insideRange(lt.tm_hour * 60 + lt.tm_min, qStart, qEnd)) {
      LOGF("[loop] quiet hours %s-%s — not rotating overnight\n", cfg.quietStart.c_str(),
           cfg.quietEnd.c_str());
      return;
    }
  }
  // No origin on record (first wake after the setting went on, or the page last
  // changed while the clock was unset), or one in the future because the clock
  // moved under us. Either way this cycle is where the interval starts.
  if (g_loopOriginEpoch <= 0 || g_loopOriginEpoch > nowSched) {
    saveLoopOrigin(nowSched);
    LOGF("[loop] rotation clock started — next page in %d min\n", cfg.loopMin);
    return;
  }
  const time_t due = g_loopOriginEpoch + (time_t)cfg.loopMin * 60;
  if (nowSched < due) {
    // A cadence tick, not a rotation tick: the page's own pack asked to refresh
    // more often than the household asked to rotate, which is allowed.
    LOGF("[loop] %ld min still to run on page %d (\"%s\")\n", (long)((due - nowSched + 59) / 60),
         g_activePageIdx, g_pages[g_activePageIdx].id.c_str());
    return;
  }
  g_activePageIdx = (g_activePageIdx + 1) % (int)g_pages.size();
  savePageIdx(g_activePageIdx);  // persists the index AND restamps the origin
  g_loopAdvanced = true;         // hash-skip must not swallow a page change
  LOGF("[loop] every %d min — advancing to page %d (\"%s\")\n", cfg.loopMin, g_activePageIdx,
       g_pages[g_activePageIdx].id.c_str());
}

// ---------------- sleep ----------------

// Defined with the rest of the device's audible vocabulary, below — this file's
// one place for what each cue means — which is after this point in source
// order, hence the forward declaration.
void beepNewError();

// NVS "err_ackd" mirrors g_errTotal as of the last cycle that actually sounded
// the new-error beep. Called from the one spot every sleep path funnels
// through (lowLevelSleep) so however many faults recordError() saw this wake —
// one or several — get exactly one beep, not one per call.
//
// If g_errTotal has grown since err_ackd, something genuinely new happened.
// Whether that turns into a sound depends on two separate silences:
//   - g_beepEnabled off: the household asked for a quiet device. err_ackd is
//     left where it is, not advanced to g_errTotal, so this is a skip, not an
//     ack — the moment beeps are turned back on, the backlog still announces.
//   - quiet hours right now (same applyQuietHours() helper deepSleepError
//     already consults for the retry itself): same treatment, same reason —
//     delayed to the next cycle that isn't inside the window, never dropped.
// Only when neither silence applies does the beep fire and err_ackd advance,
// so a fault that broke and then got fixed before either silence lifted still
// gets its one beep once it does.
static void maybeBeepNewError() {
  Preferences prefs;
  if (!prefs.begin("yat", false)) return;
  const uint32_t acked = prefs.getUInt("err_ackd", 0);
  if (g_errTotal <= acked) {
    prefs.end();
    return;
  }
  bool quiet = false;
  const time_t now = time(nullptr);
  if (now > CLOCK_SANE_EPOCH) {
    uint64_t outSecs = 0;
    std::string what;
    quiet = applyQuietHours(g_quietStart, g_quietEnd, now, 0, outSecs, what) == QuietFit::InsideNow;
  }
  if (g_beepEnabled && !quiet) {
    beepNewError();
    prefs.putUInt("err_ackd", g_errTotal);
  }
  prefs.end();
}

// [[noreturn]] is deliberate: setup() calls this from failure branches and then
// falls through in source order, so the compiler must know control stops here.
// Shared tail for every sleep path: persists the epoch fallback, sounds the
// new-error beep if one is owed, opens the console window, arms all three
// buttons as ext1 wake sources, and powers down. `sleepUs` is the target
// *before* the console window; time spent in the window is subtracted from it
// so a "sleeping 600 s" log line still means ~600 s of actual deep sleep,
// console window included.
[[noreturn]] void lowLevelSleep(uint64_t sleepUs, const char* why) {
  // Getting this far IS the evidence a freshly-installed image works, and this
  // is the only funnel every cycle exits through — so it is where the app tells
  // the bootloader to stop holding the previous firmware in reserve. A cycle
  // that panics, hangs or browns out before here never reaches this line, and
  // the next reset rolls the device back. See otaMarkAppValidIfPending() for
  // why end-of-cycle rather than boot, and for what it deliberately does not
  // count as a failure.
  otaMarkAppValidIfPending();

  if (time(nullptr) > CLOCK_SANE_EPOCH) {
    Preferences prefs;
    prefs.begin("yat", false);
    prefs.putULong64("epoch", (uint64_t)time(nullptr));
    prefs.end();
  }

  // End of cycle, before anything else here: one check covers every error
  // recordError() saw this wake, from whichever branch of setup() got us to
  // this sleep call.
  maybeBeepNewError();

  LOGF("[sleep] %s — target %llu s\n", why, (unsigned long long)(sleepUs / 1000000ULL));
  uint32_t cwStart = millis();
  // A page button pressed too late in this cycle has already queued a
  // re-render (below): the usual 10 s wait for a first console byte would sit
  // squarely between the user's press and the page they asked for, so spend a
  // second on it instead. Any byte that does arrive still opens a full session.
  consoleWindow(g_keyRerenderPending ? 1000 : CONSOLE_WINDOW_MS);
  // A YAT PORTAL in that window overrides the sleep entirely — the panel is
  // still awake here (epaper.sleep() is below), so the portal gets a live
  // panel to draw its screen on without a second init.
  maybeRunRequestedPortal();
  // Last checkpoint of the cycle: a press made during the refresh that just
  // finished, or during the console window above, still gets acted on before
  // the lights go out.
  processKeyLatches("pre-sleep", /*lastChance=*/true);
  uint64_t cwSpentUs = (uint64_t)(millis() - cwStart) * 1000ULL;
  uint64_t finalUs = sleepUs > cwSpentUs ? sleepUs - cwSpentUs : 0;
  if (finalUs < 1000000ULL) finalUs = 1000000ULL;  // never schedule ~zero

  // A press landed after this cycle had already committed to a pack, so the
  // page it selected cannot be drawn by a cycle that is over. Rather than
  // restructure the cycle — or leave the press to show up at the next
  // scheduled wake, an hour later — go round again immediately. The stored
  // data hash is cleared first because the next cycle wakes on the timer, with
  // no g_buttonWake to bypass the hash-skip, and two pages can legitimately
  // share their data sources: dataHash() sees the data, never the layout.
  if (g_keyRerenderPending) {
    Preferences prefs;
    prefs.begin("yat", false);
    prefs.putUInt("hash", 0);
    prefs.end();
    finalUs = 1000000ULL;
    LOGF("[keys] page changed after this cycle rendered — waking straight back up for it\n");
  }

  LOGF("[sleep] sleeping %llu s (KEY0/KEY1/KEY2 wake early)\n",
       (unsigned long long)(finalUs / 1000000ULL));

  if (g_panelReady) epaper.sleep();
  WiFi.disconnect(true);
  WiFi.mode(WIFI_OFF);
  digitalWrite(PIN_LED, HIGH);
  digitalWrite(PIN_BAT_EN, LOW);

  esp_sleep_enable_timer_wakeup(finalUs);

  // The awake-press interrupts come off before the RTC mux takes these pads
  // over: from here to the next wake, ext1 is the only thing that may own them.
  disarmButtonInterrupts();

  // All three buttons are active-low with external pull-ups; hold the RTC
  // pull-up through sleep so none of them float. On S3, ESP_EXT1_WAKEUP_ALL_LOW
  // is only a deprecated alias of ANY_LOW, so ANY_LOW is the correct (and
  // only) spelling.
  const gpio_num_t buttonPins[3] = {(gpio_num_t)PIN_KEY0, (gpio_num_t)PIN_KEY1,
                                     (gpio_num_t)PIN_KEY2};
  uint64_t mask = 0;
  for (gpio_num_t pin : buttonPins) {
    rtc_gpio_init(pin);
    rtc_gpio_set_direction(pin, RTC_GPIO_MODE_INPUT_ONLY);
    rtc_gpio_pullup_en(pin);
    rtc_gpio_pulldown_dis(pin);
    mask |= (1ULL << pin);
  }
  // S3: internal RTC pullups only hold through deep sleep if the RTC
  // peripheral domain stays powered — without this the pins float and the
  // buttons never wake the chip. Costs a few uA of sleep floor; revisit if
  // the board turns out to have external pullups (measure in v0.1 exit).
  esp_sleep_pd_config(ESP_PD_DOMAIN_RTC_PERIPH, ESP_PD_OPTION_ON);
  esp_sleep_enable_ext1_wakeup_io(mask, ESP_EXT1_WAKEUP_ANY_LOW);

  Serial.flush();
  Serial1.flush();
  esp_deep_sleep_start();
}

// Retry/failure backoff: a fixed number of minutes from cycle start (not
// wall-clock scheduled — these are error paths, not due-page wakes).
[[noreturn]] void deepSleepMinutes(uint32_t minutes, const char* why) {
  uint32_t spentMs = millis();
  uint64_t periodUs = (uint64_t)minutes * 60ULL * 1000000ULL;
  uint64_t spentUs = (uint64_t)spentMs * 1000ULL;
  uint64_t sleepUs = periodUs > spentUs ? periodUs - spentUs : periodUs;
  g_plannedSleepSeconds = sleepUs / 1000000ULL;
  lowLevelSleep(sleepUs, why);
}

// Normal path: sleepSeconds already computed from real wall-clock time by
// computeSleepPlan(), so no elapsed-cycle-time subtraction is needed here.
[[noreturn]] void deepSleepScheduled(uint64_t sleepSeconds, const char* why) {
  if (sleepSeconds < 1) sleepSeconds = 1;
  g_plannedSleepSeconds = sleepSeconds;
  lowLevelSleep(sleepSeconds * 1000000ULL, why);
}

// Whether a warning takeover should be assumed to own this cycle, for the two
// callers that have to decide before setup() has fetched warnsum: the failure
// ladder below (a cycle that failed may well have failed at that very fetch)
// and the voice capture (which runs before the fetch by design, so a matched
// page is what this cycle's single refresh draws). The persisted state from the
// last wake plus the YAT TAKEOVER simulation flag is the best answer available
// and is almost always the right one — a typhoon signal does not come and go
// between two wakes minutes apart.
bool takeoverLikelyThisCycle() {
  Preferences prefs;
  prefs.begin("yat", true);
  bool active = prefs.getUChar("takeover", 0) != 0 || prefs.getUChar("takeover_sim", 0) != 0;
  prefs.end();
  return active;
}

// Where every failure path in the cycle ends, instead of deepSleepMinutes().
// The two disciplines it adds are ones the success path has always had and the
// error paths never did — which is exactly where they matter most. A source
// that stays broken (a dead feed, a router that never comes back, a pack that
// cannot render) used to retry every RETRY_MIN forever, straight through the
// household's quiet hours: 288 wakes a day spent to put nothing new on the
// panel, and a battery that collapses in a week with nothing on screen to
// explain why.
//
//   - consecutive failed cycles (NVS "err_n") escalate the retry 5 -> 15 -> 60
//     min, so a permanent failure costs 24 wakes a day rather than 288;
//   - the retry then honors quiet hours exactly as computeSleepPlan() does,
//     whenever the clock is good enough to say what time it is.
//
// Neither delays a person: all three buttons stay armed as ext1 wake sources
// through any sleep, so a press still gets a fresh cycle immediately.
[[noreturn]] void deepSleepError(const char* why) {
  uint32_t n = 0;
  {
    Preferences prefs;
    prefs.begin("yat", false);
    n = prefs.getUInt("err_n", 0) + 1;
    prefs.putUInt("err_n", n);
    prefs.end();
  }
  uint32_t minutes = n <= 1 ? RETRY_MIN : (n == 2 ? RETRY_MID_MIN : RETRY_MAX_MIN);

  // A warning takeover overrides both halves of this, exactly as it overrides
  // the schedule and quiet hours on the success path (clampForTakeover): an
  // hour is far too long to leave a typhoon signal unchecked, and the cycle
  // that just failed may have failed at the warnsum fetch itself.
  const bool takeover = g_takeoverActive || takeoverLikelyThisCycle();
  if (takeover && (uint64_t)minutes * 60ULL > TAKEOVER_MAX_SLEEP_S)
    minutes = (uint32_t)(TAKEOVER_MAX_SLEEP_S / 60);

  char buf[320];
  const time_t now = time(nullptr);
  uint64_t quietSecs = 0;
  std::string what;
  if (!takeover && now > CLOCK_SANE_EPOCH &&
      applyQuietHours(g_quietStart, g_quietEnd, now, (uint64_t)minutes * 60ULL, quietSecs, what) !=
          QuietFit::NotApplicable) {
    snprintf(buf, sizeof buf, "%s (failure %u in a row, retry %u min) — %s", why, (unsigned)n,
             (unsigned)minutes, what.c_str());
    g_plannedSleepSeconds = quietSecs;
    lowLevelSleep(quietSecs * 1000000ULL, buf);
  }
  snprintf(buf, sizeof buf, "%s (failure %u in a row, retry %u min%s)", why, (unsigned)n,
           (unsigned)minutes, takeover ? ", clamped by warning takeover" : "");
  deepSleepMinutes(minutes, buf);
}

// Cleared only where a cycle genuinely finished — content on the panel, or a
// hash-skip that decided the panel is already right — never merely because the
// cycle got past the fetch: a pack that extracts and then fails to render is
// precisely the permanent failure the ladder above exists for. Takes the
// caller's open handle instead of opening a second one, and writes only when
// there is something to clear (the common case is a device that never failed).
void clearErrorStreak(Preferences& prefs) {
  uint32_t n = prefs.getUInt("err_n", 0);
  if (n == 0) return;
  prefs.putUInt("err_n", 0);
  LOGF("[retry] cycle completed — clearing the %u-cycle failure streak\n", (unsigned)n);
}

// audit #18 — see PANIC_SAFE_MODE_N. Called once at the very top of setup(),
// ahead of everything that could itself fault: the count has to survive the
// exact fault it is counting, which is why it lives in NVS rather than in RTC
// memory. A crash loop ends in a flat battery and a brownout sooner or later,
// and that would take an RTC counter with it — precisely when the breaker is
// most needed. Panics are rare, so the write costs nothing in flash wear.
void noteResetReason() {
  const esp_reset_reason_t rr = esp_reset_reason();
  const bool crashed = rr == ESP_RST_PANIC || rr == ESP_RST_TASK_WDT ||
                       rr == ESP_RST_INT_WDT || rr == ESP_RST_WDT;
  Preferences prefs;
  prefs.begin("yat", false);
  g_panicStreak = prefs.getUInt("panic_n", 0);
  if (crashed) {
    g_panicStreak++;
    prefs.putUInt("panic_n", g_panicStreak);
    LOGF("[crash] reset reason %d is a firmware fault — %u in a row\n", (int)rr,
         (unsigned)g_panicStreak);
  } else if (g_panicStreak) {
    LOGF("[crash] %u crash reset(s) still on record (this boot: reason %d)\n",
         (unsigned)g_panicStreak, (int)rr);
  }
  prefs.end();
}

// Cleared in exactly two places: a cycle that put content on the panel (the
// fault, whatever it was, did not happen this time) and the green button (the
// household is standing there doing what the safe-mode card asked). Takes the
// caller's open handle where there is one, like clearErrorStreak above.
void clearPanicStreak(Preferences& prefs, const char* why) {
  uint32_t n = prefs.getUInt("panic_n", 0);
  if (n == 0) return;
  prefs.putUInt("panic_n", 0);
  g_panicStreak = 0;
  LOGF("[crash] %s — clearing the %u-crash streak\n", why, (unsigned)n);
}

void clearPanicStreak(const char* why) {
  Preferences prefs;
  prefs.begin("yat", false);
  clearPanicStreak(prefs, why);
  prefs.end();
}

// The render result behind YAT STATUS / GET /api/status's "render_ok" and
// "rendered_page" (see g_renderOk). Written the moment the outcome is known —
// after epaper.update() returns for a success, at the point of failure
// otherwise — so a device interrupted anywhere still reports the last thing the
// panel was actually given, not the last thing a cycle hoped to give it.
void noteRenderResult(bool ok, const std::string& pageId) {
  g_renderOk = ok;
  g_renderedPage = pageId;
  Preferences prefs;
  prefs.begin("yat", false);
  prefs.putUChar("render_ok", ok ? 1 : 0);
  prefs.putString("render_page", pageId.c_str());
  prefs.end();
  LOGF("[render] result: %s, page \"%s\"\n", ok ? "ok" : "FAILED", pageId.c_str());
  // The single choke point for "that page would not draw", so it is also the
  // single place the error ring needs to hear about it — every render this
  // firmware performs reports its outcome through here.
  if (!ok) recordError(ERR_RENDER, pageId.c_str());
}

void restoreRenderResultFromNvs() {
  Preferences prefs;
  prefs.begin("yat", true);
  g_renderOk = prefs.getUChar("render_ok", 0) != 0;
  g_renderedPage = prefs.getString("render_page", "").c_str();
  prefs.end();
}

// The one way this firmware drives the panel. Every screen it can ever show —
// a rendered page, any of the six firmware cards, both setup screens — goes
// through here, and that is what keeps "render_ok"/"rendered_page" honest:
// the record is written by the same call that moves the ink, so a screen added
// later cannot quietly leave the old claim standing. `pageId` is the configured
// page whose pack produced this image, or "" for the firmware's own screens,
// which are a real render and really are not one of the household's pages.
//
// The wait is the panel's own full-refresh time (it drives no partial mode),
// not anything this function chooses; it blocks the whole task, which is why
// the button latches and the console exist. PANEL_REFRESH_S is this model's
// budget for it — see yat_common.h, where the E1001's value is still the
// E1002's placeholder. The "%lu ms" line below is the measurement that
// settles it: it is the real duration of every refresh this device has ever
// done, on whichever panel it has.
void panelRefresh(const std::string& pageId) {
  LOGF("[epd] refresh (up to ~%lu s, blocking)...\n", (unsigned long)PANEL_REFRESH_S);
  uint32_t tu = millis();
  epaper.update();
  LOGF("[epd] refresh %lu ms\n", (unsigned long)(millis() - tu));
  noteRenderResult(true, pageId);
}

// Catching "both arrows at once" at a wake is a race against our own boot.
// ext1 is a level trigger: it fires on whichever of the two contacts closes
// first, and the status word latches only the pin that did it. Two buttons
// pressed by a hand are tens of milliseconds apart, so that word reports a
// plain page-step far more often than it reports the gesture the user made.
//
// The pads themselves keep telling the truth for as long as the finger is
// down, so they get read here — called from the very top of setup(), ahead of
// the up-to-2 s wait for a USB CDC host, which is longer than most presses
// last. Between this, the status word, armButtonInterrupts()'s held-at-arm
// sample and processKeyLatches()'s awake window, every plausible timing of the
// gesture lands on the same outcome.
static bool g_arrowsDownAtWake = false;

void sampleArrowsAtWake() {
  if (esp_sleep_get_wakeup_cause() != ESP_SLEEP_WAKEUP_EXT1) return;
  uint64_t status = esp_sleep_get_ext1_wakeup_status();
  if (!(status & ((1ULL << PIN_KEY1) | (1ULL << PIN_KEY2)))) return;  // no arrow woke us
  // Hand both pads back from the RTC IO mux before reading them: a pin still
  // routed there reads as a constant low (the same trap readKey0GestureAtWake()
  // documents), which would turn every single page-step into a help request.
  rtc_gpio_deinit((gpio_num_t)PIN_KEY1);
  rtc_gpio_deinit((gpio_num_t)PIN_KEY2);
  pinMode(PIN_KEY1, INPUT_PULLUP);
  pinMode(PIN_KEY2, INPUT_PULLUP);
  delay(2);  // let the pull-ups settle after the mux switch
  g_arrowsDownAtWake = digitalRead(PIN_KEY1) == LOW && digitalRead(PIN_KEY2) == LOW;
}

void reportWakeReason() {
  esp_sleep_wakeup_cause_t cause = esp_sleep_get_wakeup_cause();
  switch (cause) {
    case ESP_SLEEP_WAKEUP_TIMER:
      LOGF("[boot] wake: timer (scheduled slot)\n");
      break;
    case ESP_SLEEP_WAKEUP_EXT1: {
      uint64_t status = esp_sleep_get_ext1_wakeup_status();
      bool k0 = status & (1ULL << PIN_KEY0);
      bool k1 = status & (1ULL << PIN_KEY1);
      bool k2 = status & (1ULL << PIN_KEY2);
      LOGF("[boot] wake: ext1 mask 0x%08llx%s%s%s\n", (unsigned long long)status,
           k0 ? " (KEY0 voice/provision)" : "", k1 ? " (KEY1 page-forward)" : "",
           k2 ? " (KEY2 page-back)" : "");
      // PRD §4.3: KEY1/KEY2 step the active page index — applied once config is
      // loaded and the page count is known, see setup(). KEY0's two gestures are
      // told apart separately (readKey0GestureAtWake(): tap -> voice capture,
      // 5 s hold -> provisioning); all three buttons continue to force a render
      // regardless, via g_buttonWake (v0.2 behavior, unchanged).
      //
      // Both arrows together is a different gesture entirely — help, not two
      // page-steps — and it must not leave a page-step intent behind, or the
      // user would come back from the help card to a page they never asked
      // for. Either the status word caught both (a near-perfect press), or
      // sampleArrowsAtWake() found both pads still down (every other press).
      if ((k1 && k2) || (g_arrowsDownAtWake && (k1 || k2))) {
        g_helpRequested = true;
        LOGF("[boot] both arrows at wake — help card, page unchanged\n");
      } else {
        g_pageForward = k1;
        g_pageBack = k2;
      }
      g_buttonWake = k0 || k1 || k2;
      break;
    }
    case ESP_SLEEP_WAKEUP_UNDEFINED:
      LOGF("[boot] wake: power-on / reset\n");
      g_coldBootWake = true;
      break;
    default:
      LOGF("[boot] wake: cause %d\n", (int)cause);
      break;
  }
}
