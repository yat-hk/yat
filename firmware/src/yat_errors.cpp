// Generated by the main.cpp module split: the code below is a verbatim
// slice of the original single-translation-unit firmware/src/main.cpp.

#include "yat_errors.h"

#include <string.h>

#include <Preferences.h>

#include "yat_common.h"

static ErrRing g_errs = {ERR_RING_VERSION, 0, 0, 0, {}};

// Monotonically growing, unlike g_errs.count (which caps at ERR_RING_N and
// wraps): the one question the end-of-cycle error beep (see maybeBeepNewError)
// needs answered is "did a genuinely new fault land since I last announced
// one", and a ring that overwrites its oldest slot cannot answer that once
// more than eight faults have ever been recorded. Persisted in NVS "err_total"
// next to "err_ackd" (the beep's own high-water mark) and "err_n" (the retry
// backoff's separate failure-streak counter) — three related but distinct
// numbers, kept apart on purpose.
uint32_t g_errTotal = 0;

// Copies at most cap-1 bytes and then backs off any trailing UTF-8 continuation
// byte, so a clipped 「天氣」 loses a whole character rather than half of one.
//
// Zero-fills first, and not merely for tidiness: these buffers are memcpy'd
// whole into the ring and the ring is written whole to flash, so anything left
// past the terminator would be persisted. The tail of an uninitialized stack
// buffer is exactly the kind of thing that must never reach storage on a device
// whose request handlers hold API keys on that same stack.
void errCopyField(char* dst, size_t cap, const char* src) {
  memset(dst, 0, cap);
  if (!src || !*src) return;
  size_t n = strnlen(src, cap - 1);
  while (n > 0 && ((unsigned char)src[n] & 0xC0) == 0x80) n--;
  memcpy(dst, src, n);
  dst[n] = 0;
}

void recordError(const char* code, const char* context, int httpStatus) {
  if (!code) return;
  const time_t now = time(nullptr);
  const uint32_t t = now > CLOCK_SANE_EPOCH ? (uint32_t)now : 0;

  // The one place a recorded fault becomes a standing condition (yat_errors.h).
  // Done here rather than at the call sites so the rule lives in one readable
  // place and a new call site cannot forget it: every path that already knew
  // to record a failure now also raises the right banner, or none.
  if (strcmp(code, ERR_FS_WRITE) == 0) {
    conditionSet(COND_STORAGE);
  } else if ((strcmp(code, ERR_STT_HTTP) == 0 || strcmp(code, ERR_LLM_HTTP) == 0) &&
             (httpStatus == 401 || httpStatus == 403)) {
    conditionSet(COND_VOICE_KEY);
  }

  char ctx[ERR_PAGE_BYTES];
  errCopyField(ctx, sizeof ctx, context);

  // Distinguishes "a fault that was already the newest thing on record fired
  // again" from "a fault landed that is not simply this cycle's timestamp on
  // the same row" — only the latter advances g_errTotal, which is exactly the
  // transition the end-of-cycle beep (maybeBeepNewError) is allowed to sound
  // for. Without this split, a source stuck down for days would re-buzz every
  // wake it stays broken instead of once when it broke.
  bool newEntry = false;
  ErrEntry* last =
      g_errs.count ? &g_errs.e[(g_errs.next + ERR_RING_N - 1) % ERR_RING_N] : nullptr;
  if (last && strcmp(last->code, code) == 0 && strcmp(last->page, ctx) == 0) {
    // Same fault as last time. Nothing to say that isn't already said; only the
    // "when" moved, and not even that within one second — which is what keeps a
    // pack whose eight sources all fail at once down to a single write.
    if (last->t == t) return;
    last->t = t;
    LOGF("[err] %s%s%s again\n", code, ctx[0] ? " " : "", ctx);
  } else {
    ErrEntry& slot = g_errs.e[g_errs.next];
    slot.t = t;
    errCopyField(slot.code, sizeof slot.code, code);
    memcpy(slot.page, ctx, sizeof ctx);
    g_errs.next = (uint8_t)((g_errs.next + 1) % ERR_RING_N);
    if (g_errs.count < ERR_RING_N) g_errs.count++;
    newEntry = true;
    LOGF("[err] recorded %s%s%s\n", code, ctx[0] ? " " : "", ctx);
  }
  if (newEntry) g_errTotal++;
  Preferences prefs;
  if (prefs.begin("yat", false)) {
    prefs.putBytes("err_ring", &g_errs, sizeof g_errs);
    if (newEntry) prefs.putUInt("err_total", g_errTotal);
    prefs.end();
  }
}

// Newest first — which is the order the portal's issues card wants and the
// order a person reading YAT ERRORS wants. Returns nullptr past the end.
const ErrEntry* errAt(size_t i) {
  if (i >= g_errs.count) return nullptr;
  return &g_errs.e[(g_errs.next + ERR_RING_N - 1 - i) % ERR_RING_N];
}

// Called once at the top of setup(), next to the other NVS mirrors. Anything
// that doesn't look exactly like a ring this firmware wrote — wrong size, wrong
// version, indices out of range — is discarded rather than trusted: the whole
// point of this record is that a device in trouble can still describe itself,
// and a half-understood blob is worse than an empty one.
void restoreErrorRingFromNvs() {
  Preferences prefs;
  if (prefs.begin("yat", true)) {
    if (prefs.getBytesLength("err_ring") == sizeof g_errs)
      prefs.getBytes("err_ring", &g_errs, sizeof g_errs);
    g_errTotal = prefs.getUInt("err_total", 0);
    prefs.end();
  }
  if (g_errs.version != ERR_RING_VERSION || g_errs.count > ERR_RING_N ||
      g_errs.next >= ERR_RING_N) {
    g_errs = ErrRing{ERR_RING_VERSION, 0, 0, 0, {}};
    return;
  }
  // Belt and braces on strings that came off flash: everything downstream
  // (strcmp, printf, the JSON writer) assumes they terminate.
  for (size_t i = 0; i < ERR_RING_N; i++) {
    g_errs.e[i].code[ERR_CODE_BYTES - 1] = 0;
    g_errs.e[i].page[ERR_PAGE_BYTES - 1] = 0;
  }
  if (g_errs.count) LOGF("[err] %u past failure(s) on record\n", (unsigned)g_errs.count);
}

// ---------------- conditions (see yat_errors.h) ----------------
//
// Persisted whole in one putBytes, same discipline as the ring: a power cut
// mid-write leaves the previous state, never half of this one.
struct CondState {
  uint8_t version;
  uint8_t reserved[3];
  uint32_t mask;
  uint32_t since[COND_N];  // most recent assertion, epoch; 0 = clock wasn't synced
};
static constexpr uint8_t COND_VERSION = 1;
static constexpr uint32_t COND_TTL_S = 7u * 24 * 3600;
static constexpr uint32_t COND_REFRESH_S = 3600;  // flash-write floor for a re-assert

static CondState g_cond = {COND_VERSION, {0, 0, 0}, 0, {0, 0, 0}};
static bool g_condLoaded = false;

static size_t condIndex(uint32_t bit) {
  for (size_t i = 0; i < COND_N; i++)
    if (bit == (1u << i)) return i;
  return COND_N;
}

static void condLoad() {
  if (g_condLoaded) return;
  g_condLoaded = true;
  Preferences prefs;
  if (prefs.begin("yat", true)) {
    if (prefs.getBytesLength("err_cond") == sizeof g_cond)
      prefs.getBytes("err_cond", &g_cond, sizeof g_cond);
    prefs.end();
  }
  // Anything that doesn't look like state this firmware wrote is discarded
  // rather than trusted, for the ring's reason: a half-understood blob here
  // would put a banner on a household's wall that nothing can clear.
  if (g_cond.version != COND_VERSION || (g_cond.mask >> COND_N) != 0)
    g_cond = CondState{COND_VERSION, {0, 0, 0}, 0, {0, 0, 0}};
}

static void condSave() {
  Preferences prefs;
  if (prefs.begin("yat", false)) {
    prefs.putBytes("err_cond", &g_cond, sizeof g_cond);
    prefs.end();
  }
}

void conditionSet(uint32_t bit) {
  size_t i = condIndex(bit);
  if (i >= COND_N) return;
  condLoad();
  const time_t now = time(nullptr);
  const uint32_t t = now > CLOCK_SANE_EPOCH ? (uint32_t)now : 0;
  const bool wasSet = (g_cond.mask & bit) != 0;
  // A condition already up and stamped within the hour needs no write: the
  // expiry clock only has to be roughly right, and this is called from paths
  // that can fire every wake for days.
  if (wasSet && t && g_cond.since[i] && t - g_cond.since[i] < COND_REFRESH_S) return;
  g_cond.mask |= bit;
  g_cond.since[i] = t;
  if (!wasSet) LOGF("[cond] condition 0x%x raised\n", (unsigned)bit);
  condSave();
}

void conditionClear(uint32_t bit) {
  size_t i = condIndex(bit);
  if (i >= COND_N) return;
  condLoad();
  if (!(g_cond.mask & bit)) return;  // the common case: nothing was wrong
  g_cond.mask &= ~bit;
  g_cond.since[i] = 0;
  LOGF("[cond] condition 0x%x cleared\n", (unsigned)bit);
  condSave();
}

uint32_t conditionsActive() {
  condLoad();
  const time_t now = time(nullptr);
  if (now <= CLOCK_SANE_EPOCH) return g_cond.mask;  // no clock, no honest ageing
  uint32_t live = g_cond.mask;
  for (size_t i = 0; i < COND_N; i++) {
    const uint32_t bit = 1u << i;
    if (!(live & bit) || !g_cond.since[i]) continue;
    if ((uint32_t)now - g_cond.since[i] > COND_TTL_S) live &= ~bit;
  }
  return live;
}

// Set around eng.fetchAndExtract() only, so httpsFetch knows whether the fetch
// it is about to fail belongs to one of the household's pages (record it, named)
// or to something they never asked for. The warnsum poll is the case that
// matters: it fails harmlessly by design (the previous decision carries
// forward), and a row naming "warnsum" would be a page nobody has heard of.
bool g_fetchErrRecord = false;
char g_fetchErrPage[ERR_PAGE_BYTES] = {0};
